;******************************************************************************
;                                                                             *
;    Filename:	    1788_Breadboard.asm			                      *
;    Date:	    JULY 20 2023                                              *
;    File Version:  1                                                         *
;    Author:        Shane Slack                                               *
;    Company:       Idaho State University                                    *
;    Description:   Firmware for testing PIC16F1788 breadboard adapter        *
;		                                                              *
;******************************************************************************
;******************************************************************************
;                                                                             *
;    Revision History:                                                        *
;	1: Basic setup for the PIC16LF1788. Test program for the dev board    *
;	   increments portb to indicate that the 1788 was soldered correctly  *
;	                                                                      *
;	    STARTED Fbraury 7 2023 -                                          *
;									      *
;                                                                             *
;******************************************************************************
	

	LIST	    p=16LF1788
	INCLUDE	    p16lf1788.INC
	INCLUDE	    1788_SETUP.INC
	
	; CONFIG1
; __config 0xEFE4
 __CONFIG _CONFIG1, _FOSC_INTOSC & _WDTE_OFF & _PWRTE_OFF & _MCLRE_ON & _CP_OFF & _CPD_OFF & _BOREN_OFF & _CLKOUTEN_OFF & _IESO_OFF & _FCMEN_OFF
; CONFIG2
; __config 0xFFFF
 __CONFIG _CONFIG2, _WRT_OFF  & _PLLEN_OFF & _STVREN_ON & _BORV_LO & _LPBOR_OFF & _LVP_OFF

    ;suppress "not in bank 0" message,  Found label after column 1,
    errorlevel -302,-207,-305,-206,-203			
							


;******************************************		
;INTERUPT VECTORS
;******************************************
		ORG 	H'000'					
 		GOTO 	SETUP		;RESET CONDITION GOTO SETUP
		ORG	H'004'
		GOTO	INTERUPT

		
	SETUP
		CALL	INITIALIZE
			
	
		GOTO	MAIN

		
		
;******************************************
;INTERUPT SERVICE ROUTINE 
;******************************************


INTERUPT
    SAVE_RESISTERS					;SAVE CONTENT OF WORKING AND STATUS REGISTER
	BANKSEL W_SAVE
	MOVWF W_SAVE					;SAVES CONTENTS OF WORKING REGISTER
	MOVFW STATUS	
	MOVWF STATUS_SAVE				;SAVES CONTENTS OF STATUS REGISTER
   ;**********I2C INTERRUPT FLAG TESTED **************
	BANKSEL PIR1
	BTFSS PIR1, SSP1IF
	GOTO  IOFC
	NOP
	CALL XMIT
	BANKSEL PIR1
	BCF PIR1, SSP1IF				;CLEAR I2C FLAG
	GOTO RESTORE_REGISTERS
    ;**********CLEARS INTERUPT ON CHANGE FLAG*******************
    IOFC
	BANKSEL INTCON	
	BCF	INTCON, IOCIF
	BCF	INTCON, TMR0IF		    ;DISABLE TMR0 INTERRUPT
	NOP
	CALL ENCODER
	GOTO RESTORE_REGISTERS
RESTORE_REGISTERS		 
    	;********RESTORE WORKING AND STATUS REGISTER   
	BANKSEL STATUS_SAVE				;RECALL STATUS REGISTER CONTENTS
	MOVFW STATUS_SAVE
	MOVWF STATUS					;RESTORE STATUS REGISTER
	MOVFW W_SAVE					;RESTORE WORKING REGISER
	
	RETFIE						;RETURN AND ENABLE INTERUPTS 
		

		


;******************************************
;  SUBROUTINES
;******************************************
XMIT;*****************************************	

	NOP
	
	
	

	BANKSEL SSP1STAT				;CHECK IS ADDRESS HAS BEEN SENT
	BTFSC SSP1STAT, D_NOT_A 
	RETURN
	
	
	
	
	BANKSEL COMMAND_1STBYTE
	
	MOVF COMMAND_1STBYTE, W
	
	BANKSEL  TRANSMIT_BYTE
	MOVWF TRANSMIT_BYTE
	
	
	CALL TXDATA
		
	BANKSEL SSPCON2
	BSF SSPCON2, ACKSTAT				;TEST IF ACKNOWLEDGE WAS RECEIVED
	
	BANKSEL PIR1
	BCF PIR1, SSP1IF				;CLEAR I2C FLAG
	
	RETURN
	;**********START CLOCK STRETCH**********
    TXDATA
    
    	NOP	
	BANKSEL SSP1CON1				;START CLOCK STRECH
	BCF SSP1CON1, CKP				;DISABLE CLOCK AND TRANSMIT	
	
	MOVWF	TRANSMIT_BYTE
	MOVF TRANSMIT_BYTE, W
	BANKSEL SSP1BUF					;LOAD SSP BUFFER WITH BYTE
	MOVWF SSP1BUF
	
	
	NOP
	BANKSEL SSP1CON1					;END CLOCK STRECH
	BSF SSP1CON1, CKP				;ENABLE CLOCK AND TRANSMIT
	
	BANKSEL SSP1STAT
	BTFSC SSP1STAT, BF
	GOTO $-2
	
	BANKSEL SSP1CON1					;END CLOCK STRECH
	BSF SSP1CON1, CKP				;ENABLE CLOCK AND TRANSMIT
	NOP
	RETURN
	
   	
	
ENCODER;*********************************************	
 ;*************ENCODER A IOC FLAGS ****************
    ENCODER_A_IOC
	BANKSEL IOCBF
	BTFSS IOCBF, IOCBF0				;TEST B0 INTERRUPT ON CHANGE FLAG
	GOTO  ENCODER_A_INPUTB	
	BCF	IOCBF, IOCBF0				;CLEAR B0 INTERRUPT ON CHANGE FLAG
    ENCODER_A_TEST_A_HIGH				;TEST INPUT A  (B0) HIGH
	 BANKSEL PORTB						
	 BTFSS PORTB, 0
	 GOTO ENCODER_A_TEST_A_LOW		
						 
	 BANKSEL ENCODER_A
	 BSF	 ENCODER_A, 0
	 RETURN
    ENCODER_A_TEST_A_LOW				;TEST INPUT A LOW 
	 BANKSEL PORTB						
	 BTFSC PORTB, 0
	 RETURN
  				
	 BANKSEL ENCODER_A
	 BSF	 ENCODER_A, 1
	 RETURN
	 
    ENCODER_A_INPUTB
	BANKSEL IOCBF
	BTFSS IOCBF, IOCBF1				;TEST A3 INTERRUPT ON CHANGE FLAG	
	GOTO  ENCODER_B_IOC
	BCF	IOCBF, IOCBF1
    ENCODER_A_TEST_B_HIGH				;TEST INPUT B (B1) HIGH
	 BANKSEL PORTB						
	 BTFSS PORTB, 1
	 GOTO ENCODER_A_TEST_B_LOW	
						 
	 BANKSEL ENCODER_A
	 BSF	 ENCODER_A, 2
	 RETURN
    ENCODER_A_TEST_B_LOW				;TEST INPUT B LOW
	 BANKSEL PORTB						
	 BTFSC PORTB, 1
	 RETURN
  				
	 BANKSEL ENCODER_A
	 BSF	 ENCODER_A, 3	
	 RETURN
	
    ;***************TEST AND CLEAR IOC FLAGS ENCODER B***********
    ENCODER_B_IOC
	BANKSEL IOCBF
	BTFSS IOCBF, IOCBF2				;TEST B2 INTERRUPT ON CHANGE FLAG
	GOTO  ENCODER_B_INPUTB	
	BCF	IOCBF, IOCBF2				;CLEAR B2 INTERRUPT ON CHANGE FLAG
    ENCODER_B_TEST_A_HIGH				;TEST INPUT A  (B2) HIGH
	 BANKSEL PORTB						
	 BTFSS PORTB, 2
	 GOTO ENCODER_B_TEST_A_LOW		
						 
	 BANKSEL ENCODER_B
	 BSF	 ENCODER_B, 0
	 RETURN
    ENCODER_B_TEST_A_LOW				;TEST INPUT A LOW 
	 BANKSEL PORTB						
	 BTFSC PORTB, 2
	 RETURN
  				
	 BANKSEL ENCODER_B
	 BSF	 ENCODER_B, 1
	 RETURN
    ENCODER_B_INPUTB
	BANKSEL IOCBF
	BTFSS IOCBF, IOCBF3				;TEST B3 INTERRUPT ON CHANGE FLAG
	RETURN
	BCF	IOCBF, IOCBF3
    ENCODER_B_TEST_B_HIGH				;TEST INPUT B (B3) HIGH
	 BANKSEL PORTB						
	 BTFSS PORTB, 3
	 GOTO ENCODER_B_TEST_B_LOW	
						 
	 BANKSEL ENCODER_B
	 BSF	 ENCODER_B, 2
	RETURN
    ENCODER_B_TEST_B_LOW				;TEST INPUT B LOW
	 BANKSEL PORTB						
	 BTFSC PORTB, 3
	RETURN

	 BANKSEL ENCODER_B
	 BSF	 ENCODER_B, 3

	 RETURN
	
	
DELAY ;************************************
							;.5 SEC DELAY BETWEEN OUTPUTS					
	NESTED_LOOP_SETUP				;NEST LOOP CREATES MOST OF THE DELAY
	    MOVLW 0XF3					;SETS COUNT OF OUTER LOOP OF NESTED LOOP TO 243 CYCLES
	    MOVWF COUNT2
	OUTER_LOOP					;SETS COUNT OF INNER LOOP OF NESTED LOOP TO 256 CYCLES
	    MOVLW 0X00
	    MOVWF COUNT1 
	INNER_LOOP					;INNER LOOP WITH 32 Q STATES
	    NOP
	    NOP
	    NOP
	    NOP
	    NOP
	    DECFSZ COUNT1
	    GOTO INNER_LOOP
	END_INNER_LOOP  
	    DECFSZ COUNT2				;RUNS OUTER LOOP
	    GOTO OUTER_LOOP   	
	
	

		RETURN
		
 ENCODER_A_SUB ;**********************************
	;*********INPUT A CHANGES FROM HIGH TO LOW
		BANKSEL ENCODER_A
		BTFSS ENCODER_A, 0
		GOTO ENCODER_A_INA_LOW				
	    ;**********OLD B INPUT LOW
		BANKSEL PORTB
		BTFSC PORTB, 1
		GOTO ENCODER_A_INB_HIGH
		
		BANKSEL INPUT_OLD_A
		BTFSC INPUT_OLD_A, 1
		GOTO LEAVE_A
	    ;*********CLOCK WISE OUTPUT
		GOTO CLOCKWISE_A
	
	    ;**********OLD B INPUT HIGH
	    ENCODER_A_INB_HIGH	
		BANKSEL INPUT_OLD_A
		BTFSS INPUT_OLD_A, 1
		GOTO LEAVE_A
	    ;*********COUNTER CLOCK WISE OUTPUT
	     GOTO COUNTERCLOCKWISE_A
		
	;*************INPUT A CHANGED FROM LOW TO HIGH	
	    ENCODER_A_INA_LOW
		BANKSEL ENCODER_A
		BTFSS ENCODER_A, 1
		GOTO ENCODER_A_INB_H
	   ;**********OLD B INPUT HIGH
		BANKSEL PORTB
		BTFSS PORTB, 1
		GOTO ENCODER_A_INB_LOW
		
		BANKSEL INPUT_OLD_A
		BTFSS INPUT_OLD_A, 1
		GOTO LEAVE_A
	    ;*********CLOCK WISE OUTPUT
		GOTO CLOCKWISE_A
		
	    ;**********OLD B INPUT LOW
	    ENCODER_A_INB_LOW
		BANKSEL INPUT_OLD_A
		BTFSC INPUT_OLD_A, 1
		GOTO LEAVE_A
	    ;*********COUNTER CLOCK WISE OUTPUT
	     GOTO COUNTERCLOCKWISE_A
			
	;*************INPUT B CHANGED FROM LOW TO HIGH		
	ENCODER_A_INB_H
		BANKSEL ENCODER_A
		BTFSS ENCODER_A, 2
		GOTO ENCODER_A_INB_L
	    ;**********OLD A INPUT HIGH
		BANKSEL PORTB
		BTFSS PORTB, 0
		GOTO ENCODER_A_INA_HIGH
		
		BANKSEL INPUT_OLD_A
		BTFSS INPUT_OLD_A, 0
		GOTO LEAVE_A
	    ;*********CLOCK WISE OUTPUT
		GOTO CLOCKWISE_A
		
	    ;**********OLD A INPUT LOW
	    ENCODER_A_INA_HIGH
		BANKSEL INPUT_OLD_A
		BTFSC INPUT_OLD_A, 0
		GOTO LEAVE_A
	    ;*********COUNTER CLOCK WISE OUTPUT
	     GOTO COUNTERCLOCKWISE_A
			
	;*************INPUT B CHANGED FROM HIGH TO LOW			
	    ENCODER_A_INB_L	
		BANKSEL ENCODER_A
		BTFSS ENCODER_A, 3
		GOTO LEAVE_A	
	    ;**********OLD A INPUT LOW
		BANKSEL PORTB
		BTFSC PORTB, 0
		GOTO ENCODER_A_INA_L_2
	
		BANKSEL INPUT_OLD_A
		BTFSC INPUT_OLD_A, 0
		GOTO LEAVE_A
	    ;*********CLOCK WISE OUTPUT
		GOTO CLOCKWISE_A
		
	    ;**********OLD A INPUT HIGH
	    ENCODER_A_INA_L_2
		BANKSEL INPUT_OLD_A
		BTFSS INPUT_OLD_A, 0
		GOTO LEAVE_A
	    ;*********COUNTER CLOCK WISE OUTPUT
	    GOTO COUNTERCLOCKWISE_A
		
	;*********CLOCK WISE OUTPUT	
	CLOCKWISE_A
	        BANKSEL PORTB
		BSF PORTB, 4
		BANKSEL COMMAND_ENCODER 
		BSF COMMAND_ENCODER, 4
		CALL DELAY
		BANKSEL PORTB
		BCF PORTB, 4

		GOTO LEAVE_A	
	;*********COUNTER CLOCK WISE OUTPUT
	COUNTERCLOCKWISE_A
		BANKSEL PORTB
		BSF PORTB, 5
		BANKSEL COMMAND_ENCODER
		BSF COMMAND_ENCODER, 5
		NOP
		CALL DELAY
		BANKSEL PORTB
		BCF PORTB, 5	
		GOTO LEAVE_A	
	LEAVE_A		
		MOVLW 0X03			;SET OLD OUTPUT FROM CURRENT INPUTS
		BANKSEL PORTB
		ANDWF  PORTB, W
		BANKSEL INPUT_OLD_A
		MOVWF INPUT_OLD_A
		BANKSEL ENCODER_A			;CLEAR CHANGE ON INTERRUPT ENABLE
		CLRF ENCODER_A
	
		RETURN

  ENCODER_B_SUB;*************************************
	
	;*********INPUT A CHANGES FROM HIGH TO LOW
		BANKSEL ENCODER_B
		BTFSS ENCODER_B, 0
		GOTO ENCODER_B_INA_LOW				
	    ;**********OLD B INPUT LOW
		BANKSEL PORTB
		BTFSC PORTB, 3
		GOTO ENCODER_B_INB_HIGH
		
		BANKSEL INPUT_OLD_B
		BTFSC INPUT_OLD_B, 3
		GOTO LEAVE_B
	    ;*********CLOCK WISE OUTPUT
		GOTO CLOCKWISE_B
	
	    ;**********OLD B INPUT HIGH
	    ENCODER_B_INB_HIGH	
		BANKSEL INPUT_OLD_B
		BTFSS INPUT_OLD_B, 3
		GOTO LEAVE_B
	    ;*********COUNTER CLOCK WISE OUTPUT
		GOTO COUNTERCLOCKWISE_B
		
	;*************INPUT A CHANGED FROM LOW TO HIGH	
	    ENCODER_B_INA_LOW
		BANKSEL ENCODER_B
		BTFSS ENCODER_B, 1
		GOTO ENCODER_B_INB_H
	   ;**********OLD B INPUT HIGH
		BANKSEL PORTB
		BTFSS PORTB, 3
		GOTO ENCODER_B_INB_LOW
		
		BANKSEL INPUT_OLD_B
		BTFSS INPUT_OLD_B, 3
		GOTO LEAVE_B
	    ;*********CLOCK WISE OUTPUT
		GOTO CLOCKWISE_B
	
	    ;**********OLD B INPUT LOW
	    ENCODER_B_INB_LOW
		BANKSEL INPUT_OLD_B
		BTFSC INPUT_OLD_B, 3
		GOTO LEAVE_B
	    ;*********COUNTER CLOCK WISE OUTPUT
		GOTO COUNTERCLOCKWISE_B
	
	;*************INPUT B CHANGED FROM LOW TO HIGH		
	    ENCODER_B_INB_H
		BANKSEL ENCODER_B
		BTFSS ENCODER_B, 2
		GOTO ENCODER_B_INB_L
	    ;**********OLD A INPUT HIGH
		BANKSEL PORTB
		BTFSS PORTB, 2
		GOTO ENCODER_B_INA_HIGH
		
		BANKSEL INPUT_OLD_B
		BTFSS INPUT_OLD_B, 2
		GOTO LEAVE_B
	    ;*********CLOCK WISE OUTPUT
		GOTO CLOCKWISE_B
	
	    ;**********OLD A INPUT LOW
	    ENCODER_B_INA_HIGH
		BANKSEL INPUT_OLD_B
		BTFSC INPUT_OLD_B, 2
		GOTO LEAVE_B
	    ;*********COUNTER CLOCK WISE OUTPUT
		GOTO COUNTERCLOCKWISE_B
	
	;*************INPUT B CHANGED FROM HIGH TO LOW			
	    ENCODER_B_INB_L	
		BANKSEL ENCODER_B
		BTFSS ENCODER_B, 3
		GOTO LEAVE_B	
	    ;**********OLD A INPUT LOW
		BANKSEL PORTB
		BTFSC PORTB, 2
		GOTO ENCODER_B_INA_L_2
	
		BANKSEL INPUT_OLD_B
		BTFSC INPUT_OLD_B, 2
		GOTO LEAVE_B
	    ;*********CLOCK WISE OUTPUT
		GOTO CLOCKWISE_B
	
	    ;**********OLD A INPUT HIGH
	    ENCODER_B_INA_L_2
		BANKSEL INPUT_OLD_B
		BTFSS INPUT_OLD_B, 2
		GOTO LEAVE_B
	    ;*********COUNTER CLOCK WISE OUTPUT
		GOTO COUNTERCLOCKWISE_B
	
	;*********CLOCK WISE OUTPUT	
	CLOCKWISE_B
		BANKSEL PORTB
		BSF PORTB, 6
		BANKSEL COMMAND_ENCODER
		BSF COMMAND_ENCODER, 6
		CALL DELAY
		BANKSEL PORTB
		BCF PORTB, 6
		GOTO LEAVE_B	
	;*********COUNTER CLOCK WISE OUTPUT
	COUNTERCLOCKWISE_B
		BANKSEL PORTB
		BSF PORTB, 7
		BANKSEL COMMAND_ENCODER
		BSF COMMAND_ENCODER, 7
		CALL DELAY
		BANKSEL PORTB
		BCF PORTB, 7		
		GOTO LEAVE_B		
	
	LEAVE_B	
		MOVLW 0X0C			;SET OLD OUTPUT FROM CURRENT INPUTS
		BANKSEL PORTB
		ANDWF  PORTB, W
		BANKSEL INPUT_OLD_B
		MOVWF INPUT_OLD_B
		BANKSEL ENCODER_B			;CLEAR CHANGE ON INTERRUPT ENABLE
		CLRF ENCODER_B
				
		RETURN

  	
;******************************************
MAIN
;******************************************

		
;	BANKSEL COMMAND_1STBYTE
;	CLRF COMMAND_1STBYTE

    ;************TEST IF SWITCH IS HIGH (MODE SELECT)
    INPUT_SWITCH

		BANKSEL PORTA
		BTFSS PORTA, 0
		GOTO INPUT_1
	;****SWITCH HIGH
		MOVLW 0XE7		    ;OUT PUT LEDS = WORKS 
		BANKSEL PORTC
		MOVWF PORTC
	
		MOVLW 0XF0		    ;OUT PUT LEDS = WORKS 
		BANKSEL PORTB
		MOVWF PORTB
		
		CALL DELAY
		
		
		
		BANKSEL PORTB
		CLRF PORTB
		
		GOTO MAIN
    ;************TEST IF INPUT 1 (SHOOT) IS PRESSED
    INPUT_1
				
		BANKSEL PORTC
		BCF PORTC,0
		BANKSEL PORTA
;		BANKSEL COMMAND_1STBYTE
;		BCF  COMMAND_1STBYTE, 0
		BTFSS PORTA, 1
		GOTO INPUT_2
		
	;****INPUT1 PRESSED
		BANKSEL PORTC
		BSF PORTC, 0
		
		BANKSEL COMMAND_1STBYTE
		BSF  COMMAND_1STBYTE, 0
    ;***********TEST IF INPUT 2 (REV) IS PRESSED
    INPUT_2	
		BANKSEL PORTC
		BCF PORTC, 1
;		BANKSEL COMMAND_1STBYTE
;		BCF  COMMAND_1STBYTE, 1
		BANKSEL PORTA
		BTFSS PORTA, 2
		GOTO INPUT_3
		
		
	;*******INPUT 2 PRESSED
		BANKSEL PORTC
		BSF PORTC, 1	
		
		BANKSEL COMMAND_1STBYTE
		BSF  COMMAND_1STBYTE, 1
    ;***********TEST IF INPUT 3  IS PRESSED
    INPUT_3	
		BANKSEL PORTC
		BCF PORTC, 2
;		BANKSEL COMMAND_1STBYTE
;		BCF  COMMAND_1STBYTE, 2
		BANKSEL PORTA
		BTFSS PORTA, 3
		GOTO INPUT_4
		
	;*******INPUT 2 PRESSED
		BANKSEL PORTC
		BSF PORTC, 2
		
		BANKSEL COMMAND_1STBYTE
		BSF  COMMAND_1STBYTE, 2
    ;************TEST INPUT 4 PRESSED*****************
    INPUT_4	
	        
		BANKSEL PORTC
		BCF PORTC, 5
;		BANKSEL COMMAND_1STBYTE
;		BCF  COMMAND_1STBYTE, 3
		BANKSEL PORTA
		BTFSS PORTA, 4
		GOTO INPUT_5
	;****INPUT 4 HIGH
		BANKSEL PORTC
		BSF PORTC, 5
		
		BANKSEL COMMAND_1STBYTE
		BSF  COMMAND_1STBYTE, 3
    ;************TEST INPUT 5 PRESSED******************
    INPUT_5	
		BANKSEL PORTC
		BCF PORTC, 6
		BANKSEL PORTA
		BTFSS PORTA, 5
		GOTO INPUT_6
	
	;****INPUT 4 HIGH
		BANKSEL PORTC
		BSF PORTC, 6
    ;***********TEST IF INPUT 6 HIGH
    INPUT_6	
		BANKSEL PORTC
		BCF PORTC, 7
		BANKSEL PORTA
		BTFSS PORTA, 6
		GOTO ENCODER_A_TEST	
		
	;*******INPUT 6 HIGH
		BANKSEL PORTC
		BSF PORTC, 7
    ;**********TEST ENCODER A INPUTS ********
    ENCODER_A_TEST
		CALL ENCODER_A_SUB
	    CW_A	
		BANKSEL COMMAND_ENCODER
		BTFSS COMMAND_ENCODER, 4
		GOTO CCW_A
		
		BANKSEL COMMAND_1STBYTE
		BSF  COMMAND_1STBYTE, 4
		GOTO ENCODER_B_TEST
	    CCW_A	
		BANKSEL COMMAND_ENCODER
		BTFSS COMMAND_ENCODER, 5
		GOTO  ENCODER_B_TEST
		 
		BANKSEL COMMAND_1STBYTE
		BSF  COMMAND_1STBYTE, 5
		GOTO ENCODER_B_TEST
		
    ;**********TEST ENCODER B INPUTS ********		
    ENCODER_B_TEST  
		CALL ENCODER_B_SUB
	    CW_B	
		BANKSEL COMMAND_ENCODER
		BTFSS COMMAND_ENCODER, 6
		GOTO CCW_B
		
		BANKSEL COMMAND_1STBYTE
		BSF  COMMAND_1STBYTE, 6
		GOTO FINAL
	    CCW_B	
		BANKSEL COMMAND_ENCODER
		BTFSS COMMAND_ENCODER, 7
		GOTO  FINAL
		 
		BANKSEL COMMAND_1STBYTE
		BSF  COMMAND_1STBYTE, 7
		

;*************END ??***************************
		
FINAL		
	BANKSEL COMMAND_1STBYTE
	CLRF  COMMAND_1STBYTE

;	BANKSEL COMMAND_ENCODER
;	CLRF COMMAND_ENCODER
	
	GOTO MAIN
	
	END
;********************END PROGRAM DIRECTIVE ***********************************
;*****************************************************************************
