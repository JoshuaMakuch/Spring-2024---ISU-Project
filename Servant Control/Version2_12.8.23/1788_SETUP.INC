;******************************************************************************
;                                                                             *
;    Filename:	    1788_SETUP.INC				              *
;    Date:	    JULY 20 2023                                              *
;    File Version:  3                                                         *
;    Author:        Shane Slack                                               *
;    Company:       Idaho State University                                    *
;    Description:   Firmware for Seting up a PIC16F1788			      *
;		                                                              *
;******************************************************************************

;******************************************************************************
;                                                                             *
;    Revision History:                                                        *
;	1: INITIAL FILE TO SETUP A PIC16F1788 SPECIFICS ON SETUP SHOULD BE    *
;	   LISTED HERE AS MODIFIED                                            *
;	    STARTED July 20 2023 - CURRENT VERSION IMPLEMENTED August 26,2023 *
;	2:  BY JOSHUA MAKUCH                                      *
;	    STARTED NOV 8 2023 - CURRENT VERSION IMPLEMENTED NOV 8 2023	      *
;									      *
;       3: ADAPTED FOR PHERIPHERAL 					      *
;	    STARTED NOV 16 2023 - CURRENT VERSION IMPLEMENTED NOV  2023	 								      *
;                                                                             *
;******************************************************************************

    
 
    
;******************************************
;DEFINE PERSONAL SFR LOCATIONS
;******************************************
COUNT1		EQU H'0020'		;REGISTER FOR DELAY COUNTING
COUNT2		EQU H'0021'		;REGISTER FOR DELAY COUNTING

STATUS_SAVE	EQU H'0030'		;SAVE CONTENTS OF STATUS REGISTER
W_SAVE	        EQU H'0031'		;SAVES CONTENTS OF WORKING REGISTER
		
ENCODER_A	EQU H'0040'		;ENABLE ENCODER A
INPUT_OLD_A	EQU H'0041'		;REGISTER SAVES LAST ENCODER A INPUT	
ENCODER_B	EQU H'0042'		;ENABLE ENCODER B 
INPUT_OLD_B	EQU H'0043'		;REGISTER SAVES LAST ENCODER B INPUT

	
COMMAND_1STBYTE EQU H'0050'		;STORES DATA OF FIRST COMMAND
COMMAND_ENCODER EQU H'0055'
 
TRANSMIT_BYTE	EQU H'0060'		;TRANSMIT DATA

		
;******************************************
;DEFINE CONSTANTS
;******************************************

	
	
;******************************************		
;DEFINE PIN / BIT LABELS
;******************************************

	
	
		
SETUP_CODE   CODE		;START OF THE FILE
	    
INITIALIZE
   
;------OSC SETUP  ----------------------------------------------
		BANKSEL	OSCCON
		MOVLW	0X7A
		MOVWF	OSCCON		;SET INTERNL OSC TO 32 MHZ
		
;------OSC SETUP  ----------------------------------------------
		;BANKSEL	OSCCON				;OSCILLATOR CONTROL, REGISTER 6-1 (PG.86)
		;BCF		OSCCON,	SPLLEN		;SOFTWARE PLL ENABLE BIT
		;BSF		OSCCON,	IRCF3		;INTERNAL OSCILLATOR FREQUENCY SELECT BITS
		;BSF		OSCCON,	IRCF2		;(SET TO 16 MHz)
		;BSF		OSCCON,	IRCF1		
		;BSF		OSCCON,	IRCF0		
		;BSF		OSCCON,	SCS1		;SYSTEM CLOCK SELECT BITS
		;BSF		OSCCON,	SCS0		;(SET TO INTERNAL OSCILLATOR BLOCK)	
                              	
;------ I/O PORT SETUP ------------------------------------------------------	
;* PORT A SETUP  **************************************
					
		BANKSEL LATA		;PORTA DATA LATCH, REGISTER 13-4 (PG.136)
		CLRF	LATA		;CLEAR PORTA LATCHES
		
		BANKSEL	TRISA		;PORTA TRI-STATE, REGISTER 13-5 (PG.136)
		MOVLW	0xFF		;SET PORTA AS INPUTS  
		MOVWF	TRISA		
		
		MOVLW	0X00	    
		BANKSEL	WPUA		;WEAK PULL-UP PORTA, REGISTER 13-7 (PG.137)
		MOVWF	WPUA		;DISABLE PORT A WEAK PULLUPS
		
		BANKSEL	SLRCONA		;PORTA SLEW RATE CONTROL, REGISTER 13-9 (PG.138)
		CLRF	SLRCONA		;SLEWRATE TO MAXIMUM
		
		BANKSEL	INLVLA		;PORTA INPUT LEVEL CONTROL, REGISTER 13-10 (PG.138)
		CLRF	INLVLA		;SET INPUT LEVEL TO TTL
		
		BANKSEL	ODCONA		;PORTA OPEN-DRAIN CONTROL, REGISTER 13-8 (PG.138)
		CLRF	ODCONA		;SET PORT A TO PUSH PULL
		
		BANKSEL ANSELA		;PORTA ANALOG SELECT, REGISTER 13-6 (PG.137)
		CLRF	ANSELA		;SET ALL PORTA TO DIGITAL I/O
		
		BANKSEL PORTA		;PORTA, REGISTER 13-3 (PG.136)
		CLRF    PORTA		;SET ALL PINS LOW	
;* PORT B SETUP	***************************************************************			
		BANKSEL LATB		;PORTB DATA LATCH, REGISTER 13-13 (PG.142)	
		CLRF	LATB		;CLEAR PORTB LATCHES
		
		BANKSEL	TRISB		;PORTB TRI-STATE, REGISTER 13-12 (PG.142)
		MOVLW	0x0F		;SET TO B0-3 AS INPUTS, B4-7 AS OUTPUTS
		MOVWF	TRISB		;PORTB SET TO B0-3 AS INPUTS		
		
		BANKSEL	WPUB		;WEAK PULL-UP PORTB, REGISTER 13-15 (PG.143)			
		MOVLW	0X00		;DIABLE ALL PORTB WEAK-PULLUPS
		MOVWF	WPUB		
		
		BANKSEL	SLRCONB		;PORTB SLEW RATE CONTROL, REGISTER 13-17 (PG.144)
		CLRF	SLRCONB		;SLEWRATE TO MAXIMUM	
		
		BANKSEL	INLVLB		;PORTB INPUT LEVEL CONTROL, REGISTER 13-18 (PG.144)		
		CLRF	INLVLB		;SET INPUT LEVEL TO TTL	
		
		BANKSEL	ODCONB		;PORTB OPEN-DRAIN CONTROL, REGISTER 13-16 (PG.144)		 
		CLRF	ODCONB		;SET PORT B TO PUSH PULL

		BANKSEL ANSELB		;PORTB ANALOG SELECT, REGISTER 13-14 (PG.143)
		CLRF	ANSELB		;SET ALL PORTB TO DIGITAL I/O
		
		BANKSEL PORTB		;PORTB, REGISTER 13-11 (PG.142)	
		CLRF    PORTB		;SET ALL PINS LOW
;PORT C SETUP******************************************************************
		BANKSEL LATC		;PORTC DATA LATCH, REGISTER 13-21 (PG.147)	
		CLRF	LATC		;CLEAR ALL PORTC LATCHES
		
					;PORTB TRI-STATE, REGISTER 13-20 (PG.147)
		MOVLW 0X18		;PORT C C0-2 AND 5-7 AS OUTPUTS, 
		BANKSEL TRISC		;C3 AND C4 FOR I2C
		MOVWF	TRISC		;PORTC AS OUTPUT
		
		MOVLW	0X00		
		BANKSEL	WPUC		;WEAK PULL-UP PORTC, REGISTER 13-22 (PG.148)	
		MOVWF	WPUC		;DISABLE WEAK PULLUPS 
		
		BANKSEL	SLRCONC		;PORTC SLEW RATE CONTROL, REGISTER 13-24 (PG.148)
		CLRF	SLRCONC		;SLEWRATE TO MAXIMUM
		
		BANKSEL	INLVLC		;PORTC INPUT LEVEL CONTROL, REGISTER 13-25 (PG.149)	
		CLRF	INLVLC		;SET INPUT LEVEL TO TTL
		
		BANKSEL	ODCONC		;PORTC OPEN-DRAIN CONTROL, REGISTER 13-23 (PG.148)	
		CLRF	ODCONC		;SET PORT C TO PUSH PULL
		
		BANKSEL PORTC		;PORTC, REGISTER 13-19 (PG.147)	
		CLRF    PORTC		;SET ALL PINS LOW

;------ COMM PINS SETUP ----------------------------------------------
;*******I2C PORT ON RC 3&4,   ******************
		BANKSEL	APFCON1		    ;ALTERNTE PIN FUNCTION CONTROL, REGISTER 13-1 (PG.132)
		MOVLW	0X00
		MOVWF	APFCON1
;		BCF	APFCON1, SCKSEL	    ;0 [SCK = RC3] / 1 [SCK = RB7]
;		BCF	APFCON1, SDISEL	    ;0 [SDA = RC4] / 1 [SDA = RB6]
;		BCF	APFCON1, TXSEL	    ;0 [TX = RC6] / 1 [TX = RB6]
;		BCF	APFCON1, RXSEL	    ;0 [RX = RC7] / 1 [RX = RB7]
;		BCF	APFCON1, C2OUTSEL   ;0 [C2OUT = RA5] / 1 [C2OUT = RA6]	
;		BCF	APFCON1, CCP1SEL    ;0 [CCP1 = RC2] / 1 [CCP1 = RB0]
;		BCF	APFCON1, SDOSEL	    ;0 [CCP1 = RC5] / 1 [CCP1 = RB5]
;		BCF	APFCON1, CCP2SEL    ;0 [CCP2 = RC1] / 1 [CCP2 = RB3]
			
;MISC SETUP ******************************************************************
;OPTION_REG REGISTER:
		BANKSEL OPTION_REG		    ;OPTION, REGISTER 22-1 (PG.208)
		BCF	OPTION_REG, PS0		    ;\\
		BCF	OPTION_REG, PS1		    ; >>PRESCALER RATIO SET 1:1
		BCF	OPTION_REG, PS2		    ;//
		BSF	OPTION_REG, PSA		    ;PRESCALER ASSIGNED TO WDT 
		BCF	OPTION_REG, T0SE	    ;TMR0 EDGE SET RISING
		BCF	OPTION_REG, T0CS	    ;TMR0 CLOCK SET TO INTERNAL
		BSF	OPTION_REG, INTEDG	    ;RB0/INT SET TO RISING EDGE
		BCF	OPTION_REG, 7		    ;PULLUPS SET TO INDIVIDUALLY EN.	
;INTCON REGISTER:
		BANKSEL INTCON			    ;INTERRUPT CONTROL, REGISTER 8-1 (PG.97)
		BCF	INTCON, INTE		    ;DISABLE RB0/INT EXT INTERRUPT
		BCF	INTCON, TMR0IE		    ;DISABLE TMR0 INTERRUPT
		BCF	INTCON, IOCIE		    ;DISABLE INTERRUPTS ON CHANGE
		BCF	INTCON, PEIE		    ;DISABLE PERIPHERAL INTERRUPTS
		BCF	INTCON, GIE		    ;DISABLE ALL UNMASKED INTERRUPTS
;PIE1 REGISTER:
		BANKSEL PIE1			    ;PERIPHERAL INTERRUPT ENABLE 1, REGISTER 8-2 (PG.98)
		BCF	PIE1, TMR1IE		    ;DISABLE TMR1 INTERRUPT
		BCF	PIE1, TMR2IE		    ;DISABLE TMR2 INTERRUPT
		BCF	PIE1, CCP1IE		    ;DISABLE CCP1 INTERRUPT
		BCF	PIE1, SSP1IE		    ;DISABLE SSP INTERRUPT
		BCF	PIE1, TXIE		    ;DISABLE USART TX INTERRUPT
		BCF	PIE1, RCIE		    ;DISABLE USART RX INTERRUPT
 		BCF	PIE1, ADIE		    ;DISABLE A/D INTERRUPT
		BCF	PIE1, 7			    ;DISABLE PSP INTERRUPT	
;PIE2 REGISTER:
		BANKSEL	PIE2			    ;PERIPHERAL INTERRUPT ENABLE 2, REGISTER 8-3 (PG.99)
		BCF	PIE2, CCP2IE		    ;DISABLE THE CCP2 INTERRUPT
		BCF	PIE2, BCL1IE		    ;DISABLE BUS COLLISION INTERRUPT
		BCF	PIE2, EEIE		    ;DISABLE EEPROM WRITE INTERRUPT
		BCF	PIE2, C3IE		    ;DISABLE COMPARATOR C3 INTERRUPT
		BCF	PIE2, C4IE		    ;DISABLE COMPARATOR C4 INTERRUPT
		BCF	PIE2, C1IE		    ;DISABLE COMPARATOR C1 INTERRUPT
		BCF	PIE2, C2IE		    ;DISABLE COMPARATOR C2 INTERRUPT
		BCF	PIE2, OSFIE		    ;DISABLE OSCILLATOR FAIL INTERRUPT		
;PIE3 REGISTER	
		BANKSEL PIE3			    ;PERIPHERAL INTERRUPT ENABLE 3, REGISTER 8-4 (PG.100)
		BCF	PIE3, CCP3IE		    ;DISALBES CCP3 INTERRUPT		
;PIE4 REGISTER		
		BANKSEL PIE4			    ;PERIPHERAL INTERRUPT ENABLE 4, REGISTER 8-5 (PG.101)
		BCF	PIE4, PSMC1SIE		    ;DISABLE PSMC1 AUTO-SHUTDOWN INTERRUPTS
		BCF	PIE4, PSMC2SIE		    ;DISABLE PSMC2 AUTO-SHUTDOWN INTERRUPTS
		BCF	PIE4, PSMC3SIE		    ;DISABLE PSMC3 AUTO-SHUTDOWN INTERRUPTS
		BCF	PIE4, PSMC4SIE		    ;DISABLE PSMC4 AUTO-SHUTDOWN INTERRUPTS
		BCF	PIE4, PSMC1TIE		    ;DISABLE PSMC1 TIME BASE GENERATED INTERRUPTS
		BCF	PIE4, PSMC2TIE		    ;DISABLE PSMC2 TIME BASE GENERATED INTERRUPTS
		BCF	PIE4, PSMC3TIE		    ;DISABLE PSMC3 TIME BASE GENERATED INTERRUPTS
		BCF	PIE4, PSMC4TIE		    ;DISABLE PSMC4 TIME BASE GENERATED INTERRUPTS
;T1CON REGISTER: 
		BANKSEL	T1CON			    ;TIMER1 CONTROL, REGISTER 23-1 (PG.217)
		BCF	T1CON, TMR1ON		    ;DISABLE TIMER 1
		BCF	T1CON, T1OSCEN		    ;OSCILLATOR IS SHUT OFF
		;BCF	T1CON, T1CKPS1		    ;00 1:1 PRESCALE VALUE
		;BCF	T1CON, T1CKPS0	
;T2CON REGISTER:  
		BANKSEL	T2CON			    ;TIMER2 CONTROL, REGISTER 24-1 (PG.222)
		;BSF	T2CON, T2OUTPS0		    ;\
		;BSF	T2CON, T2OUTPS1		    ; \ TIMER 2 POSTSCALER
		;BSF	T2CON, T2OUTPS2		    ; / '0111' POSTSCALER = 1:8
		;BCF	T2CON, T2OUTPS3		    ;/
		BCF	T2CON, TMR2ON		    ;DIS. TIMER 2/ ENABLED AS NEEDED
		;BSF	T2CON, T2CKPS0		    ;\ 11 PRESCALE VALUE IS 64
		;BSF	T2CON, T2CKPS1		    ;/		
;PR2 REGISTER:  (HOLDS COMPARISON VALUE FOR TIMER INTERUPT)
		;MOVLW	HALF_SEC		    ;VALUE SET IN DEF OF CONSTATNTS 
		;BANKSELPR2
		;MOVWF	PR2
		
		;BANKSEL	PR2
		;MOVLW		D'078'		;T2 INTERVAL = 4.992mS
;CCP1CON REGISTER:
		BANKSEL	CCP1CON			;CCP1 CONTROL, REGISTER 25-1 (PG.231)
		BCF	CCP1CON, CCP1M0	
		BCF	CCP1CON, CCP1M1		;>CAPTURE/COMPARE/PWM DISABLED
		BCF	CCP1CON, CCP1M2	
		BCF	CCP1CON, CCP1M3	
;CCP2CON REGISTER:
		BANKSEL	CCP2CON			;CCP2 CONTROL, REGISTER 25-1 (PG.231)
		BCF	CCP2CON, CCP2M0	
		BCF	CCP2CON, CCP2M1		;>CAPTURE/COMPARE/PWM DISABLED
		BCF	CCP2CON, CCP2M2	
		BCF	CCP2CON, CCP2M3	
;CCP3CON REGISTER:
		BANKSEL	CCP3CON			;CCP3 CONTROL, REGISTER 25-1 (PG.231)
		BCF	CCP3CON, CCP3M0	
		BCF	CCP3CON, CCP3M1		;>CAPTURE/COMPARE/PWM DISABLED
		BCF	CCP3CON, CCP3M2	
		BCF	CCP3CON, CCP3M3	
;FVRCON REGISTER
		BANKSEL FVRCON			;FIXED VOLTAGE REFERENCE CONTROL, REGISTER 15-1 (PG.167)
		BCF	FVRCON, TSEN		;DISABLE TEMPERATURE INDICATOR
		BCF	FVRCON, FVREN		;DISABLE FIXED VOLTAGE REFERENCE		
;OPA1CON REGISTER
		BANKSEL OPA1CON			;OPERATIONAL AMPLIFIER 1 CONTROL, REGISTER 18-1 (PG.187)
		BCF	OPA1CON, OPA1EN		;DISABLE OP AMP 1
;OPA2CON REGISTER
		BANKSEL OPA2CON			;OPERATIONAL AMPLIFIER 2 CONTROL, REGISTER 18-1 (PG.187)
		BCF	OPA2CON, OPA1EN		;DISABLE OP AMP 2
;DAC1CON0 REGISTER
		BANKSEL DAC1CON0		;VOLTAGE REFERENCE CONTROL, REGISTER 19-1 (PG.192)
		BCF	DAC1CON0, DAC1EN	;DISABLE DAC1
;DAC2CON0 REGISTER
		BANKSEL DAC2CON0		;VOLTAGE REFERENCE CONTROL, REGISTER 20-1 (PG.196)
		BCF	DAC2CON0, DAC2EN	;DISABLE DAC2
;DAC3CON0 REGISTER
		BANKSEL DAC3CON0		;VOLTAGE REFERENCE CONTROL, REGISTER 20-1 (PG.196)
		BCF	DAC3CON0, DAC3EN	;DISABLE DAC3
;DAC4CON0 REGISTER
		BANKSEL DAC4CON0		;VOLTAGE REFERENCE CONTROL, REGISTER 20-1 (PG.196)
		BCF	DAC4CON0, DAC4EN	;DISABLE DAC4
;CM1CON0 REGISTER   
		BANKSEL	CM1CON0			;COMPARATOR C1 CONTROL, REGISTER 21-1 (PG.203)
		BCF	CM1CON0, C1ON		;DISABLE COMPARATOR C1
;CM2CON0 REGISTER  
		BANKSEL	CM2CON0			;COMPARATOR C2 CONTROL, REGISTER 21-1 (PG.203)
		BCF	CM2CON0, C2ON		;DISABLE COMPARATOR C2
;CM3CON0 REGISTER   
		BANKSEL	CM3CON0			;COMPARATOR C3 CONTROL, REGISTER 21-1 (PG.203)
		BCF	CM3CON0, C3ON		;DISABLE COMPARATOR C3
;CM4CON0 REGISTER   
		BANKSEL	CM4CON0			;COMPARATOR C4 CONTROL, REGISTER 21-1 (PG.203)
		BCF	CM4CON0, C4ON		;DISABLE COMPARATOR C4
;PSMC1CON REGISTER		
		BANKSEL PSMC1CON		;PSMC 1 CONTROL, REGISTER 26-1 (PG.265)
		BCF	PSMC1CON, PSMC1EN	;DISABLE PSMC1 MODULE
;PSMC2CON REGISTER		
		BANKSEL PSMC2CON		;PSMC 2 CONTROL, REGISTER 26-1 (PG.265)
		BCF	PSMC2CON, PSMC2EN	;DISABLE PSMC2 MODULE
;PSMC3CON REGISTER		
		BANKSEL PSMC3CON		;PSMC 3 CONTROL, REGISTER 26-1 (PG.265)
		BCF	PSMC3CON, PSMC3EN	;DISABLE PSMC3 MODULE
;PSMC4CON REGISTER		
		BANKSEL PSMC4CON		;PSMC 4 CONTROL, REGISTER 26-1 (PG.265)
		BCF	PSMC4CON, PSMC4EN	;DISABLE PSMC4 MODULE
;A/D SETUP*****************************************		
;ADCON0 REGISTER
		BANKSEL	ADCON0		    ;ADC CONTROL 0, REGISTER 17-1 (PG.177)
		BCF	ADCON0, ADON	    ;DISABLE A/D CONVERTER
;USART SETUP *****************************************************************	
;RCSTA REGISTER:
		BANKSEL RCSTA		;RECEIVE STATUS AND CONTROL, REGISTER 28-2 (PG.355)
		;BCF	RCSTA,CREN	;DISABLE CONTINUOS RECIEVE	
		BCF	RCSTA,SPEN	;DISABLE SERIAL PORT		
;DISABLE TRANSMIT:
		;BANKSEL TXSTA
		;BCF	TXSTA,	TXEN	;DISABLE TRANSMIT		

;***************** PRE PROGRAM SETUP****************	
		
;*** I2C SETUP *****************************************
;SSPADD REGISTER (PERIPHERAL MODE):
		MOVLW	0X14
		BANKSEL SSPADD				;MSSP ADDRESS AND BAUD RATE, REGISTER 27-6 (PG.343)
		MOVWF SSPADD				;ADDRESS OF SERVANT DEVICE 10HEX, BITS 7-1, BIT 0 = DON'T CARE
		
;SSPCON1 REGISTER:					;PERIPHERAL, TRANSMIT MODE
		BANKSEL SSPCON				;SSP CONTROL, REGISTER 27-2 (PG.340)    
		BCF		SSPCON,	WCOL		;WRITE COLLISION DETECT BIT
		BCF		SSPCON,	SSPOV		;RECEIVE OVERFLOW INDICATOR BIT
		BSF		SSPCON,	SSPEN		;ENABLE SYNCHRONUS SERIAL PORT. SETS SDA & SCL PINS AS SERIAL INPUTS
		BSF		SSPCON,	CKP		;ENABLES CLOCK - CLOCK POLARITY SELECT BIT -SERVANT MODE
		BSF		SSPCON,	SSPM3		;SYNCHRONUS SERIAL PORT MODE SELECT BITS
		BSF		SSPCON,	SSPM2		;SET TO SERVANT, 7 BIT ADDRESS 
		BSF		SSPCON,	SSPM1		
		BCF		SSPCON,	SSPM0					
					
;SSPCON2 REGISTER:					
		BANKSEL SSPCON2				;SSP CONTROL 2, REGISTER 27-3 (PG.341)
		BSF		SSPCON2, GCEN		;ENABLE GENERAL CALL INTERRUPT (SERVANT MODE ONLY)
		BCF		SSPCON2, ACKSTAT	;ACKNOWLEDGE STATUS BIT (ACKNOWLEDGE WAS RECEIEVED)
		BCF		SSPCON2, ACKDT		;(IN RECEIVE MODE) ACKNOWLEDGE SEQUENCE IDLE
		BCF		SSPCON2, ACKEN		;ACKNOWLEDGE SEQUENCE ENABLE BIT (MASTER MODE ONLY)
		BCF		SSPCON2, RCEN		;RECEIVE ENABLE BIT (MASTER MODE ONLY)
		BCF		SSPCON2, PEN		;STOP CONDITION ENABLE BIT (MASTER MODE ONLY)
		BCF		SSPCON2, RSEN		;REPEATED START CONDITION ENABLE BIT (MASTER MODE ONLY)
		BSF		SSPCON2, SEN		;ENABLE CLOCK STRETCH -START CONDITION ENABLE		
						
;SSPCON3 REGISTER:
		BANKSEL SSP1CON3			;SSP CONTROL 3, REGISTER 27-4 (PG.342)
		BCF		SSP1CON3, ACKTIM	;ACKNOWLEDGE TIME STATUS BIT
		BCF		SSP1CON3, PCIE		;DISABLE STOP CONDITION INTERRUPT
		BSF		SSP1CON3, SCIE		;ENABLE START CONDITION INTERRUPT 
		BCF		SSP1CON3, BOEN		;DISABLE BUFFER OVERWRITE 
		BCF		SSP1CON3, SDAHT		;100ns SDA HOLD TIME SELECTION
		BCF		SSP1CON3, SBCDE		;DISABLE SERVANT MODE BUS COLLISION DETECT INTERRUPT
		BCF		SSP1CON3, AHEN		;DISABLE ADDRESS HOLDING
		BCF		SSP1CON3, DHEN		;DISABLE DATA HOLDING 
;SSPSTAT REGISTER:
		BANKSEL SSPSTAT			;SSP STATUS, REGISTER 27-1 (PG.338)
		BSF		SSPSTAT, SMP		;SPI DATA INPUT SAMPLE BIT
		BSF		SSPSTAT, CKE		;SPI CLOCK EDGE SELECT BIT (SPI MODE ONLY)
		BCF		SSPSTAT, D_NOT_A	;DATA/!ADDRESS BIT (INDICATES THE FIRST BYTE IS ADDRESS BYTE)
		BCF		SSPSTAT, P		;STOP BIT INDICATOR
		BCF		SSPSTAT, S		;START BIT INDICATOR
		BCF		SSPSTAT, R_NOT_W	;READ/!WRITE BIT INFORMATION 
		BCF		SSPSTAT, UA		;UPDATE ADDRESS BIT (10-BIT I2C MODE ONLY)
		BCF		SSPSTAT, BF		;BUFFER FULL STATUS BIT (RX - NOT COMPLETE, TX- TRANSMIT COMPLETE)	

	
		
;*** INTERRUPTS ON CHANGE SETUP *****************************************		
		
		MOVLW  0x0F
		BANKSEL IOCBP			;INTERRUPT-ON-CHANGE POSITIVE EDGE, REGISTER 14-1 (PG.163)
		MOVWF	IOCBP
		
		MOVLW 0X0F
		BANKSEL IOCBN			;INTERRUPT-ON-CHANGE NEGATIVE EDGE, REGISTER 14-2 (PG.163)
		MOVWF IOCBN
		
;*** SET INTERRUPTS *****************************************		
		BANKSEL PIE1
		BSF PIE1, SSP1IE
		
		BANKSEL INTCON			;INTERRUPT CONTROL, REGISTER 8-1 (PG.97)
		BSF INTCON, IOCIE		;ENABLE INTERRUPTS ON CHANGE
		BSF INTCON, PEIE		;ENALBE PERIPHERAL INTERRUPTS
		BSF INTCON, GIE			;ENABLE ALL UNMASKED INTERRUPTS
		

		
		
		RETURN
		
