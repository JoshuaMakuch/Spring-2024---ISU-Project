;******************************************************************************
;                                                                             *
;    Filename:	    1788_SETUP.INC				              *
;    Date:	    APRIL 1, 2024					      *
;    File Version:  1                                                         *
;    Author:        JOSHUA MAKUCH                                             *
;    Company:       Idaho State University                                    *
;    Description:   FIRMWARE FOR SETTING UP THE PERIPHERAL CONTROLLER FOR     *
;		    DRIVING THE MINIATV					      *
;		                                                              *
;******************************************************************************

;******************************************************************************
;                                                                             *
;    Revision History:                                                        *
;	1: INITIAL FILE TO SETUP A PIC16F1788 SPECIFICS ON SETUP SHOULD BE    *
;	   LISTED HERE AS MODIFIED                                            *
;			         					      *
;					                                      *
;	STARTED APRIL 1, 2024 - CURRENT VERSION IMPLEMENTED		      *
;******************************************************************************	

;******************************************
;DEFINE PERSONAL SFR LOCATIONS
;******************************************
	W_SAVE		    EQU 0X20			;STORESWORKING REGISTER
	STATUS_SAVE	    EQU 0X21			;STORES STATUS REGISTER
	BTN_REG_1	    EQU 0X22			;STORES BUTTON VALUES
	INFO_REG_1	    EQU 0X23			;STORES CUSTOM INDICATORS
	ENCODER_1_CNT	    EQU 0X24			;STORES ENCODER 1 COUNT
	ENCODER_2_CNT	    EQU 0X25			;STORES ENCODER 2 COUNT
	SHRT_TRM_REG	    EQU 0X26			;A REGISTER USED TO TEMPORARILY STORE DATA WHEN NEEDED
	RX_I2C_VAR1	    EQU	0X27			;A REGISTER USED TO STORE I2C VARIABLE 1 DATA
	TESTING_REG	    EQU 0X28			;A REGISTER USED TO KEEP TRACK OF I2C COMS
	    
;******************************************		
;DEFINE PIN / BIT LABELS
;******************************************
SETUP_CODE   CODE		;START OF THE FILE
	    
INITIALIZE
   
;------OSC SETUP  ----------------------------------------------
		BANKSEL	OSCCON				;PG.86
		BCF		OSCCON,	SPLLEN		;SOFTWARE PLL ENABLE BIT
		BSF		OSCCON,	IRCF3		;INTERNAL OSCILLATOR FREQUENCY SELECT BITS
		BSF		OSCCON,	IRCF2		;(SET TO 16 MHz)
		BSF		OSCCON,	IRCF1		
		BSF		OSCCON,	IRCF0		
		BSF		OSCCON,	SCS1		;SYSTEM CLOCK SELECT BITS
		BSF		OSCCON,	SCS0		;(SET TO INTERNAL OSCILLATOR BLOCK)
;------ COMM PINS SETUP ----------------------------------------------
;*******I2C PORT ON RC 3&4, UART ON RC 6&7 FOR CALIBRATION  ******************
		BANKSEL	APFCON1				;PG.132
		BCF		APFCON1, SCKSEL		;0 [SCK = RC3] / 1 [SCK = RB7]
		BCF		APFCON1, SDISEL		;0 [SDA = RC4] / 1 [SDA = RB6]
		BCF		APFCON1, TXSEL		;0 [TX = RC6] / 1 [TX = RB6]
		BCF		APFCON1, RXSEL		;0 [RX = RC7] / 1 [RX = RB7]
		BCF		APFCON1, C2OUTSEL	;0 [C2OUT = RA5] / 1 [C2OUT = RA6]	
		BCF		APFCON1, CCP1SEL	;0 [CCP1 = RC2] / 1 [CCP1 = RB0]
		BCF		APFCON1, SDOSEL		;0 [CCP1 = RC5] / 1 [CCP1 = RB5]
		BCF		APFCON1, CCP2SEL	;0 [CCP2 = RC1] / 1 [CCP2 = RB3]	
;ADCON0 REGISTER
		BANKSEL	ADCON0				;PG.177
		BSF		ADCON0, ADRMD		;SET DATA PRECISION TO 10 BIT
		BCF		ADCON0, ADON		;DISABLE A/D CONVERTER
		BCF		ADCON0, CHS4		;00000 SET A/D CHANNEL TO AN0 (RA0)
		BCF		ADCON0, CHS3	
		BCF		ADCON0, CHS2	
		BCF		ADCON0, CHS1	
		BCF		ADCON0, CHS0		
;ADCON1 REGISTER
		BANKSEL	ADCON1				;PG.178
		BCF		ADCON1, ADFM		;SIGN-MAGNITUDE FORMAT (LEFT JUSTIFIED)
		BSF		ADCON1, ADCS2		;110 A/D CONVERSION CLOCK = FOSC/64 = 4uS
		BSF		ADCON1, ADCS1
		BCF		ADCON1, ADCS0	
		BCF		ADCON1, ADNREF		;VREF- = VSS = GND
		BCF		ADCON1, 1		;VREF+ = VDD = +3.3V	
		BCF		ADCON1, 0	
;ADCON2 REGISTER
		BANKSEL	ADCON2				;PG.179
		BCF		ADCON2, TRIGSEL3	;0000 A/D AUTO TRIG DISABLED	
		BCF		ADCON2, TRIGSEL2
		BCF		ADCON2, TRIGSEL1	
		BCF		ADCON2, TRIGSEL0
		BSF		ADCON2, CHSN3		;1111 A/D NEG DIF CHANNEL BY ADNREF
		BSF		ADCON2, CHSN2
		BSF		ADCON2, CHSN1	
		BSF		ADCON2, CHSN0	
		BCF		ADCON2, GO_NOT_DONE	;ADC CONVERSION DONE
		BCF		ADCON2, ADON		;ADC IS DISABLED
;A/D SETUP ******************************************************************
		
		BANKSEL ANSELA				;PG.137
		CLRF		ANSELA			;SET ALL BITS DIGITAL I/O

		BANKSEL ANSELB				
		CLRF		ANSELB			;SET ALL PORTB TO DIGITAL I/O
		
		BANKSEL ANSELC				
		CLRF		ANSELC			;SET ALL PORTC TO DIGITAL I/O
			
;------ I/O PORT SETUP ------------------------------------------------------
;*** PORT A SETUP **************************************				
		BANKSEL LATA				;PG.136
		CLRF		LATA		    	;CLEARS ALL PORTA LATCHES
		BANKSEL	TRISA		
		MOVLW		0xFF			;SET PORTA AS INPUTS 
		MOVWF		TRISA		
		BANKSEL	WPUA				;DISABLE PORT A WEAK PULLUPS
		MOVLW		0X00
		MOVWF		WPUA		
		BANKSEL	SLRCONA				;SLEWRATE TO MAXIMUM
		CLRF		SLRCONA		
		BANKSEL	INLVLA				;SET INPUT LEVEL TO TTL
		CLRF		INLVLA		
		BANKSEL	ODCONA				;SET PORT A TO PUSH PULL
		CLRF		ODCONA		
;*** PORT B SETUP **************************************			

		BANKSEL LATB				;PG.141   
		CLRF		LATB			;CLEAR PORTB LATCHES
		BANKSEL	TRISB				;PORTB SET TO ALL OUTPUTS
		MOVLW		0x00		
		MOVWF		TRISB		
		BANKSEL	WPUB				;DIABLE ALL PORTB WEAK-PULLUPS
		MOVLW		0X00
		MOVWF		WPUB		
		BANKSEL	SLRCONB				;SLEWRATE TO MAXIMUM
		CLRF		SLRCONB		
		BANKSEL	INLVLB				;SET INPUT LEVEL TO TTL
		CLRF		INLVLB		
		BANKSEL	ODCONB				;SET PORT B TO PUSH PULL 
		CLRF		ODCONB		

;***PORT C SETUP ***************************************
		BANKSEL LATC				;PG.145
		CLRF		LATC			;CLEAR ALL PORTC LATCHES
		BANKSEL	TRISC				;RC0-2 & 5 INPUTS
		MOVLW		B'00111111'		;RC3&4 INPUTS FOR I2C
		MOVWF		TRISC			;RC6-7 OUTPUTS
		BANKSEL	WPUC				;DISABLE WEAK PULLUPS 
		MOVLW		0X00		
		MOVWF		WPUC		
		BANKSEL	SLRCONC				;SLEWRATE TO MAXIMUM
		CLRF		SLRCONC		
		BANKSEL	INLVLC				;SET INPUT LEVEL TO TTL
		CLRF		INLVLC		
		BANKSEL	ODCONC				;SET PORT C TO PUSH PULL
		CLRF		ODCONC	
;*** I2C SETUP *****************************************
;SSPADD REGISTER (MASTER MODE):
		BANKSEL SSPADD				;PG.343
		MOVLW		D'08'		;(IN SLAVE MODE) PERIPHERAL I2C SLAVE ADDRESS (D'08')
		MOVWF		SSPADD
;SSPCON1 REGISTER:
		BANKSEL SSPCON				;PG.340    
		BCF		SSPCON,	WCOL		;WRITE COLLISION DETECT BIT
		BCF		SSPCON,	SSPOV		;RECEIVE OVERFLOW INDICATOR BIT
		BSF		SSPCON,	SSPEN		;SYNCHRONUS SERIAL PORT ENABLE BIT. SETS SDA & SCL PINS AS SERIAL INPUTS
		BSF		SSPCON,	CKP		;CLOCK POLARITY SELECT BIT (UNUSED IN MASTER I2C)
		BCF		SSPCON,	SSPM3		;SYNCHRONUS SERIAL PORT MODE SELECT BITS
		BSF		SSPCON,	SSPM2		;SET TO I2C SLAVE MODE, 7-BIT ADDRESS
		BSF		SSPCON,	SSPM1		
		BCF		SSPCON,	SSPM0		
;SSPCON2 REGISTER:					
		BANKSEL SSPCON2				;PG.341
		BSF		SSPCON2, GCEN		;GENERAL CALL INTERRUPT ENABLE BIT (SLAVE MODE ONLY)
		BCF		SSPCON2, ACKSTAT	;ACKNOWLEDGE STATUS BIT (ACKNOWLEDGE WAS RECEIEVED)
		BCF		SSPCON2, ACKDT		;(IN RECEIVE MODE) ACKNOWLEDGE SEQUENCE IDLE
		BCF		SSPCON2, ACKEN		;ACKNOWLEDGE SEQUENCE ENABLE BIT (MASTER MODE ONLY)
		BCF		SSPCON2, RCEN		;RECEIVE ENABLE BIT (MASTER MODE ONLY)
		BCF		SSPCON2, PEN		;STOP CONDITION ENABLE BIT (MASTER MODE ONLY)
		BCF		SSPCON2, RSEN		;REPEATED START CONDITION ENABLE BIT (MASTER MODE ONLY)
		BSF		SSPCON2, SEN		;START CONDITION ENABLE/STRECTH ENABLE BIT
;SSPCON3 REGISTER:
		BANKSEL SSP1CON3			;PG.342
		BCF		SSP1CON3, ACKTIM	;ACKNOWLEDGE TIME STATUS BIT
		BCF		SSP1CON3, PCIE		;STOP CONDITION INTERRUP ENABLE BIT
		BCF		SSP1CON3, SCIE		;START CONDITION INTERRUPT ENBLE BIT
		BCF		SSP1CON3, BOEN		;BUFFER OVERWRITE ENABLE BIT
		BCF		SSP1CON3, SDAHT		;SDA HOLD TIME SELECTION BIT
		BCF		SSP1CON3, SBCDE		;SLAVE MODE BUS COLLISION DETECT ENABLE BIT
		BCF		SSP1CON3, AHEN		;ADDRESS HOLD ENABLE BIT
		BCF		SSP1CON3, DHEN		;DATA HOLD ENABLE BIT
;SSPSTAT REGISTER:
		BANKSEL SSPSTAT				;PG.338
		BCF		SSPSTAT, SMP		;SPI DATA INPUT SAMPLE BIT
		BCF		SSPSTAT, CKE		;SPI CLOCK EDGE SELECT BIT (SPI MODE ONLY)
		BSF		SSPSTAT, D_NOT_A	;DATA/!ADDRESS BIT (INDICATES THE FIRST BYTE IS ADDRESS BYTE)
		BCF		SSPSTAT, P		;STOP BIT INDICATOR
		BCF		SSPSTAT, S		;START BIT INDICATOR
		BCF		SSPSTAT, R_NOT_W	;READ/!WRITE BIT INFORMATION 
		BCF		SSPSTAT, UA		;UPDATE ADDRESS BIT (10-BIT I2C MODE ONLY)
		BCF		SSPSTAT, BF		;BUFFER FULL STATUS BIT (RX - NOT COMPLETE, TX- TRANSMIT COMPLETE)
;*** USART SETUP ***************************************
;BAUDRATE REGISTERS:		
		BANKSEL BAUDCTL				;PG.356
		BCF		BAUDCTL, ABDOVF		;AUTO-BAUD 0DETECT OVERFLOW BIT (DID NOT OVERFLOW)
		BSF		BAUDCTL, RCIDL		;RECEIVED IDLE FLAG BIT (RECEIVER IS IDLE)
		BCF		BAUDCTL, SCKP		;SYNCHRONUS CLCK POLRAITY BIT (TRANSMIT NON-INVERTED DATA TO RC6/TX/CK)
		BSF		BAUDCTL, BRG16		;8-BIT BAUD RATE GENERATOR USED
		BCF		BAUDCTL, WUE		;WAKEUP ENABLE BIT (OPERATING NORMALLY)
		BCF		BAUDCTL, ABDEN		;AUTO-BAUD DETECT ENABLE BIT (DISABLED)
;SPBRG REGISTER:
		BANKSEL SPBRG				;PG.357
		MOVLW		D'034'	    		;SET SERIAL BAUD RATE (114286.71)
		MOVWF	    	SPBRG
;TXSTA REGISTER :
		BANKSEL TXSTA				;PG.354
		BCF		TXSTA, CSRC		;CLOCK SOURCE SELECT BIT (SLAVE MODE)
		BCF		TXSTA, TX9		;9-BIT TRANSMIT DISABLE
		BSF		TXSTA, TXEN		;TRANSMIT ENABLE BIT
		BCF		TXSTA, SYNC		;EUSART MODE SELECT BIT (1 = SYNCHRONUS)
		BCF		TXSTA, SENDB		;SEND BREAK CHARACTER BIT
		BSF		TXSTA, BRGH		;UNUSED IN SYNCHRONUS 
		BSF		TXSTA, TRMT		;TRANSMIT SHIFT REGISTER STATUS BIT (TSR EMPTY)
		BCF		TXSTA, TX9D		;NINTH-BIT OF TRANSMIT DATA
;RCSTA REGISTER :
		BANKSEL RCSTA				;PG.355
		BCF		RCSTA, SPEN		;DISABLE SERIAL PORT
		BCF		RCSTA, RX9		;SETS TO 8 BIT RECEPTION
		BCF		RCSTA, SREN		;SINGLE RECEIVE ENABLE BIT (MASTER -> DISABLE SINGLE BIT)
		BSF		RCSTA, CREN		;ENABLE CONTINUOUS RECIEVE
		BCF		RCSTA, ADDEN		;ADDRESS DETECT BIT (8-BIT DOESN'T CARE)
		BCF		RCSTA, FERR		;FRAMING ERROR BIT
		BCF		RCSTA, OERR		;OVERRUN ERROR BIT
		BCF		RCSTA, RX9D		;NINTH-BIT OF RECEIVE DATA
;MISC SETUP ******************************************************************
;OPTION_REG REGISTER: 
		BANKSEL OPTION_REG			;PG.208
		BCF		OPTION_REG, PS0		;\\
		BCF		OPTION_REG, PS1		; >>PRESCALER RATIO SET 1:1
		BCF		OPTION_REG, PS2		;//
		BSF		OPTION_REG, PSA		;PRESCALER ASSIGNED TO WDT 
		BCF		OPTION_REG, T0SE	;TMR0 EDGE SET RISING
		BCF		OPTION_REG, T0CS	;TMR0 CLOCK SET TO INTERNAL
		BSF		OPTION_REG, INTEDG	;RB0/INT SET TO RISING EDGE
		BCF		OPTION_REG, 7		;PULLUPS SET TO INDIVIDUALLY EN.
;INTCON REGISTER:
		BANKSEL INTCON				;PG.97
		BCF		INTCON, INTE		;DISABLE RB0/INT EXT INTERRUPT
		BCF		INTCON, TMR0IE		;DISABLE TMR0 INTERRUPT
		BCF		INTCON, PEIE		;DISABLE PERIPHERAL INTERRUPTS...FOR NOW... ;)
		BCF		INTCON, GIE		;DISABLE ALL UNMASKED INTERRUPTS...FOR NOW... ;)
;PIE1 REGISTER: 
		BANKSEL PIE1				;PG.98
		BCF		PIE1, TMR1IE		;DISABLE TMR1 INTERRUPT
		BCF		PIE1, TMR2IE		;DISABLE TMR2 INTERRUPT
		BCF		PIE1, CCP1IE		;DISABLE CCP1 INTERRUPT
		BCF		PIE1, SSP1IE		;DISABLE SSP INTERRUPT...FOR NOW... ;)
		BCF		PIE1, TXIE		;DISABLE USART TX INTERRUPT
		BCF		PIE1, RCIE		;DISABLE USART RX INTERRUPT
 		BCF		PIE1, ADIE		;DISABLE A/D INTERRUPT
		BCF		PIE1, 7			;DISABLE PSP INTERRUPT
;PIE2 REGISTER:
		BANKSEL	PIE2				;PG.99
		BCF		PIE2, CCP2IE		;DISABLE THE CCP2 INTERRUPT
		BCF		PIE2, BCL1IE		;DISABLE BUS COLLISION INTERRUPT
		BCF		PIE2, EEIE		;DISABLE EEPROM WRITE INTERRUPT
;T1CON REGISTER:
		BANKSEL	T1CON				;PG.217
		BCF		T1CON, TMR1ON		;DISABLE TIMER 1
;T2CON REGISTER:  
		BANKSEL	T2CON				;PG.222
		BCF		T2CON, T2OUTPS0		;\
		BCF		T2CON, T2OUTPS1		; \ TIMER 2 POSTSCALER
		BCF		T2CON, T2OUTPS2		; / '0000' POSTSCALER = 1:1
		BCF		T2CON, T2OUTPS3		;/
		BCF		T2CON, TMR2ON		;DIS. TIMER 2/ ENABLED AS NEEDED
		BCF		T2CON, T2CKPS0		;\ '01' PRESCALE VALUE = 1:4
		BSF		T2CON, T2CKPS1		;/
;PR2 REGISTER:  (HOLDS COMPARISON VALUE FOR TIMER INTERUPT)
		BANKSEL	PR2
		MOVLW		D'010'			;T2 INTERVAL = 10 uS
		MOVWF		PR2
;CCP1CON REGISTER:
		BANKSEL	CCP1CON
		BCF		CCP1CON, CCP1M0	
		BCF		CCP1CON, CCP1M1		; >CAPTURE/COMPARE/PWM DISABLED
		BCF		CCP1CON, CCP1M2	
		BCF		CCP1CON, CCP1M3	
;CCP2CON REGISTER:
		BANKSEL	CCP2CON
		BCF		CCP2CON, CCP2M0	
		BCF		CCP2CON, CCP2M1		;>CAPTURE/COMPARE/PWM DISABLED
		BCF		CCP2CON, CCP2M2	
		BCF		CCP2CON, CCP2M3	
;*** PRE-MAIN SETUP ************************************
		BANKSEL PORTA
		CLRF		PORTA
		CLRF		PORTB
		CLRF		PORTC
		
		BANKSEL INFO_REG_1
		CLRF		INFO_REG_1
		CLRF		ENCODER_1_CNT
		CLRF		ENCODER_2_CNT
		CLRF		RX_I2C_VAR1
		    
		BANKSEL INTCON				;THIS PORTION ENSURES WORKS ONLY AFTER SETUP
		BSF		INTCON, PEIE		;ENABLE PERIPHERAL INTERRUPTS
		BSF		INTCON, GIE		;ENABLE ALL UNMASKED INTERRUPTS
		BANKSEL PIE1
		BSF		PIE1, SSP1IE		;ENABLE SSP INTERRUPTS
		BANKSEL PIR1
		BCF		PIR1, SSP1IF		;CLEAR I2C INTERRUPT FLAG IN CASE IT WAS TOGGLED IN SETUP
		
		RETURN
		
