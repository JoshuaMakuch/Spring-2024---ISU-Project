;******************************************************************************
;                                                                             *
;    Filename:	    1788_SETUP.INC				              *
;    Date:	    JULY 20 2023                                              *
;    File Version:  1                                                         *
;    Author:        Shane Slack                                               *
;    Company:       Idaho State University                                    *
;    Description:   Firmware for Seting up a PIC16F1788			      *
;		                                                              *
;******************************************************************************

;******************************************************************************
;                                                                             *
;    Revision History:                                                        *
;	1: INITIAL FILE TO SETUP A PIC16F1788 SPECIFICS ON SETUP SHOULD BE    *
;	   LISTED HERE AS MODIFIED                                            *
;	    STARTED July 20 2023 - CURRENT VERSION IMPLEMENTED August 26,2023 *
;									      *
;                                                                             *
;******************************************************************************

    
 
    


		
		
		
;******************************************
;DEFINE CONSTANTS
;******************************************
;I2C_ADD	EQU	D'90'		;USE TEST ADDRESS
SBAUDVAL	EQU	D'25'		;SET SERIAL BAUD RATE 9600 W/16M OSC
HALF_SEC	EQU	D'240'		;PR2 VALUE TO RUN 1 SECOND

	
	
;******************************************		
;DEFINE PIN / BIT LABELS
;******************************************

	
	
		
SETUP_CODE   CODE		;START OF THE FILE
	    
INITIALIZE
   
;------OSC SETUP  ----------------------------------------------
		BANKSEL	OSCCON		;PAGE 86
		BCF	OSCCON,	0	;TIMER 1 OSC
		BSF	OSCCON,	1	;INTERNAL OSC
		BCF	OSCCON,	2	;UNUSED 
		BSF	OSCCON,	3	;INTERNAL OSCILLATOR SELECT BITS 
		BSF	OSCCON,	4	;///
		BCF	OSCCON,	5	;//
		BSF	OSCCON,	6	;/
		BCF	OSCCON,	7	;PLL ENABLE BIT
		
		
;------ COMM PINS SETUP ----------------------------------------------
;*******I2C PORT ON RC 3&4, UART ON RB 6&7 FOR CALIBRATION  ******************
		BANKSEL	APFCON1		    ;PAGE 132
		BCF	APFCON1, SCKSEL	    ;0 [SCK = RC3] / 1 [SCK = RB7]
		BCF	APFCON1, SDISEL	    ;0 [SDA = RC4] / 1 [SDA = RB6]
		BCF	APFCON1, TXSEL	    ;0 [TX = RC6] / 1 [TX = RB6]
		BCF	APFCON1, RXSEL	    ;0 [RX = RC7] / 1 [RX = RB7]
		BCF	APFCON1, C2OUTSEL   ;0 [C2OUT = RA5] / 1 [C2OUT = RA6]	
		BCF	APFCON1, CCP1SEL    ;0 [CCP1 = RC2] / 1 [CCP1 = RB0]
		BCF	APFCON1, SDOSEL	    ;0 [CCP1 = RC5] / 1 [CCP1 = RB5]
		BCF	APFCON1, CCP2SEL    ;0 [CCP2 = RC1] / 1 [CCP2 = RB3]

;*****ADC SETUP****		
;ADCON0 REGISTER

		BANKSEL	ADCON0
		BCF	ADCON0, ADRMD	;SET DATA PRECISION TO 10 BIT
		BCF	ADCON0, ADON	;DISABLE A/D CONVERTER
		BCF	ADCON0, CHS0	;00011 SET A/D CHANNEL TO 1
		BCF	ADCON0, CHS1	;
		BCF	ADCON0, CHS2	;
		BCF	ADCON0, CHS3	;
		BCF	ADCON0, CHS4	;			
;ADCON1 REGISTER
		BANKSEL	ADCON1
		
		BCF	ADCON1, ADCS0	
		BSF	ADCON1, ADCS1	;111 A/D CONVERSION CLOCK = FOSC/32
		BCF	ADCON1, ADCS2	
		
		BCF	ADCON1, ADFM	;SIGN MAGNITUDE DATA METHOD(IS L-JUST)
		
		BCF	ADCON1, ADNREF	;VREF- = VSS
		
		BCF	ADCON1, 0	;00 VREF+ = VDD		
		BCF	ADCON1, 1		
;ADCON2 REGISTER
		BANKSEL	ADCON2
		
		BCF	ADCON2, TRIGSEL0	
		BCF	ADCON2, TRIGSEL1 ;0000 A/D AUTO TRIG DISABLED
		BCF	ADCON2, TRIGSEL2	
		BCF	ADCON2, TRIGSEL3
		
		BSF	ADCON2, CHSN0	
		BSF	ADCON2, CHSN1	;1111 A/D NEG DIF CHANNEL BY ADNREF
		BSF	ADCON2, CHSN2	
		BSF	ADCON2, CHSN3	
;**** END ADC SETTUP****
		
		
;ANALOG SELECT REGISTER FOR PORT A AND B SETUP *******************************
		
		BANKSEL ANSELA
		CLRF	ANSELA		;SET ALL PORTA TO DIGITAL I/O

		BANKSEL ANSELB
		CLRF	ANSELB		;SET ALL PORTB TO DIGITAL I/O
		
;------ I/O PORT SETUP ------------------------------------------------------
;* PORT A SETUP    RA1-3 ARE TO BE USED AS ANALOG INPUTS
		BANKSEL LATA
		CLRF	LATA
		BANKSEL	TRISA		;
		MOVLW	0x00		;SET PORTA AS INPUTS 
		MOVWF	TRISA		
		BANKSEL	WPUA
		MOVLW	0X00
		MOVWF	WPUA		;DISABLE PORT A WEAK PULLUPS
		BANKSEL	SLRCONA
		CLRF	SLRCONA		;SLEWRATE TO MAXIMUM
		BANKSEL	INLVLA
		CLRF	INLVLA		;SET INPUT LEVEL TO TTL
		BANKSEL	ODCONA
		CLRF	ODCONA		;SET PORT A TO PUSH PULL
		
;* PORT B SETUP				USED FOR DEBUG LEDS ALL PORT PINS
		BANKSEL LATB		;\RB6 & 7 CAN BE USED AS SERIAL    
		CLRF	LATB		; >COM PORT, INDICATORS, OR TESTPOINTS 
		BANKSEL	TRISB		;/THROUGH ICSP PORT
		MOVLW	0x00		;PORT B DEBUG LEDs OUTPUTs
		MOVWF	TRISB		;RB6 TX & RB7 RX
		BANKSEL	WPUB
		MOVLW	0X00
		MOVWF	WPUB		;DISABLE PORT B WEAK PULLUPS
		BANKSEL	SLRCONB
		CLRF	SLRCONB		;SLEWRATE TO MAXIMUM
		BANKSEL	INLVLB
		CLRF	INLVLB		;SET INPUT LEVEL TO TTL
		BANKSEL	ODCONB
		CLRF	ODCONB		;SET PORT B TO PUSH PULL 

;PORT C SETUP
		BANKSEL LATC
		CLRF	LATC		;
		BANKSEL	TRISC		;RC3&4 INPUT FOR I2C
		MOVLW	0xFF		;RC0-2 OUTPUTS		
		MOVWF	TRISC		;RC6 TX & RC7 RX
		
		BANKSEL	WPUC
		MOVLW	0X00		;DISABLE WEAK PULLUPS 
		MOVWF	WPUC		;
		
		BANKSEL	SLRCONC
		CLRF	SLRCONC		;SLEWRATE TO MAXIMUM
		BANKSEL	INLVLC
		CLRF	INLVLC		;SET INPUT LEVEL TO TTL
		BANKSEL	ODCONC
		CLRF	ODCONC		;SET PORT C TO PUSH PULL

;USART SETUP *****************************************************************	
;BAUDRATE REGISTERS 		
		BANKSEL	BAUDCON
		BCF	BAUDCON, BRG16	;SET BAUDRATE GENERATOR TO 8 BIT

		BANKSEL TXSTA
		BCF	TXSTA,	BRGH	;SET BRGH TO HIGH SPEED
		BCF	TXSTA,	SYNC	;SET SYNC TO ASYNCH MODE
		BCF	TXSTA,	TX9	;SET TO 8 BIT TRANSMISSION

	
;SPBRG REGISTER 
		BANKSEL SPBRG
		MOVLW	SBAUDVAL	;SET SERIAL BAUD RATE
		MOVWF	SPBRG

;TXSTA REGISTER 

		

;RCSTA REGISTER 
		BANKSEL RCSTA
		BSF	RCSTA,CREN	;ENABLE CONTINUOS RECIEVE
		BCF	RCSTA,RX9	;SET 8 BIT RECEPTION		
		BSF	RCSTA,SPEN	;ENABLE SERIAL PORT

;ENABLE TRANSMIT
		BANKSEL TXSTA
		BSF	TXSTA,	TXEN	;ENABLE TRANSMIT		
		
;MISC SETUP ******************************************************************
;OPTION_REG REGISTER 
		BANKSEL OPTION_REG	;PAGE 208
		BCF	OPTION_REG, PS0	;\\
		BCF	OPTION_REG, PS1	; >>PRESCALER RATIO SET 1:1
		BCF	OPTION_REG, PS2	;//
		BSF	OPTION_REG, PSA	;PRESCALER ASSIGNED TO WDT 
		BCF	OPTION_REG, 4	;TMR0 EDGE SET RISING
		BCF	OPTION_REG, 5	;TMR0 CLOCK SET TO INTERNAL
		BSF	OPTION_REG, INTEDG	;RB0/INT SET TO RISING EDGE
		BCF	OPTION_REG, 7	;PULLUPS SET TO INDIVIDUALLY EN.
		
;INTCON REGISTER 
		BANKSEL INTCON		;PAGE 97
		
		BCF	INTCON, INTE	;DISABLE RB0/INT EXT INTERRUPT
		BCF	INTCON, TMR0IE	;DISABLE TMR0 INTERRUPT
		BCF	INTCON, PEIE	;DISABLE PERIPHERAL INTERRUPTS
		BCF	INTCON, GIE	;DISABLE ALL UNMASKED INTERRUPTS
		
;PIE1 REGISTER 
		BANKSEL PIE1		;PAGE 98
		BCF	PIE1, TMR1IE	;DISABLE TMR1 INTERRUPT
		BCF	PIE1, TMR2IE	;DISABLE TMR2 INTERRUPT
		BCF	PIE1, CCP1IE	;DISABLE CCP1 INTERRUPT
		BCF	PIE1, SSP1IE	;DISABLE SSP INTERRUPT
		BCF	PIE1, TXIE	;DISABLE USART TX INTERRUPT
		BCF	PIE1, RCIE	;DISABLE USART RX INTERRUPT
 		BCF	PIE1, ADIE	;DISABLE A/D INTERRUPT
		BCF	PIE1, 7		;DISABLE PSP INTERRUPT
	
;PIE2 REGISTER
		BANKSEL	PIE2
		BCF	PIE2,	CCP2IE	;DISABLE THE CCP2 INTERRUPT
		BCF	PIE2,	C3IE	;DISABLE CMPARITOR3 ENABLE BIT
		BCF	PIE2,	C4IE	;DISABLE CMPARITOR4 ENABLE BIT
		BCF	PIE2,	BCL1IE	;DISABLE BUS COLLISION INTERRUPT
		BCF	PIE2,	EEIE	;DISABLE EEPROM WRITE INTERRUPT
		BCF	PIE2,	C1IE	;DISABLE CMPARITOR1 ENABLE BIT
		BCF	PIE2,	C2IE	;DISABLE CMPARITOR2 ENABLE BIT
		BCF	PIE2,	OSFIF	;OSCILLATOR FAIL INTERRUPT ENABLE BIT 
		
;T1CON REGISTER 
		BANKSEL	T1CON
		BCF	T1CON, TMR1ON	;DISABLE TIMER 1
		BCF	T1CON, T1OSCEN	;OSCILLATOR IS SHUT OFF
		BCF	T1CON, T1CKPS1	;00 1:1 PRESCALE VALUE
		BCF	T1CON, T1CKPS0	

;***  TIMER 2 SETUP,  USED TO CONTROL A/D CONVERTER CYCLE TIME
;T2CON REGISTER   
		BANKSEL	T2CON
		BSF	T2CON, T2OUTPS0	;\
		BSF	T2CON, T2OUTPS1 ; \ TIMER 2 POSTSCALER
		BSF	T2CON, T2OUTPS2 ; / '0111' POSTSCALER = 1:8
		BCF	T2CON, T2OUTPS3 ;/
		BCF	T2CON, TMR2ON 	;DIS. TIMER 2/ ENABLED AS NEEDED
		BSF	T2CON, T2CKPS0	;\ 11 PRESCALE VALUE IS 64
		BSF	T2CON, T2CKPS1	;/
		
;PR2 REGISTER  HOLDS COMPARISON VALUE FOR TIMER INTERUPT
		
		MOVLW	HALF_SEC	;VALUE SET IN DEF OF CONSTATNTS 
		BANKSEL	PR2
		MOVWF	PR2

;CCP1CON REGISTER
		BANKSEL	CCP1CON
		BCF	CCP1CON, CCP1M0	
		BCF	CCP1CON, CCP1M1	; >CAPTURE/COMPARE/PWM DISABLED
		BCF	CCP1CON, CCP1M2	
		BCF	CCP1CON, CCP1M3	
		
;CCP2CON REGISTER 
		BANKSEL	CCP2CON
		BCF	CCP2CON, CCP2M0	
		BCF	CCP2CON, CCP2M1	;>CAPTURE/COMPARE/PWM DISABLED
		BCF	CCP2CON, CCP2M2	
		BCF	CCP2CON, CCP2M3	
		
		
		RETURN