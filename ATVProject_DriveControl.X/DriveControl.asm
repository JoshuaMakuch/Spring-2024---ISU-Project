;******************************************************************************
;                                                                             *
;    Filename:	    DriveControl.asm			                      *
;    Date:	    November, 27, 2023                                        *
;    File Version:  1                                                         *
;    Author:        Baden Brenner                                             *
;    Company:       Idaho State University                                    *
;    Description:   code for the 1788 to contorl the drive function of the atv*
;		                                                              *
;******************************************************************************
;******************************************************************************
;                                                                             *
;									      *
;                                                                             *
;******************************************************************************
	
	LIST	    p=16F1788
	INCLUDE	    p16f1788.INC
	
	; CONFIG1
; __config 0xEFE4
 __CONFIG _CONFIG1, _FOSC_INTOSC & _WDTE_OFF & _PWRTE_OFF & _MCLRE_ON & _CP_OFF & _CPD_OFF & _BOREN_OFF & _CLKOUTEN_OFF & _IESO_OFF & _FCMEN_OFF
; CONFIG2
; __config 0xFFFF
 __CONFIG _CONFIG2, _WRT_OFF  & _PLLEN_OFF & _STVREN_ON & _BORV_LO & _LPBOR_OFF & _LVP_OFF

    ;suppress "not in bank 0" message,  Found label after column 1,
    errorlevel -302,-207,-305,-206,-203	
;******************************************
;DEFINE PERSONAL SFR LOCATIONS
;******************************************
		EQU H'0020'		;UNUSED
		EQU H'0021'		;UNUSED
		EQU H'0022'		;UNUSED
		EQU H'0023'		;UNUSED
ADSAVE		EQU H'0024'		;REGISTER FOR A/D DATA
ADCOUNT		EQU H'0025'		;ADITIONAL REGISTER FOR SAVING THE ADC DATA 
W_SAVE		EQU H'0026'		;REGISTER FOR STORING WORKING REGISTER
STATUS_SAVE	EQU H'0027'		;REGISTER FOR STORING STATUS REGISTER
		EQU H'0028'		;UNUSED
TURN_DATA	EQU H'0029'		;VARIBLE REGISTER TO SAVE THE TURN DATA 
SAVEDATA3	EQU H'002A'		;REGISTER FOR SAVEING INPUT I2C DATA
BYTEIND		EQU H'002B'		;INDICATORS FOR HANDLING RECEVED DATA 
FORWARD_DATA	EQU H'002C'		;USED TO HOLD DATA TO CALL THE TABLE FOR FORWARD 
REVERCE_DATA	EQU H'002D'		;USED TO HOLD DATA TO CALL THE TABLE FOR REVERCE
DRIVE_DATA	EQU H'002E'		;USED TO HOLD LOADED DRIVE DATA FROM THE TABLE 
STERING_DATA	EQU H'002F'		;USED TO HOLD LOADED DRIVE DATA FROM THE TABLE 
;******************************************		
;INTERUPT VECTORS
;******************************************
		ORG 	H'000'					
 		GOTO 	SETUP		;RESET CONDITION GOTO SETUP
		ORG	H'004'
		GOTO	INTERUPT	;INTERUPT CONDITION
		
		ORG	H'006'		;LOCK THE TABLE TO THE BEGINING OF THE MEMORY
					;TO PREVENT CRASHING 
TABLE_FORWARD
		BANKSEL	PCL				;TABLE TO SCALE FORWARD VALUE
		ADDWF	PCL,1	
		RETLW	0X16
		RETLW	0X16
		RETLW	0X16
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		RETLW	0X0B	
TABLE_REVERSE
		BANKSEL	PCL				;TABLE TO SCALE REVERSE VALUE
		ADDWF	PCL,1
		RETLW	0X18
		RETLW	0X18
		RETLW	0X18
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		RETLW	0X25	
TABLE_TURN		
		BANKSEL	PCL				;TABLE TO SCALE STERING VALUE
		ADDWF	PCL,1
		RETLW	0X27
		RETLW	0X24
		RETLW	0X22
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		RETLW	0X09
SETUP
;******************************************		
;DEFINE PIN / BIT LABELS
;******************************************
;------OSC SETUP  ----------------------------------------------
		BANKSEL	OSCCON		;PAGE 86
		BCF	OSCCON,	0	;TIMER 1 OSC
		BSF	OSCCON,	1	;INTERNAL OSC
		BCF	OSCCON,	2	;UNUSED 
		BSF	OSCCON,	3	;INTERNAL OSCILLATOR SELECT BITS 
		BSF	OSCCON,	4	;///
		BCF	OSCCON,	5	;//
		BSF	OSCCON,	6	;/
		BCF	OSCCON,	7	;PLL ENABLE BIT
		
		
;------ COMM PINS SETUP ----------------------------------------------
;*******I2C PORT ON RC 3&4, UART ON RB 6&7 FOR CALIBRATION  ******************
		BANKSEL	APFCON1		    ;PAGE 132
		BCF	APFCON1, SCKSEL	    ;0 [SCK = RC3] / 1 [SCK = RB7]
		BCF	APFCON1, SDISEL	    ;0 [SDA = RC4] / 1 [SDA = RB6]
		BCF	APFCON1, TXSEL	    ;0 [TX = RC6] / 1 [TX = RB6]
		BCF	APFCON1, RXSEL	    ;0 [RX = RC7] / 1 [RX = RB7]
		BCF	APFCON1, C2OUTSEL   ;0 [C2OUT = RA5] / 1 [C2OUT = RA6]	
		BCF	APFCON1, CCP1SEL    ;0 [CCP1 = RC2] / 1 [CCP1 = RB0]
		BCF	APFCON1, SDOSEL	    ;0 [CCP1 = RC5] / 1 [CCP1 = RB5]
		BCF	APFCON1, CCP2SEL    ;0 [CCP2 = RC1] / 1 [CCP2 = RB3]
		

		BANKSEL	APFCON2
		CLRF	APFCON2
;*****ADC SETUP****		
;ADCON0 REGISTER

		BANKSEL	ADCON0
		BSF	ADCON0, ADON	;DISABLE A/D CONVERTER
		BSF	ADCON0,	1	;ADC CONVERSION STATUS BIT 
		BCF	ADCON0, CHS0	;0000O SET A/D CHANNEL TO AN0
		BCF	ADCON0, CHS1	;
		BCF	ADCON0, CHS2	;
		BCF	ADCON0, CHS3	;
		BCF	ADCON0, CHS4	;			
		BSF	ADCON0, ADRMD	;SET DATA PRECISION TO 10 BIT
		
;ADCON1 REGISTER
		BANKSEL	ADCON1
		
		BCF	ADCON1, ADCS0	
		BCF	ADCON1, ADCS1	;111 A/D CONVERSION CLOCK = FOSC/32
		BCF	ADCON1, ADCS2	
		
		BCF	ADCON1, ADFM	;SIGN MAGNITUDE DATA METHOD(IS L-JUST)
		
		BCF	ADCON1, ADNREF	;VREF- = VSS
		
		BCF	ADCON1, 0	;00 VREF+ = VDD		
		BCF	ADCON1, 1		
;ADCON2 REGISTER
		BANKSEL	ADCON2
		
		BCF	ADCON2, TRIGSEL0	
		BCF	ADCON2, TRIGSEL1 ;0000 A/D AUTO TRIG DISABLED
		BCF	ADCON2, TRIGSEL2	
		BCF	ADCON2, TRIGSEL3
		
		BSF	ADCON2, CHSN0	
		BSF	ADCON2, CHSN1	;1111 A/D NEG DIF CHANNEL BY ADNREF
		BSF	ADCON2, CHSN2	
		BSF	ADCON2, CHSN3	
;**** END ADC SETTUP****
		
		
;ANALOG SELECT REGISTER FOR PORT A AND B SETUP *******************************
		
		BANKSEL ANSELA
		CLRF	ANSELA		;SET ALL PORTA TO DIGITAL I/O

		BANKSEL ANSELB
		CLRF	ANSELB		;SET ALL PORTB TO DIGITAL I/O
		
;------ I/O PORT SETUP ------------------------------------------------------
;* PORT A SETUP    RA1-3 ARE TO BE USED AS ANALOG INPUTS
		BANKSEL LATA
		CLRF	LATA
		BANKSEL	TRISA		;
		MOVLW	0xFF		;SET PORTA AS INPUTS 
		MOVWF	TRISA		
		BANKSEL	WPUA
		MOVLW	0X00
		MOVWF	WPUA		;DISABLE PORT A WEAK PULLUPS
		BANKSEL	SLRCONA
		CLRF	SLRCONA		;SLEWRATE TO MAXIMUM
		BANKSEL	INLVLA
		CLRF	INLVLA		;SET INPUT LEVEL TO TTL
		BANKSEL	ODCONA
		CLRF	ODCONA		;SET PORT A TO PUSH PULL
		
;* PORT B SETUP				USED FOR DEBUG LEDS ALL PORT PINS
		BANKSEL LATB		;\RB6 & 7 CAN BE USED AS SERIAL    
		CLRF	LATB		; >COM PORT, INDICATORS, OR TESTPOINTS 
		BANKSEL	TRISB		;/THROUGH ICSP PORT
		MOVLW	0x00		;PORT B DEBUG LEDs OUTPUTs
		MOVWF	TRISB		;RB6 TX & RB7 RX
		BANKSEL	WPUB
		MOVLW	0X00
		MOVWF	WPUB		;DISABLE PORT B WEAK PULLUPS
		BANKSEL	SLRCONB
		CLRF	SLRCONB		;SLEWRATE TO MAXIMUM
		BANKSEL	INLVLB
		CLRF	INLVLB		;SET INPUT LEVEL TO TTL
		BANKSEL	ODCONB
		CLRF	ODCONB		;SET PORT B TO PUSH PULL 

;PORT C SETUP
		BANKSEL LATC
		CLRF	LATC		;
		BANKSEL	TRISC		;RC3&4 INPUT FOR I2C
		MOVLW	B'00011000'	;RC0-2 OUTPUTS		
		MOVWF	TRISC		;RC6 TX & RC7 RX
		
		BANKSEL	WPUC
		MOVLW	0X00		;DISABLE WEAK PULLUPS 
		MOVWF	WPUC		;
		
		BANKSEL	SLRCONC
		CLRF	SLRCONC		;SLEWRATE TO MAXIMUM
		BANKSEL	INLVLC
		CLRF	INLVLC		;SET INPUT LEVEL TO TTL
		BANKSEL	ODCONC
		CLRF	ODCONC		;SET PORT C TO PUSH PULL

;USART SETUP *****************************************************************	
;BAUDRATE REGISTERS 		
		BANKSEL	BAUDCON
		BCF	BAUDCON, BRG16	;SET BAUDRATE GENERATOR TO 8 BIT

		BANKSEL TXSTA
		BCF	TXSTA,	BRGH	;SET BRGH TO HIGH SPEED
		BCF	TXSTA,	SYNC	;SET SYNC TO ASYNCH MODE
		BCF	TXSTA,	TX9	;SET TO 8 BIT TRANSMISSION

	
;SPBRG REGISTER 
		BANKSEL SPBRG
		MOVLW	H'0F'	;SET SERIAL BAUD RATE
		MOVWF	SPBRG

;TXSTA REGISTER 
		BANKSEL TXSTA				;PG.354
		BSF		TXSTA, CSRC		;CLOCK SOURCE SELECT BIT (MASTER MODE)
		BSF		TXSTA, TX9		;9-BIT TRANSMIT ENABLE
		BCF		TXSTA, TXEN		;TRANSMIT ENABLE BIT
		BSF		TXSTA, SYNC		;EUSART MODE SELECT BIT (1 = SYNCHRONUS)
		BCF		TXSTA, SENDB		;SEND BREAK CHARACTER BIT
		BCF		TXSTA, BRGH		;UNUSED IN SYNCHRONUS 
		BSF		TXSTA, TRMT		;TRANSMIT SHIFT REGISTER STATUS BIT (TSR EMPTY)
		BCF		TXSTA, TX9D		;NINTH-BIT OF TRANSMIT DATA
		

;RCSTA REGISTER 
		BANKSEL RCSTA				;PG.355
		BSF		RCSTA,SPEN		;DISABLE SERIAL PORT
		BCF		RCSTA,RX9		;SET 8 BIT RECEPTION
		BCF		RCSTA,SREN		;SIONGLE RECEIVE ENABLE BIT (MASTER -> DISABLE SINGLE BIT)
		BCF		RCSTA,CREN		;DISABLE CONTINUOUS RECIEVE
		BCF		RCSTA, ADDEN		;ADDRESS DETECT BIT (8-BIT DOESN'T CARE)
		BCF		RCSTA, FERR		;FRAMING ERROR BIT
		BCF		RCSTA, OERR		;OVERRUN ERROR BIT
		BCF		RCSTA, RX9D		;NINTH-BIT OF RECEIVE DATA	

;ENABLE TRANSMIT
		BANKSEL TXSTA
		BSF	TXSTA,	TXEN	;ENABLE TRANSMIT	
		
;*** I2C SETUP *****************************************
;SSPADD REGISTER (SLAVE MODE):
		BANKSEL SSPADD				;PG.343
		MOVLW	B'00010100'			;ADDRESS
		MOVWF	SSPADD
		
;SSPCON1 REGISTER:
		BANKSEL SSPCON				;PG.340    
		BCF		SSPCON,	WCOL		;WRITE COLLISION DETECT BIT
		BCF		SSPCON,	SSPOV		;RECEIVE OVERFLOW INDICATOR BIT
		BSF		SSPCON,	SSPEN		;SYNCHRONUS SERIAL PORT ENABLE BIT. SETS SDA & SCL PINS AS SERIAL INPUTS
		BSF		SSPCON,	CKP		;CLOCK POLARITY SELECT BIT (UNUSED IN MASTER I2C)
		BSF		SSPCON,	SSPM3		;SYNCHRONUS SERIAL PORT MODE SELECT BITS
		BSF		SSPCON,	SSPM2		;SET TO SLAVE 7BIT-ADDRESSING WITH INTERUPTS 
		BSF		SSPCON,	SSPM1		
		BCF		SSPCON,	SSPM0		
;SSPCON2 REGISTER:					
		BANKSEL SSPCON2				;PG.341
		BSF		SSPCON2, GCEN		;GENERAL CALL INTERRUPT ENABLE BIT (SLAVE MODE ONLY)
		BCF		SSPCON2, ACKSTAT	;ACKNOWLEDGE STATUS BIT (ACKNOWLEDGE WAS RECEIEVED)
		BCF		SSPCON2, ACKDT		;(IN RECEIVE MODE) ACKNOWLEDGE SEQUENCE IDLE
		BCF		SSPCON2, ACKEN		;ACKNOWLEDGE SEQUENCE ENABLE BIT (MASTER MODE ONLY)
		BCF		SSPCON2, RCEN		;RECEIVE ENABLE BIT (MASTER MODE ONLY)
		BCF		SSPCON2, PEN		;STOP CONDITION ENABLE BIT (MASTER MODE ONLY)
		BCF		SSPCON2, RSEN		;REPEATED START CONDITION ENABLE BIT (MASTER MODE ONLY)
		BSF		SSPCON2, SEN		;START CONDITION ENABLE/STRECTH ENABLE BIT
;SSPCON3 REGISTER:
		BANKSEL SSP1CON3			;PG.342
		BCF		SSP1CON3, ACKTIM	;ACKNOWLEDGE TIME STATUS BIT
		BCF		SSP1CON3, PCIE		;STOP CONDITION INTERRUP ENABLE BIT
		BSF		SSP1CON3, SCIE		;START CONDITION INTERRUPT ENBLE BIT
		BCF		SSP1CON3, BOEN		;BUFFER OVERWRITE ENABLE BIT
		BCF		SSP1CON3, SDAHT		;SDA HOLD TIME SELECTION BIT
		BSF		SSP1CON3, SBCDE		;SLAVE MODE BUS COLLISION DETECT ENABLE BIT
		BCF		SSP1CON3, AHEN		;ADDRESS HOLD ENABLE BIT
		BCF		SSP1CON3, DHEN		;DATA HOLD ENABLE BIT
;SSPSTAT REGISTER:
		BANKSEL SSPSTAT				;PG.338
		BSF		SSPSTAT, SMP		;SPI DATA INPUT SAMPLE BIT
		BCF		SSPSTAT, CKE		;SPI CLOCK EDGE SELECT BIT (SPI MODE ONLY)
		BSF		SSPSTAT, D_NOT_A	;DATA/!ADDRESS BIT (INDICATES THE FIRST BYTE IS ADDRESS BYTE)
		BCF		SSPSTAT, P		;STOP BIT INDICATOR
		BCF		SSPSTAT, S		;START BIT INDICATOR
		BCF		SSPSTAT, R_NOT_W	;READ/!WRITE BIT INFORMATION 
		BCF		SSPSTAT, UA		;UPDATE ADDRESS BIT (10-BIT I2C MODE ONLY)
		BCF		SSPSTAT, BF		;BUFFER FULL STATUS BIT (RX - NOT COMPLETE, TX- TRANSMIT COMPLETE)		
		
;MISC SETUP ******************************************************************
;OPTION_REG REGISTER 
		BANKSEL OPTION_REG	;PAGE 208
		BCF	OPTION_REG, PS0	;\\
		BCF	OPTION_REG, PS1	; >>PRESCALER RATIO SET 1:1
		BCF	OPTION_REG, PS2	;//
		BSF	OPTION_REG, PSA	;PRESCALER ASSIGNED TO WDT 
		BCF	OPTION_REG, 4	;TMR0 EDGE SET RISING
		BCF	OPTION_REG, 5	;TMR0 CLOCK SET TO INTERNAL
		BSF	OPTION_REG, INTEDG	;RB0/INT SET TO RISING EDGE
		BCF	OPTION_REG, 7	;PULLUPS SET TO INDIVIDUALLY EN.
		
;INTCON REGISTER 
		BANKSEL INTCON		;PAGE 97
		
		BCF	INTCON, INTE	;DISABLE RB0/INT EXT INTERRUPT
		BCF	INTCON, TMR0IE	;DISABLE TMR0 INTERRUPT
		BSF	INTCON, PEIE	;ENABLE PERIPHERAL INTERRUPTS
		BSF	INTCON, GIE	;ENABLE ALL UNMASKED INTERRUPTS
		
;PIE1 REGISTER 
		BANKSEL PIE1		;PAGE 98
		BCF	PIE1, TMR1IE	;DISABLE TMR1 INTERRUPT
		BCF	PIE1, TMR2IE	;DISABLE TMR2 INTERRUPT
		BCF	PIE1, CCP1IE	;DISABLE CCP1 INTERRUPT
		BSF	PIE1, SSP1IE	;DISABLE SSP INTERRUPT
		BCF	PIE1, TXIE	;DISABLE USART TX INTERRUPT
		BCF	PIE1, RCIE	;DISABLE USART RX INTERRUPT
 		BCF	PIE1, ADIE	;DISABLE A/D INTERRUPT
		BCF	PIE1, 7		;DISABLE PSP INTERRUPT
	
;PIE2 REGISTER
		BANKSEL	PIE2
		BCF	PIE2,	CCP2IE	;DISABLE THE CCP2 INTERRUPT
		BCF	PIE2,	C3IE	;DISABLE CMPARITOR3 ENABLE BIT
		BCF	PIE2,	C4IE	;DISABLE CMPARITOR4 ENABLE BIT
		BCF	PIE2,	BCL1IE	;DISABLE BUS COLLISION INTERRUPT
		BCF	PIE2,	EEIE	;DISABLE EEPROM WRITE INTERRUPT
		BCF	PIE2,	C1IE	;DISABLE CMPARITOR1 ENABLE BIT
		BCF	PIE2,	C2IE	;DISABLE CMPARITOR2 ENABLE BIT
		BCF	PIE2,	OSFIF	;OSCILLATOR FAIL INTERRUPT ENABLE BIT 
		
;T1CON REGISTER 
		BANKSEL	T1CON
		BCF	T1CON, TMR1ON	;DISABLE TIMER 1
		BCF	T1CON, T1OSCEN	;OSCILLATOR IS SHUT OFF
		BCF	T1CON, T1CKPS1	;00 1:1 PRESCALE VALUE
		BCF	T1CON, T1CKPS0	



;*****************************************************				
;			PWM SETUP
;*****************************************************		
		BANKSEL	PR2 ;LOAD PR2 WITH PWM PERIOD
		MOVLW	H'FF'
		MOVWF	PR2
		
;CCPR1L	
		BANKSEL	CCPR1L
		MOVLW	H'08'	;LOAD START POINT FOR CCP1
		MOVWF	CCPR1L
;CCPR2L	
		BANKSEL	CCPR2L
		MOVLW	H'08'	;LOAD START POINT FOR CCP2
		MOVWF	CCPR2L
			
;CCP1CON REGISTER
		BANKSEL	CCP1CON
		CLRF	CCP1CON
		BCF	CCP1CON, CCP1M0	;\
		BSF	CCP1CON, CCP1M1	;>>>CAPTURE/COMPARE/PWM DISABLED
		BSF	CCP1CON, CCP1M2	;//
		BSF	CCP1CON, CCP1M3	;/
		BCF	CCP1CON,    4
		BCF	CCP1CON,    5
;CCP2CON REGISTER 
		BANKSEL	CCP2CON
		CLRF	CCP2CON
		BCF	CCP2CON, CCP2M0	;\
		BSF	CCP2CON, CCP2M1	;>>>CAPTURE/COMPARE/PWM DISABLED
		BSF	CCP2CON, CCP2M2	;//
		BSF	CCP2CON, CCP2M3	;/
		BCF	CCP2CON,    4
		BCF	CCP2CON,    5
		
		BANKSEL	PIR1
		BCF	PIR1, TMR2IF
		
;T2CON REGISTER   
		BANKSEL	T2CON
		BCF	T2CON, T2OUTPS0	;\
		BCF	T2CON, T2OUTPS1 ; \ TIMER 2 POSTSCALER
		BCF	T2CON, T2OUTPS2 ; / '0111' POSTSCALER = 1:8
		BCF	T2CON, T2OUTPS3 ;/
		BSF	T2CON, TMR2ON 	;DIS. TIMER 2/ ENABLED AS NEEDED
		BCF	T2CON, T2CKPS0	;\ 10 PRESCALE VALUE IS 16
		BSF	T2CON, T2CKPS1	;/
		
		BANKSEL	PIR1
		BTFSS	PIR1,	TMR2IF	
		GOTO	$-2
		
		BCF	PIR1,	TMR2IF
		
		BANKSEL	TRISC
		MOVLW	B'00011000'	;MAKE SHURE THAT TRISC IS SET RIGHT FOR I2C
		MOVWF	TRISC
		
		BANKSEL	PORTB
		CLRF	PORTB		;MAKE SHURE PORTB IS CLEAR
		
		
		GOTO	MAIN

;******************************************		
			
;******************************************
;INTERUPT SERVICE ROUTINE 
;******************************************
INTERUPT
		BANKSEL	W_SAVE	    ;SAVE THE WORKING REGISTER
		MOVWF	W_SAVE
		MOVFW	STATUS	    ;SAVE THE STATUS 
		MOVWF	STATUS_SAVE
		
		BANKSEL	PIR1
		BTFSC	PIR1,	SSP1IF	;TEST THE I2C RECEVE FLAG
		CALL	I2C_RECEVE	;CALL THE I2C RECEVE ROUTINE 
		BANKSEL	SSPCON1
		BSF	SSPCON1, CKP	;STOP CLOCK STRETCHING 
		BANKSEL	PIR1
		BCF	PIR1,	SSP1IF	;CLEAR I2C INTERUPT FLAG
		
		BANKSEL	STATUS_SAVE ;RECALL STATUS 
		MOVFW	STATUS_SAVE
		MOVWF	STATUS
		MOVFW	W_SAVE	    ;RECALL WORKING
		RETFIE		    ;RETURN AND ENABLE INTERUPTS 	
I2C_RECEVE
		BANKSEL	SSPCON1
		BCF	SSPCON1, CKP	;START CLOCK STRETCHING
		
		BANKSEL	SSPSTAT
		BTFSC	SSPSTAT,    5;DATA/_NOT_ADDRESS
		GOTO	RECEVED
	
		BANKSEL	SSP1BUF
		MOVFW	SSP1BUF	    ;CLEAR THE BUFFER BY MOVING THE DATA TO WORKING
EXIT		
		RETURN
RECEVED
		BANKSEL	BYTEIND
		BTFSC	BYTEIND,    7	;TEST IF THE DRIVE DATA HAS ALLREADY BEEN RECEVED(FOR THE STOP CONDITION) 
		GOTO	DRIVE	    
		
		BANKSEL	BYTEIND
		BTFSC	BYTEIND,    6	;TEST IF THE TURN DATA HAS BEEN RECEVED 
		GOTO	TURN
		
		BANKSEL	BYTEIND
		BTFSC	BYTEIND,    5	;TEST IF THE FORWARD DATA HAS BEEN RECEVED 
		GOTO	FOWARD
		
		BANKSEL	BYTEIND
		BTFSC	BYTEIND,    4	;TEST IF THE REVERCE DATA HAS BEEN RECEVED 
		GOTO	REVERCE
		
		BANKSEL	SSP1BUF
		MOVFW	SSP1BUF		;SHIFT THE RECEVED DATA TO WORKING 
		
		BANKSEL	SAVEDATA3   
		MOVWF	SAVEDATA3	;SAVE THE RECEVED DATA TO SAVEDATA3 
		MOVFW	SAVEDATA3	;SHIFT THE DATA TO THE WORKING REGISTER 
		
		XORLW	H'044'		;TEST IF THE DATA IS THE DRIVE INDICATOR BYTE
		
		BANKSEL	STATUS
		BTFSC	STATUS,	2
		CALL	DRIVEIND	;IF THE DATA IS THE DRIVE INDICATOR SET THAT BIT  
		
		BANKSEL	SAVEDATA3
		MOVFW	SAVEDATA3	;PULL THE DATA FROM SAVEDATA3 
		
		XORLW	H'054'		;TEST IF THE DATA IS THE TURN INDICATOR BYTE
		
		BANKSEL	STATUS
		BTFSC	STATUS,	2
		CALL	TURNIND		;IF THE DATA IS THE TURN INDICATOR SET THAT BIT 
		
		BANKSEL	SAVEDATA3
		MOVFW	SAVEDATA3	;PULL THE DATA FROM SAVEDATA3 
		
		XORLW	H'046'		;TEST IF THE DATA IS THE FORWARD INDICATOR BYTE
		
		BANKSEL	STATUS
		BTFSC	STATUS,	2
		CALL	FOWARDIND	;IF THE DATA IS THE FORWARD INDICATOR SET THAT BIT 
		
		
		BANKSEL	SAVEDATA3
		MOVFW	SAVEDATA3	;PULL THE DATA FROM SAVEDATA3 
		
		XORLW	H'042'		;TEST IF THE DATA IS THE REVERCE INDICATOR BYTE
		
		BANKSEL	STATUS
		BTFSC	STATUS,	2
		CALL	REVIND		;IF THE DATA IS THE REVERCE INDICATOR SET THAT BIT 
		
		GOTO	EXIT
DRIVEIND
		BANKSEL	BYTEIND
		BSF	BYTEIND,    7	;SET THE DRIVE DATA INDICATOR 
		RETURN
TURNIND	    
		BANKSEL	BYTEIND
		BSF	BYTEIND,    6	;SET THE TURN DATA INDICATOR
		RETURN
FOWARDIND
		BANKSEL	BYTEIND
		BSF	BYTEIND,    5	;SET THE FORWARD DATA INDICATOR
		RETURN	
REVIND
		BANKSEL	BYTEIND
		BSF	BYTEIND,    4	;SET THE REVERCE DATA INDICATOR
		RETURN		
DRIVE	    
		BANKSEL	BYTEIND
		BCF	BYTEIND,    7	;CLEAR THE DRIVE DATA INDACATOR
		
		BANKSEL DRIVE_DATA
		CLRF	DRIVE_DATA	;CLEAR THE DRIVE DATA REGISTER
		
		BANKSEL	SSP1BUF
		MOVFW	SSP1BUF		;SHIFT THE DATA FROM THE BUFFER TO THE WORKING REGISTER
		
		BANKSEL DRIVE_DATA
		MOVWF	DRIVE_DATA	;SHIFT THE DATA IN THE WORKING TO THE DRIVE DATA REGISTER
		
		GOTO	EXIT		
TURN	
		BANKSEL	BYTEIND
		BCF	BYTEIND,    6	;CLEAR THE TURN DATA INDACATOR
		
		BANKSEL TURN_DATA
		CLRF	TURN_DATA   ;CLEAR THE TURN DATA REGISTER
		
		BANKSEL	SSP1BUF
		MOVFW	SSP1BUF	    ;SHIFT THE DATA FROM THE BUFFER TO THE WORKING REGISTER
		
		BANKSEL TURN_DATA
		MOVWF	TURN_DATA   ;SHIFT THE DATA IN THE WORKING TO THE TURN DATA REGISTER
		
		BANKSEL	TURN_DATA
		LSRF	TURN_DATA			;SHIFT BYTE4 FOUR TIMES
		LSRF	TURN_DATA
		LSRF	TURN_DATA
		LSRF	TURN_DATA
		MOVFW	TURN_DATA
		CALL	TABLE_TURN			;CALL TABLE TO SCALE VALUE
		MOVWF	STERING_DATA	;LOAD VALUE FROM THE TABLE TO THE STERING REGISTER
		GOTO	EXIT
FOWARD
		BANKSEL	BYTEIND
		BCF	BYTEIND,    5	;CLEAR THE FORWARD DATA INDACATOR
		
		BANKSEL FORWARD_DATA
		CLRF	FORWARD_DATA	;CLEAR THE FORWARD DATA REGISTER
		
		BANKSEL	SSP1BUF
		MOVFW	SSP1BUF		;SHIFT THE DATA FROM THE BUFFER TO THE WORKING REGISTER
		
		BANKSEL FORWARD_DATA
		MOVWF	FORWARD_DATA	;SHIFT THE DATA IN THE WORKING TO THE FORWARD DATA REGISTER
		
		BANKSEL	FORWARD_DATA
		LSRF	FORWARD_DATA			;SHIFT BYTE4 FOUR TIMES
		LSRF	FORWARD_DATA
		LSRF	FORWARD_DATA
		LSRF	FORWARD_DATA
		MOVFW	FORWARD_DATA
		CALL	TABLE_FORWARD			;CALL TABLE TO SCALE VALUE
		MOVWF	DRIVE_DATA	;LOAD VALUE FROM THE TABLE TO THE DRIVE REGISTER 
		
		GOTO	EXIT	
REVERCE
		BANKSEL	BYTEIND
		BCF	BYTEIND,    4	;CLEAR THE REVERCE DATA INDACATOR
		
		BANKSEL REVERCE_DATA
		CLRF	REVERCE_DATA	;CLEAR THE REVERCE DATA REGISTER
		
		BANKSEL	SSP1BUF
		MOVFW	SSP1BUF		;SHIFT THE DATA FROM THE BUFFER TO THE WORKING REGISTER
		
		BANKSEL REVERCE_DATA
		MOVWF	REVERCE_DATA	;SHIFT THE DATA IN THE WORKING TO THE REVERCE DATA REGISTER
		
		BANKSEL	REVERCE_DATA
		LSRF	REVERCE_DATA				;SHIFT BYTE4 FOUR TIMES
		LSRF	REVERCE_DATA
		LSRF	REVERCE_DATA
		LSRF	REVERCE_DATA
		MOVFW	REVERCE_DATA
		CALL	TABLE_REVERSE			;CALL TABLE TO SCALE VALUE
		MOVWF	DRIVE_DATA	;LOAD VALUE FROM THE TABLE TO THE DRIVE REGISTER
		
		GOTO	EXIT
;******************************************
;  SUBROUTINES
;******************************************
DELAY ;************************************
		RETURN
				
CONVERT ;**********************************
		RETURN

XMIT ;*************************************
		RETURN

REC ;******************************************
		RETURN
;******************************************
STOPCOMPERSSER
		BANKSEL	PORTB
		BCF	PORTB,	7   ;CLEAR PORTB BIT 7 TO STOP THE AIR COMPRESSER 
		GOTO	MAIN

STARTCOMPERSSER
		BANKSEL	PORTB
		BSF	PORTB,	7   ;SET PORTB BIT 7 TO START THE AIR COMPRESSER
		GOTO	MAIN
		
;******************************************
MAIN
;******************************************

		BANKSEL	DRIVE_DATA
		MOVFW	DRIVE_DATA	;SHIFT THE DRIVE DATA VALUR TO WORKING 
		
		BANKSEL	CCPR2L
		MOVWF	CCPR2L		;SHIFT THE DRIVE DATA TO THE PW CONTROL REGISTER 
		
		BANKSEL	STERING_DATA
		MOVFW	STERING_DATA	;SHIFT THE STERING DATA VALUR TO WORKING

		BANKSEL	CCPR1L
		MOVWF	CCPR1L		;SHIFT THE STERING DATA TO THE PW CONTROL REGISTER 		
			
	;*****ADC SETUP****		
;ADCON0 REGISTER

		BANKSEL	ADCON0
		BSF	ADCON0, ADON	;ENABLE A/D CONVERTER
		BSF	ADCON0,	1	;ADC CONVERSION STATUS BIT 
		BSF	ADCON0, CHS0	;0000O SET A/D CHANNEL TO AN1
		BCF	ADCON0, CHS1	;
		BCF	ADCON0, CHS2	;
		BCF	ADCON0, CHS3	;
		BCF	ADCON0, CHS4	;			
		BSF	ADCON0, ADRMD	;SET DATA PRECISION TO 10 BIT
		
;ADCON1 REGISTER
		BANKSEL	ADCON1
		
		BCF	ADCON1, ADCS0	
		BCF	ADCON1, ADCS1	;111 A/D CONVERSION CLOCK = FOSC/32
		BCF	ADCON1, ADCS2	
		
		BCF	ADCON1, ADFM	;SIGN MAGNITUDE DATA METHOD(IS L-JUST)
		
		BCF	ADCON1, ADNREF	;VREF- = VSS
		
		BCF	ADCON1, 0	;00 VREF+ = VDD		
		BCF	ADCON1, 1		
;ADCON2 REGISTER
		BANKSEL	ADCON2
		
		BCF	ADCON2, TRIGSEL0	
		BCF	ADCON2, TRIGSEL1 ;0000 A/D AUTO TRIG DISABLED
		BCF	ADCON2, TRIGSEL2	
		BCF	ADCON2, TRIGSEL3
		
		BSF	ADCON2, CHSN0	
		BSF	ADCON2, CHSN1	;1111 A/D NEG DIF CHANNEL BY ADNREF
		BSF	ADCON2, CHSN2	
		BSF	ADCON2, CHSN3	
;**** END ADC SETTUP****
		
		BANKSEL	ADCON0
		BTFSC	ADCON0,	1	;TEST THE GO/DONE BIT
		GOTO	$-2		;WAIGHT TILL THE CONVERTION COMPLEETS
		
		BANKSEL	ADRESH
		MOVFW	ADRESH		;MOVE THE RESULT TO WORKING 

		SUBLW	B'10011000'	;SUBTRACT THE HIGH SETPOINT	
		
		BANKSEL	STATUS
		BTFSS	STATUS,	0	;TEST THE NEGITIVE RESULT BIT 
		GOTO	STOPCOMPERSSER	;IF THE RESULT IS NEGITIVE STOP THE COMPRESSER
		
		BANKSEL	ADRESH		  
		MOVFW	ADRESH		;IF THE RESULT IS NOT NEGITIVE PULL THE RESULT AGAIN
		
		SUBLW	B'10001110'	;SUBTRACT THE LOW SETPOINT 
		
		BANKSEL	STATUS
		BTFSC	STATUS,	0	;TEST THE NEGITIVE RESULT BIT 
		GOTO	STARTCOMPERSSER	;IF THE RESULT IS NEGITIVE START THE COMPRESSER
		
		GOTO	MAIN			    ;REPEAT
		
		END

;********************END PROGRAM DIRECTIVE ***********************************
;*****************************************************************************









