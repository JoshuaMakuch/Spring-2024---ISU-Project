;******************************************************************************
;                                                                             *
;    Filename:	    MiniATV_Controller_Master_Code.asm			      *
;    Date:	    November 9, 2023					      *
;    File Version:  8                                                         *
;    Author:        Joshua Makuch                                             *
;    Company:       Idaho State University                                    *
;    Description:   Firmware for runing the Master PIC for the MiniATV	      *
;		    Controller						      *
;		                                                              *
;******************************************************************************
;******************************************************************************
;                                                                             *
;    Revision History:                                                        *
;	1: Basic setup for the PIC16LF1789. Test program for the dev board    *
;	   increments portb to indicate that the 1789 was soldered correctly  *
;	2: This version will now have 3 joysticks, 7 buttons, 2 triggers,     *
;          a mode select switch, robot address dip switch package, and	      *
;	   several LED indicators.				              *
;	3: UART transmission and reception function. Mode 1 utilizes nearly   *
;	   all controls to function. Mode 2 is a button test display. Only    *
;	   drive works ATM however. 					      *
;	5: UART still works, however, UART is now 115.2k Baud Rate as well as *
;	   a PCB has been made for this design. I2C is about to begin	      *
;	   development.							      *
;	6: ADC has been fixed. The issue was that AN6 was being toggled and   *
;	   causing PORTE pin1 (button 2) to accidentally toggle and tie to    *
;	   another analog input, creating a spike and toggling the input.     *
;	   Additionally, basic I2C has been integrated.			      *
;	7: This version utilizes the lock brakes button for use in I2C comms  *
;	   testing. This overwrites a lot of stuff, don't use this version    *
;	8: This is the final version of the 2024 spring semester. This	      *
;	   version contains procedures for handling two peripherals as well   *
;	   as a semi-functioning disconnect/connect indicator. Additionally   *
;	   work has been done for UART TX and RX. Refer to the report. This   *
;	   is meant to be the template version for future designs. Any	      *
;	   offshoots from here will require the user to alter the include     *
;	   files and main code. Good luck from here future coders :D 4/25/24  *
;									      *
;	    STARTED NOV 17 2023 - CURRENT VERSION IMPLEMENTED		      *
;                                                                             *
;******************************************************************************
	
;******************************************************************************
;									      *
;	PERIPHERAL ALLOCATION IN THE PERI_STATUS REGISTER:		      *
;	7 - N/A								      *
;	6 - N/A								      *
;	5 - N/A								      *
;	4 - N/A								      *
;	3 - N/A								      *
;	2 - N/A								      *
;	1 - PERI_ADR50 (JVE-S2 LCD SCREEN)				      *
;	0 - PERI_ADR8 (TURRET CONTROLLER)				      *
;									      *
;******************************************************************************
	
	LIST	    p=16LF1789
	INCLUDE	    P16LF1789.INC
	INCLUDE	    1789_SETUP.INC
	INCLUDE	    1789_UART.INC
	INCLUDE	    1789_PERIPHERAL_ADR8.INC
	INCLUDE	    1789_PERIPHERAL_ADR50.INC
	
; CONFIG1
; __config 0xEFE4
 __CONFIG _CONFIG1, _FOSC_INTOSC & _WDTE_OFF & _PWRTE_OFF & _MCLRE_ON & _CP_OFF & _CPD_OFF & _BOREN_OFF & _CLKOUTEN_OFF & _IESO_OFF & _FCMEN_OFF
; CONFIG2
; __config 0xFFFF
 __CONFIG _CONFIG2, _WRT_OFF  & _PLLEN_OFF & _STVREN_ON & _BORV_LO & _LPBOR_OFF & _LVP_ON

    ;suppress "not in bank 0" message,  Found label after column 1,
    errorlevel -302,-207,-305,-206,-203			
							
;******************************************		
;ORIGIN VECTORS & SETUP
;******************************************
		ORG 	H'000'					
 		GOTO 	SETUP				;RESET CONDITION GOTO SETUP
		ORG	H'004'
		GOTO	INTERUPT
SETUP
		CALL	INITIALIZE			;CALLS THE SETUP FILE 1788_SETUP.INC
		GOTO	MAIN
;******************************************
;INTERUPT SERVICE ROUTINE 
;******************************************
INTERUPT
		BANKSEL W_SAVE
		MOVWF		W_SAVE			;SAVE WORKING REGISTER CONTENTS
		BANKSEL	STATUS
		MOVFW		STATUS
		MOVWF		STATUS_SAVE		;SAVES STATUS REGISTER CONTENTS
		
		BANKSEL PIR1
		BTFSC  PIR1, RCIF			;TESTS THE RECEIVE INTERRUPT FLAG, IF SET CALL RECEIVED_BYTE
		CALL REC_BYTE
		
		BANKSEL PIR1
		BTFSC	PIR1, TMR2IF			;IF TIMER2 INTERRUPT FLAG, THEN HANDLE TIMER COUNT
		CALL HANDLE_T2_INT
		BANKSEL PIR1
		BCF	PIR1, SSP1IF
		
		BANKSEL STATUS_SAVE			;RECALL STATUS REGISTER CONTENTS
		MOVFW		STATUS_SAVE
		MOVWF		STATUS			;RESTORE STATUS REGISTER CONTENTS
		BANKSEL W_SAVE				
		MOVFW		W_SAVE			;RESTORE WORKING REGISTER CONTENTS
		
		RETFIE					;RETURN AND RESET INTERRUPT ENABLE BITS
;******************************************
;  SUBROUTINES
;******************************************
;*** HANDLE T2_INT *************************************
HANDLE_T2_INT
		
		BANKSEL PIR1				;PG.36
		BCF		PIR1, TMR2IF		;TMR2 INTERRUPT FLAG RESET
		
		BANKSEL TMR_CNT
		DECFSZ	TMR_CNT				;IF ? COUNTS OF TMR_CNT HAS OCCURED, RESET THE COUNT
		RETURN
		
		BANKSEL TMR_CNT
		MOVLW		D'024'
		MOVWF		TMR_CNT
		BANKSEL INFO_REG
		BSF		INFO_REG, 3
		
		RETURN
;*** CONVERSION_DONE ***********************************
CONVERSION_DONE
		
		BANKSEL ADCON0				;TEMPORARILY STORES ADCON0 FOR USE IN ANALOG READING
		MOVFW		ADCON0
		BANKSEL SHRT_TRM_REG
		MOVWF		SHRT_TRM_REG
		
		MOVLW		B'00000100'		;INCREMENT "ADCON0" ANALOG CHANNEL SELECT IN SHRT_TRM_REG
		BANKSEL		SHRT_TRM_REG			
		ADDWF		SHRT_TRM_REG, 1		
		
		MOVLW		B'10011001'		;IF ("ANALOG SELECT CHANNEL" = AN6) THEN:
		BANKSEL SHRT_TRM_REG			    ;RESET ADCON0 ANALOG SELECT CHANNEL TO AN0
		XORWF		SHRT_TRM_REG, 0		;ELSE:
		BANKSEL STATUS				    ;INCREMENT ADCON0 ANALOG CHANNEL SELECT
		BTFSS		STATUS, Z				 
		GOTO SEC_CON_ADC_1
		BANKSEL ADCON0				
		BCF		ADCON0, CHS4
		BCF		ADCON0, CHS3
		BCF		ADCON0, CHS2
		BCF		ADCON0, CHS1
		BCF		ADCON0, CHS0
		GOTO END_ADC_1
		SEC_CON_ADC_1
		MOVLW		B'00000100'		
		BANKSEL		ADCON0			
		ADDWF		ADCON0, 1	
		END_ADC_1
		
		MOVLW		B'00000100'
		BANKSEL SHRT_TRM_REG
		SUBWF		SHRT_TRM_REG, 1
		
		
		BANKSEL ADRESH				;STORES THE UPPER 8-BIT ADC CONVERSTION RESULT INTO ADC_RESULT
		MOVFW		ADRESH	
		BANKSEL		ADC_RESULT
		MOVWF		ADC_RESULT
		
		
							;SELECT CASE (ANALOG SELECT CHANNEL (ANX)):
		
		MOVLW		B'10000001'		    ;CASE 0
		BANKSEL		SHRT_TRM_REG		    ;STORE ADC_RESULT INTO JOY1UD
		XORWF		SHRT_TRM_REG, 0
		BANKSEL STATUS
		BTFSS		STATUS, Z
		GOTO $ + 4
		BANKSEL ADC_RESULT
		MOVFW		ADC_RESULT
		MOVWF		JOY1UD
		
		MOVLW		B'10000101'		    ;CASE 1
		BANKSEL		SHRT_TRM_REG		    ;STORE ADC_RESULT INTO JOY1LR
		XORWF		SHRT_TRM_REG, 0
		BANKSEL STATUS
		BTFSS		STATUS, Z
		GOTO $ + 4
		BANKSEL ADC_RESULT
		MOVFW		ADC_RESULT
		MOVWF		JOY1LR
		
		MOVLW		B'10001001'		    ;CASE 2
		BANKSEL		SHRT_TRM_REG		    ;STORE ADC_RESULT INTO JOY2UD
		XORWF		SHRT_TRM_REG, 0
		BANKSEL STATUS
		BTFSS		STATUS, Z
		GOTO $ + 4
		BANKSEL ADC_RESULT
		MOVFW		ADC_RESULT
		MOVWF		JOY2UD
		
		MOVLW		B'10001101'		    ;CASE 3
		BANKSEL		SHRT_TRM_REG		    ;STORE ADC_RESULT INTO JOY2LR
		XORWF		SHRT_TRM_REG, 0
		BANKSEL STATUS
		BTFSS		STATUS, Z
		GOTO $ + 4
		BANKSEL ADC_RESULT
		MOVFW		ADC_RESULT
		MOVWF		JOY2LR
		
		MOVLW		B'10010001'		    ;CASE 4
		BANKSEL		SHRT_TRM_REG		    ;STORE ADC_RESULT INTO JOY3UD
		XORWF		SHRT_TRM_REG, 0
		BANKSEL STATUS
		BTFSS		STATUS, Z
		GOTO $ + 4
		BANKSEL ADC_RESULT
		MOVFW		ADC_RESULT
		MOVWF		JOY3UD
		
		MOVLW		B'10010101'		    ;CASE 5
		BANKSEL		SHRT_TRM_REG		    ;STORE ADC_RESULT INTO JOY3LR
		XORWF		SHRT_TRM_REG, 0
		BANKSEL STATUS
		BTFSS		STATUS, Z
		GOTO $ + 4
		BANKSEL ADC_RESULT
		MOVFW		ADC_RESULT
		MOVWF		JOY3LR
							;END CASE
				
		BANKSEL ADCON0
		BSF		ADCON0, 1		;BEGIN A NEW CONVERSION
		
		RETURN
;*** SET_HARD_STOP ************************
SET_HARD_STOP
		
		BANKSEL INFO_REG
		BSF		INFO_REG, 6
		BCF		INFO_REG, 7
		CALL TX_SEND_HARD_STOP
		
		RETURN
;*** TOGGLE_LOCK_BRAKES *******************
TOGGLE_LOCK_BRAKES

		BANKSEL INFO_REG			;FLIP THE LOCK BRAKES STATE
		MOVLW		B'00100000'
		XORWF		INFO_REG, 1		
		MOVLW		0X00			;IF (LOCK BRAKES STATE) THEN:
		BTFSC		INFO_REG, 5		    ;SET TX_DATA_44H_VAR11 TO LOCK BRAKES
		MOVLW		0X01			;ELSE
		MOVWF		TX_DATA_44H_VAR1		    ;SET TX_DATA_44H_VAR1 TO RELEASE BRAKES
		CALL TX_SEND_LOCK_BRAKES
		
		BANKSEL BTN_REG_1			;CLEAR BUTTON 2 INDICATOR
		BCF		BTN_REG_1, 3		;CLEAR COAST AND HARD STOP INDICATORS
		BANKSEL INFO_REG
		BCF		INFO_REG, 7
		BCF		INFO_REG, 6
		RETURN
;*** TOGGLE_SPEED *************************
TOGGLE_SPEED
		
		BANKSEL BTN_REG_1			;CLEAR JOYBTN1 INDICATOR
		BCF		BTN_REG_1, 6		
		BANKSEL INFO_REG			;FLIP THE TOGGLE SPEED STATE
		MOVLW		B'00010000'
		XORWF		INFO_REG, 1
		
		RETURN
;*** SET_FWD_VAR **************************
SET_FWD_VAR
		BANKSEL JOY1UD				;SET TX_DATA_42H_VAR1 TO 2 * (JOY1UD - 128)
		MOVFW		JOY1UD
		BANKSEL TX_DATA_46H_VAR1
		MOVWF		TX_DATA_46H_VAR1
		MOVLW		D'128'
		SUBWF		TX_DATA_46H_VAR1, 1
		LSLF		TX_DATA_46H_VAR1, 1					
					
		BANKSEL INFO_REG
		BTFSC		INFO_REG, 4		;IF (TOGGLED SPEED) THEN:
		LSRF		TX_DATA_46H_VAR1, 1	    ;TX_DATA_42H_VAR1 = TX_DATA_42H_VAR1 / 4
		BTFSC		INFO_REG, 4
		LSRF		TX_DATA_46H_VAR1, 1
		
		CALL TX_SEND_MOVE_FORWARD
		
		BANKSEL INFO_REG
		BCF		INFO_REG, 7		;CLEAR COAST INDICATOR (INFO_REG, 7)
		BANKSEL INFO_REG
		BSF		INFO_REG, 2		;SET MOVE FWD INDICATOR
		
		RETURN
;*** SET_BWD_VAR **************************
SET_BWD_VAR
		BANKSEL JOY1UD				;SET TX_DATA_42H_VAR1 TO 255 - (JOY1UD * 2)
		MOVFW		JOY1UD
		BANKSEL TX_DATA_42H_VAR1
		MOVWF		TX_DATA_42H_VAR1
		LSLF		TX_DATA_42H_VAR1, 1
		MOVFW		TX_DATA_42H_VAR1
		SUBLW		D'255'
		MOVWF		TX_DATA_42H_VAR1
		
		BANKSEL INFO_REG
		BTFSC		INFO_REG, 4		;IF (TOGGLED SPEED) THEN:
		LSRF		TX_DATA_42H_VAR1, 1		;TX_DATA_42H_VAR1 = TX_DATA_42H_VAR1 / 4
		BANKSEL INFO_REG
		BTFSC		INFO_REG, 4
		LSRF		TX_DATA_42H_VAR1, 1

		CALL TX_SEND_MOVE_BACK
		
		BANKSEL INFO_REG
		BCF		INFO_REG, 7		;CLEAR COAST INDICATOR (INFO_REG, 7)
		BANKSEL INFO_REG
		BSF		INFO_REG, 1		;SET MOVE BWD INDICATOR
		
		RETURN
;******************************************
MODE_1_MAIN
;******************************************
		
		BANKSEL PERI_STATUS		    ;IF (PERI_ADR8 ISN'T CONNECTED) THEN:
		BTFSS		PERI_STATUS, 0		;CALL IDENTIFY_PERIPHERAL_ADR8
		CALL IDENTIFY_PERIPHERAL_ADR8
		
		BANKSEL PERI_STATUS		    ;IF (PERI_ADR50 ISN'T CONNECTED) THEN:
		BTFSS		PERI_STATUS, 1		;CALL IDENTIFY_PERIPHERAL_ADR5
		CALL IDENTIFY_PERIPHERAL_ADR50
		
		BANKSEL	PERI_STATUS		    ;IF (PERI_ADR8 IS CONNECTED) THEN:
		BTFSC		PERI_STATUS, 0		;CALL READ_FROM_PERIPHERAL_ADR8
		CALL READ_FROM_PERIPHERAL_ADR8	
		
		BANKSEL	PERI_STATUS		    ;IF (PERI_ADR50 IS CONNECTED) THEN:
		BTFSC		PERI_STATUS, 1		;CALL WRITE_TO_PERIPHERAL_ADR8
		CALL WRITE_TO_PERIPHERAL_ADR50
		
		BANKSEL	JOY1LR			    ;SEND ALTERNATE TURN BASED OFF OF (JOY1LR)
		MOVFW		JOY1LR
		MOVWF		TX_DATA_74H_VAR1
		CALL TX_SEND_ALTERNATE_TURN
		
		BANKSEL PERI_STATUS		    ;IF (PERI_ADR50 CONNECTED) THEN:
		BTFSC		PERI_STATUS, 1		;SET PERI_ADR50 CONNECTED INDICATOR
		GOTO PERI_ADR50_INDICATOR_ON	    ;ELSE:
		BTFSS		PERI_STATUS, 1		;CLEAR PERI_ADR50 CONNECTED INDICATOR
		GOTO PERI_ADR50_INDICATOR_OFF
		PERI_ADR50_INDICATOR_ON
		BANKSEL PORTD
		BSF		PORTD, 6
		GOTO PERI_ADR50_INIDICATOR_END
		PERI_ADR50_INDICATOR_OFF
		BANKSEL PORTD
		BCF		PORTD, 6
		GOTO PERI_ADR50_INIDICATOR_END
		PERI_ADR50_INIDICATOR_END
		
		MOVLW		D'150'			;IF (JOY1UD > 150) THEN:
		BANKSEL JOY1UD				    ;SET PORTD BIT 0 (LED INDICATOR)
		SUBWF		JOY1UD, 0		;ELSE
		BANKSEL STATUS				    ;CLEAR PORTD BIT
		BTFSC		STATUS, C	
		BSF		PORTD, 0
		BTFSS		STATUS, C
		BCF		PORTD, 0
		
		
		MOVLW		D'150'
		BANKSEL JOY1LR
		SUBWF		JOY1LR, 0
		BANKSEL STATUS
		BTFSC		STATUS, C
		BSF		PORTD, 1
		BTFSS		STATUS, C
		BCF		PORTD, 1
		
		BANKSEL BTN_REG_1			;IF (JOYBTN1 & !PORTC_1) THEN:
		BTFSS		BTN_REG_1, 6		    ;CALL TOGGLE_SPEED
		GOTO TOGGLE_SPEED_END1			;SET TX_VAR1 = TX_VAR1 / 4
		BTFSC		PORTC, 1		    ;CLEAR JOYBTN1 INDICATOR
		GOTO TOGGLE_SPEED_END1
		CALL TOGGLE_SPEED
		TOGGLE_SPEED_END1

		BANKSEL INFO_REG
		BSF		INFO_REG, 7		;SET COAST INDICATOR (INFO_REG, 7)
		
		BANKSEL INFO_REG
		BCF		INFO_REG, 2
		MOVLW		D'150'			;IF (JOY1UD > 150) THEN:	
		BANKSEL JOY1UD				    ;CALL SET_FWD_VAR 
		SUBWF		JOY1UD, 0		    ;SET MOVE FWD INDICATOR	
		BANKSEL STATUS				    ;CLEAR COAST INDICATOR (INFO_REG, 7)    
		BTFSC		STATUS, C		;ELSE:
		CALL SET_FWD_VAR			    ;CLEAR MOVE FWD INDICATOR
		
		BANKSEL INFO_REG
		BCF		INFO_REG, 1
		MOVLW		D'113'			;IF (JOY1UD < 113) THEN:	
		BANKSEL JOY1UD				    ;CALL SET_BWD_VAR
		SUBWF		JOY1UD, 0		    ;SET MOVE BWD INDICATOR
		BANKSEL STATUS				    ;CLEAR COAST INDICATOR (INFO_REG, 7)
		BTFSS		STATUS, C		;ELSE:
		CALL SET_BWD_VAR			    ;SET MOVE BWD INDICATOR
		
		BANKSEL BTN_REG_1			;IF (BUTTON 1 PRESSED) THEN:
		BTFSS		BTN_REG_1, 2		    ;CLEAR COAST INDICATOR
		BCF		INFO_REG, 6		    ;SET HARDSTOP INDICATOR
		BTFSC		BTN_REG_1, 2		;ELSE:
		CALL SET_HARD_STOP			    ;CLEAR HARDSTOP INDICATOR
		
		BANKSEL BTN_REG_1			;IF (BTN2_IND & !PORTE_1) THEN:
		BTFSS		BTN_REG_1, 3		    ;CALL TOGGLE_LOCK_BRAKES
		GOTO LOCK_BRAKES_END1			    ;CLEAR COAST INDICATOR
		BTFSS		PORTE, 1		    ;CLEAR HARD STOP INDICATOR
		CALL TOGGLE_LOCK_BRAKES
		LOCK_BRAKES_END1
		
		BANKSEL INFO_REG			;IF (COAST INDICATOR) THEN:
		BTFSC		INFO_REG, 7		    ;CALL SEND_COAST
		CALL TX_SEND_STOP			    ;CLEAR COAST INDICATOR (INFO_REG, 7)
		
		BANKSEL PERI_STATUS			;IF (PERIPHERAL 0 CONNECTED) THEN:
		BTFSC		PERI_STATUS, 0		    ;GOTO MAIN1_PERI_CONTROLLER AND INDICATE CONNECTED
		GOTO MAIN1_PERI_CONTROLLER		;ELSE:
		GOTO MAIN1_ORIGINAL_CONTROLLER		    ;GOTO MAIN1_ORIGINAL_CONTROLLER AND INDICATE DISCONNECTED
		
		
MAIN1_PERI_CONTROLLER
		BANKSEL PORTD				;INDICATE PERIPHERAL CONTROLLER CONNECTED
		BSF	    PORTD, 7
	
		CALL TX_SEND_CANNON_X_AXIS_AND_Y_AXIS	;THE PERIPHERAL_ADR8 FILE SHOULD HAVE HANDELED ALL APPROPRIATE DATA
		
		CALL TX_SEND_CANNON_MECHANISM		;THE PERIPHERAL_ADR8 FILE SHOULD HAVE HANDELED ALL APPROPRIATE DATA
		
		GOTO MAIN				;EXIT MODE 1
		
MAIN1_ORIGINAL_CONTROLLER
		BANKSEL PORTD				;INDICATE PERIPHERAL CONTROLLER DISCONNECTED
		BCF	    PORTD, 7  
		
		BANKSEL TX_DATA_43H_VAR1		;SEND CANNON X/Y-AXIS BASED OFF OF (JOY3LR) AND (JOY3UD), RESPECTIVELY
		MOVFW		JOY3LR
		MOVWF		TX_DATA_43H_VAR1
		MOVFW		JOY3UD
		MOVWF		TX_DATA_43H_VAR2
		CALL TX_SEND_CANNON_X_AXIS_AND_Y_AXIS
		
		BANKSEL TX_DATA_63H_VAR1
		MOVLW		0X00			;IF (TRIGGER 1 INDICATOR) THEN:
		BTFSC		BTN_REG_1, 0		    ;SET REV INDICATOR (1) TO TX_DATA_63H_VAR1
		MOVLW		0X01			;ELSE:
		MOVWF		TX_DATA_63H_VAR1	    ;SET DON'T REV INDICATOR (0) TO TX_DATA_63H_VAR1
		MOVLW		0X00			;IF (TRIGGER 2 INDICATOR) THEN:
		BTFSC		BTN_REG_1, 1		    ;SET REV INDICATOR (1) TO TX_DATA_63H_VAR2
		MOVLW		0X01			;ELSE:
		MOVWF		TX_DATA_63H_VAR2	    ;SET DON'T REV INDICATOR (0) TO TX_DATA_63H_VAR1
		CALL TX_SEND_CANNON_MECHANISM
		
		GOTO MAIN				;EXIT MODE 1
;******************************************
MODE_2_MAIN
;******************************************
		
		BANKSEL PORTE				;IF (NOT BUTTON 2) THEN:
		BTFSC		PORTE, 1		    ;CLEAR BUTTON2_INDICATOR (BTN_REG_1 BIT3)
		BSF		BTN_REG_1, 3		;ELSEIF (BUTTON 2) THEN:
		BTFSS		PORTE, 1		    ;SET BUTTON2_INDICATOR (BTN_REG_1 BIT3)
		BCF		BTN_REG_1, 3
		
		BANKSEL PORTC				;IF (NOT JOYBTN 1) THEN:
		BTFSC		PORTC, 1		    ;CLEAR JOYBTN1_INDICATOR (BTN_REG_1 BIT6)
		BSF		BTN_REG_1, 6		;ELSEIF (JOYBTN 1) THEN:
		BTFSS		PORTC, 1		    ;SET JOYBTN1_INDICATOR (BTN_REG_1 BIT6)
		BCF		BTN_REG_1, 6
		
		BANKSEL PORTD
		BTFSC		BTN_REG_1, 0
		BSF		PORTD, 7
		BTFSS		BTN_REG_1, 0
		BCF		PORTD, 7
		
		BANKSEL PORTD
		BTFSC		BTN_REG_1, 1
		BSF		PORTD, 6
		BTFSS		BTN_REG_1, 1
		BCF		PORTD, 6
		
		BANKSEL PORTD
		BTFSC		BTN_REG_1, 2
		BSF		PORTD, 5
		BTFSS		BTN_REG_1, 2
		BCF		PORTD, 5
		
		BANKSEL PORTD
		BTFSC		BTN_REG_1, 3
		BSF		PORTD, 4
		BTFSS		BTN_REG_1, 3
		BCF		PORTD, 4
		
		BANKSEL PORTD
		BTFSC		BTN_REG_1, 4
		BSF		PORTD, 3
		BTFSS		BTN_REG_1, 4
		BCF		PORTD, 3
		
		BANKSEL PORTD
		BTFSC		BTN_REG_1, 5
		BSF		PORTD, 2
		BTFSS		BTN_REG_1, 5
		BCF		PORTD, 2
		
		BANKSEL PORTD
		BCF		PORTD, 1
		BTFSC		BTN_REG_1, 6
		BSF		PORTD, 1
		BTFSC		BTN_REG_1, 7
		BSF		PORTD, 1
		BTFSC		BTN_REG_2, 0
		BSF		PORTD, 1
		BCF		PORTD, 0

		GOTO MAIN
;!!!!!!!!!!!!!!!!!!!!!!!!!!!!!!!!!!!!!!!!!!
EMERGENCY_MODE
;!!!!!!!!!!!!!!!!!!!!!!!!!!!!!!!!!!!!!!!!!!
;		BANKSEL INTCON
;		CLRF		INTCON		    ;DISABLE ALL INTERRUPTS
		BANKSEL TX_CHAR
		MOVLW		0X45		    ;TRANSMIT EMERGENCY STOP CONSTANTLY
		MOVWF		TX_CHAR
		CLRF		TX_VAR1
		CLRF		TX_VAR2
		CLRF		TX_VAR3
		CALL SEND_DATA_PACKET
		BANKSEL PORTD			    ;SET ALL LED INDICATORS HIGH
		MOVLW		0XFF
		MOVWF		PORTD
		GOTO EMERGENCY_MODE
;******************************************
MAIN
;******************************************
		BANKSEL PORTB				;STORE PORTB INTO ROBOT ADDRESS
		MOVFW		PORTB			;CLEAR BIT 7 AS THIS IS A 7-BIT ADDRESS
		MOVWF		RBT_ADDR
		BCF		RBT_ADDR, 7
		
		BANKSEL PORTA				;IF (NOT TRIGGER1) THEN:
		BTFSC		PORTA, 6		    ;CLEAR TRIGGER1_INDICATOR (BTN_REG_1 BIT0)
		BSF		BTN_REG_1, 0		;ELSEIF (TRIGGER1) THEN:
		BTFSS		PORTA, 6		    ;SET TRIGGER1_INDICATOR (BTN_REG_1 BIT0)
		BCF		BTN_REG_1, 0
			
		BANKSEL PORTA				;IF (NOT TRIGGER2) THEN:
		BTFSC		PORTA, 7		    ;CLEAR TRIGGER2_INDICATOR (BTN_REG_1 BIT1)
		BSF		BTN_REG_1, 1		;ELSEIF (TRIGGER1) THEN:
		BTFSS		PORTA, 7		    ;SET TRIGGER2_INDICATOR (BTN_REG_1 BIT1)
		BCF		BTN_REG_1, 1
		
		BANKSEL PORTA				;IF (NOT BUTTON 1) THEN:
		BTFSC		PORTA, 4		    ;CLEAR BUTTON1_INDICATOR (BTN_REG_1 BIT2)
		BSF		BTN_REG_1, 2		;ELSEIF (BUTTON 1) THEN:
		BTFSS		PORTA, 4		    ;SET BUTTON1_INDICATOR (BTN_REG_1 BIT2)
		BCF		BTN_REG_1, 2
		
		BANKSEL PORTE				;IF (NOT BUTTON 2) THEN:
		BTFSC		PORTE, 1		    ;CLEAR BUTTON2_INDICATOR (BTN_REG_1 BIT3)
		BSF		BTN_REG_1, 3		;ELSEIF (BUTTON 2) THEN:
;		BTFSS		PORTE, 1		    ;SET BUTTON2_INDICATOR (BTN_REG_1 BIT3)
;		BCF		BTN_REG_1, 3		:! This section is off for use in toggling function
		
		BANKSEL PORTE				;IF (NOT BUTTON 3) THEN:
		BTFSC		PORTE, 2		    ;CLEAR BUTTON3_INDICATOR (BTN_REG_1 BIT4)
		BSF		BTN_REG_1, 4		;ELSEIF (BUTTON 3) THEN:
		BTFSS		PORTE, 2		    ;SET BUTTON3_INDICATOR (BTN_REG_1 BIT4)
		BCF		BTN_REG_1, 4
		
		BANKSEL PORTC				;IF (NOT BUTTON 4) THEN:
		BTFSC		PORTC, 0		    ;CLEAR BUTTON4_INDICATOR (BTN_REG_1 BIT5)
		BSF		BTN_REG_1, 5		;ELSEIF (BUTTON 4) THEN:
		BTFSS		PORTC, 0		    ;SET BUTTON4_INDICATOR (BTN_REG_1 BIT5)
		BCF		BTN_REG_1, 5	
		
		BANKSEL PORTC				;IF (NOT JOYBTN 1) THEN:
		BTFSC		PORTC, 1		    ;CLEAR JOYBTN1_INDICATOR (BTN_REG_1 BIT6)
		BSF		BTN_REG_1, 6		;ELSEIF (JOYBTN 1) THEN:
;		BTFSS		PORTC, 1		    ;SET JOYBTN1_INDICATOR (BTN_REG_1 BIT6)
;		BCF		BTN_REG_1, 6		:! This section is off for use in toggling function
		
		BANKSEL PORTC				;IF (NOT JOYBTN 2) THEN:
		BTFSC		PORTC, 2		    ;CLEAR JOYBTN2_INDICATOR (BTN_REG_1 BIT7)
		BSF		BTN_REG_1, 7		;ELSEIF (JOYBTN 2) THEN:
		BTFSS		PORTC, 2		    ;SET JOYBTN2_INDICATOR (BTN_REG_1 BIT7)
		BCF		BTN_REG_1, 7
		
		BANKSEL PORTC				;IF (NOT JOYBTN 3) THEN:
		BTFSC		PORTC, 5		    ;CLEAR JOYBTN3_INDICATOR (BTN_REG_2 BIT0)
		BSF		BTN_REG_2, 0		;ELSEIF (JOYBTN 3) THEN:
		BTFSS		PORTC, 5		    ;SET JOYBTN3_INDICATOR (BTN_REG_2 BIT0)
		BCF		BTN_REG_2, 0
		
		BANKSEL PORTB				;IF (NOT MODE SELECT) THEN:
		BTFSC		PORTB, 7		    ;CLEAR MODE_SELECT_INDICATOR (BTN_REG_2 BIT1)
		BSF		BTN_REG_2, 1		;ELSEIF (MODE SELECT) THEN:
		BTFSS		PORTB, 7		    ;SET MODE SELECT (BTN_REG_2 BIT1)
		BCF		BTN_REG_2, 1
		
		BANKSEL BTN_REG_1
		BTFSC		BTN_REG_1, 5		;IF (EMERGENCY BUTTON) THEN:
		GOTO EMERGENCY_MODE			    ;GOTO EMERGENCY MODE
		
		BANKSEL ADCON0				;IF (ADC DONE) THEN:
		BTFSS		ADCON0, 1		    ;CALL CONVERSION_DONE
		CALL CONVERSION_DONE
		
		BANKSEL RX_INFO_REG			;IF (HANDLE DATA INDICATOR) THEN:
		BTFSC		RX_INFO_REG, 6		    ;CALL HANDLE DATA
		CALL HANDLE_RX_DATA
							    
		BANKSEL PORTB				;IF (!MODE SELECT) THEN:
		BTFSS		PORTB, 7		    ;GOTO MODE_1_MAIN
		GOTO MODE_1_MAIN			;ELSEIF (MODE SELECT) THEN:
		BANKSEL PORTB				    ;GOTO MODE_2_MAIN
		BTFSC		PORTB, 7
		GOTO MODE_2_MAIN

		GOTO	MAIN				;LOOP BACK
		END
;********************END PROGRAM DIRECTIVE ***********************************
;*****************************************************************************
