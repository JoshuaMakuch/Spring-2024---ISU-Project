;******************************************************************************
;                                                                             *
;    Filename:	    1789_PERIPHERAL_ADR50.INC				      *
;    Date:	    APRIL 9,  2024                                            *
;    File Version:  1                                                         *
;    Author:        JOSHUA MAKUCH                                             *
;    Company:       Idaho State University                                    *
;    Description:   Source file for the peripheral JVE-S2 LCD SCREEN	      *
;									      *		
;   STARTED APRIL 23, 2024 - CURRENT VERSION IMPLEMENTED		      *
;******************************************************************************
		
;******************************************************************************
;                                                                             *
;    Revision History:                                                        *
;	1: This handles all protocols for peripheral communication for the    *
;	   universal controller JVE-S2 LCD screen.			      *
;									      *
;******************************************************************************	
	    
;*****************************************************
;START OF FILE
;*****************************************************		
		
;*** IDENTIFY_PERIPHERAL_ADR50 ***************
IDENTIFY_PERIPHERAL_ADR50
		
		CALL	I2C_IDLE_ADR50			;ENSURE I2C MODULE IS IDLE
	
		BANKSEL	SSPCON2
		BSF		SSPCON2,SEN		;GENERATE A START CONDITION
		
		CALL I2C_IDLE_ADR50
		
		MOVLW		B'01010000'		;ATTEMPT TO WRITE TO THE PERIPHERAL TO PROBE FOR AN ACKNOWLEDGE
		BANKSEL		SSP1BUF			;"50H - WRITE"
		MOVWF		SSP1BUF
		
		CALL I2C_IDLE_ADR50
		
		BANKSEL SSP1CON2			;IF (ACKNOWLEDGE RECEIVED) THEN:
		BTFSC		SSP1CON2, ACKSTAT	    ;SET PERIPHERAL STATUS INDICATOR (ESTABLISHED COMMS)
		GOTO NEVER_ACKNOWLEDGED_ADR50		;ELSE:					    
		BANKSEL PERI_STATUS			    ;GOTO NEVER_ACKNOWLEDGED_ADR50
		BSF		PERI_STATUS, 1		   
		
		CALL I2C_IDLE_ADR50
		
		CALL TRANSMIT_COMMAND_ADR50		;TRANSMITS INITIAL COMMAND BYTE
		BANKSEL SHRT_TRM_REG			;TRANSMIT '98' SECONDARY COMMAND BYTE
		MOVLW		0X98	
		MOVWF		SHRT_TRM_REG
		CALL TRANSMIT_CHAR_ADR50
		BANKSEL SHRT_TRM_REG			;SET BRIGHTNESS TO MAXIMUM (0-255)
		MOVLW		0XFF	
		MOVWF		SHRT_TRM_REG
		CALL TRANSMIT_CHAR_ADR50
		
		CALL TRANSMIT_COMMAND_ADR50		;TRANSMITS INITIAL COMMAND BYTE
		BANKSEL SHRT_TRM_REG			;CLEAR SCREEN
		MOVLW		0X58			
		MOVWF		SHRT_TRM_REG
		CALL TRANSMIT_CHAR_ADR50
		
		;THIS IS SOMEHOW FASTER THAN DOING A CLEAR SCREEN COMMAND
		CALL TRANSMIT_COMMAND_ADR50		;TRANSMITS INITIAL COMMAND BYTE
		BANKSEL SHRT_TRM_REG			;SET SCREEN CURSOR TO HOME
		MOVLW		0X48			
		MOVWF		SHRT_TRM_REG
		CALL TRANSMIT_CHAR_ADR50
		
		;START LINE*****************************
		BANKSEL SHRT_TRM_REG			;TRANSMIT CHAR 'C'
		MOVLW		'C'			
		MOVWF		SHRT_TRM_REG
		CALL TRANSMIT_CHAR_ADR50
		BANKSEL SHRT_TRM_REG			;TRANSMIT CHAR 'A'
		MOVLW		'A'			
		MOVWF		SHRT_TRM_REG
		CALL TRANSMIT_CHAR_ADR50
		BANKSEL SHRT_TRM_REG			;TRANSMIT CHAR 'N'
		MOVLW		'N'			
		MOVWF		SHRT_TRM_REG
		CALL TRANSMIT_CHAR_ADR50
		BANKSEL SHRT_TRM_REG			;TRANSMIT CHAR '_'
		MOVLW		'_'			
		MOVWF		SHRT_TRM_REG
		CALL TRANSMIT_CHAR_ADR50
		BANKSEL SHRT_TRM_REG			;TRANSMIT CHAR 'X'
		MOVLW		'X'			
		MOVWF		SHRT_TRM_REG
		CALL TRANSMIT_CHAR_ADR50
		BANKSEL SHRT_TRM_REG			;TRANSMIT CHAR ':'
		MOVLW		':'			
		MOVWF		SHRT_TRM_REG
		CALL TRANSMIT_CHAR_ADR50
		BANKSEL SHRT_TRM_REG			;TRANSMIT CHAR ' '
		MOVLW		' '			
		MOVWF		SHRT_TRM_REG
		CALL TRANSMIT_CHAR_ADR50
		BANKSEL SHRT_TRM_REG			;TRANSMIT CHAR ' '
		MOVLW		' '			
		MOVWF		SHRT_TRM_REG
		CALL TRANSMIT_CHAR_ADR50
		BANKSEL SHRT_TRM_REG			;TRANSMIT CHAR ' '
		MOVLW		' '			
		MOVWF		SHRT_TRM_REG
		CALL TRANSMIT_CHAR_ADR50
		BANKSEL SHRT_TRM_REG			;TRANSMIT CHAR 'H'
		MOVLW		'H'			
		MOVWF		SHRT_TRM_REG
		CALL TRANSMIT_CHAR_ADR50
		BANKSEL SHRT_TRM_REG			;TRANSMIT CHAR ' '
		MOVLW		' '			
		MOVWF		SHRT_TRM_REG
		CALL TRANSMIT_CHAR_ADR50
		BANKSEL SHRT_TRM_REG			;TRANSMIT CHAR ' '
		MOVLW		' '			
		MOVWF		SHRT_TRM_REG
		CALL TRANSMIT_CHAR_ADR50
		BANKSEL SHRT_TRM_REG			;TRANSMIT CHAR ' '
		MOVLW		' '			
		MOVWF		SHRT_TRM_REG
		CALL TRANSMIT_CHAR_ADR50
		BANKSEL SHRT_TRM_REG			;TRANSMIT CHAR 'S'
		MOVLW		'S'			
		MOVWF		SHRT_TRM_REG
		CALL TRANSMIT_CHAR_ADR50
		BANKSEL SHRT_TRM_REG			;TRANSMIT CHAR 'P'
		MOVLW		'P'			
		MOVWF		SHRT_TRM_REG
		CALL TRANSMIT_CHAR_ADR50
		BANKSEL SHRT_TRM_REG			;TRANSMIT CHAR 'D'
		MOVLW		'D'			
		MOVWF		SHRT_TRM_REG
		CALL TRANSMIT_CHAR_ADR50
		BANKSEL SHRT_TRM_REG			;TRANSMIT CHAR ':'
		MOVLW		':'			
		MOVWF		SHRT_TRM_REG
		CALL TRANSMIT_CHAR_ADR50
		BANKSEL SHRT_TRM_REG			;TRANSMIT CHAR ' '
		MOVLW		' '			
		MOVWF		SHRT_TRM_REG
		CALL TRANSMIT_CHAR_ADR50
		BANKSEL SHRT_TRM_REG			;TRANSMIT CHAR ' '
		MOVLW		' '			
		MOVWF		SHRT_TRM_REG
		CALL TRANSMIT_CHAR_ADR50
		BANKSEL SHRT_TRM_REG			;TRANSMIT CHAR ' '
		MOVLW		' '			
		MOVWF		SHRT_TRM_REG
		CALL TRANSMIT_CHAR_ADR50
		;NEW LINE ******************************
		BANKSEL SHRT_TRM_REG			;TRANSMIT CHAR 'C'
		MOVLW		'C'			
		MOVWF		SHRT_TRM_REG
		CALL TRANSMIT_CHAR_ADR50
		BANKSEL SHRT_TRM_REG			;TRANSMIT CHAR 'A'
		MOVLW		'A'			
		MOVWF		SHRT_TRM_REG
		CALL TRANSMIT_CHAR_ADR50
		BANKSEL SHRT_TRM_REG			;TRANSMIT CHAR 'N'
		MOVLW		'N'			
		MOVWF		SHRT_TRM_REG
		CALL TRANSMIT_CHAR_ADR50
		BANKSEL SHRT_TRM_REG			;TRANSMIT CHAR '_'
		MOVLW		'_'			
		MOVWF		SHRT_TRM_REG
		CALL TRANSMIT_CHAR_ADR50
		BANKSEL SHRT_TRM_REG			;TRANSMIT CHAR 'Y'
		MOVLW		'Y'			
		MOVWF		SHRT_TRM_REG
		CALL TRANSMIT_CHAR_ADR50
		BANKSEL SHRT_TRM_REG			;TRANSMIT CHAR ':'
		MOVLW		':'			
		MOVWF		SHRT_TRM_REG
		CALL TRANSMIT_CHAR_ADR50
		BANKSEL SHRT_TRM_REG			;TRANSMIT CHAR ' '
		MOVLW		' '			
		MOVWF		SHRT_TRM_REG
		CALL TRANSMIT_CHAR_ADR50
		BANKSEL SHRT_TRM_REG			;TRANSMIT CHAR ' '
		MOVLW		' '			
		MOVWF		SHRT_TRM_REG
		CALL TRANSMIT_CHAR_ADR50
		BANKSEL SHRT_TRM_REG			;TRANSMIT CHAR ' '
		MOVLW		' '			
		MOVWF		SHRT_TRM_REG
		CALL TRANSMIT_CHAR_ADR50
		BANKSEL SHRT_TRM_REG			;TRANSMIT CHAR 'H'
		MOVLW		'H'			
		MOVWF		SHRT_TRM_REG
		CALL TRANSMIT_CHAR_ADR50
		BANKSEL SHRT_TRM_REG			;TRANSMIT CHAR ' '
		MOVLW		' '			
		MOVWF		SHRT_TRM_REG
		CALL TRANSMIT_CHAR_ADR50
		BANKSEL SHRT_TRM_REG			;TRANSMIT CHAR ' '
		MOVLW		' '			
		MOVWF		SHRT_TRM_REG
		CALL TRANSMIT_CHAR_ADR50
		BANKSEL SHRT_TRM_REG			;TRANSMIT CHAR ' '
		MOVLW		' '			
		MOVWF		SHRT_TRM_REG
		CALL TRANSMIT_CHAR_ADR50
		BANKSEL SHRT_TRM_REG			;TRANSMIT CHAR 'B'
		MOVLW		'B'			
		MOVWF		SHRT_TRM_REG
		CALL TRANSMIT_CHAR_ADR50
		BANKSEL SHRT_TRM_REG			;TRANSMIT CHAR 'R'
		MOVLW		'R'			
		MOVWF		SHRT_TRM_REG
		CALL TRANSMIT_CHAR_ADR50
		BANKSEL SHRT_TRM_REG			;TRANSMIT CHAR 'A'
		MOVLW		'A'			
		MOVWF		SHRT_TRM_REG
		CALL TRANSMIT_CHAR_ADR50
		BANKSEL SHRT_TRM_REG			;TRANSMIT CHAR ':'
		MOVLW		':'			
		MOVWF		SHRT_TRM_REG
		CALL TRANSMIT_CHAR_ADR50
		BANKSEL SHRT_TRM_REG			;TRANSMIT CHAR ' '
		MOVLW		' '			
		MOVWF		SHRT_TRM_REG
		CALL TRANSMIT_CHAR_ADR50
		BANKSEL SHRT_TRM_REG			;TRANSMIT CHAR ' '
		MOVLW		' '			
		MOVWF		SHRT_TRM_REG
		CALL TRANSMIT_CHAR_ADR50
		BANKSEL SHRT_TRM_REG			;TRANSMIT CHAR ' '
		MOVLW		' '			
		MOVWF		SHRT_TRM_REG
		BANKSEL SHRT_TRM_REG			;TRANSMIT CHAR ' '
		MOVLW		' '			
		MOVWF		SHRT_TRM_REG
		CALL TRANSMIT_CHAR_ADR50
		;NEW LINE ******************************
		
		BANKSEL SHRT_TRM_REG			;TRANSMIT CHAR '~'
		MOVLW		'~'			
		MOVWF		SHRT_TRM_REG
		CALL TRANSMIT_CHAR_ADR50
		BANKSEL SHRT_TRM_REG			;TRANSMIT CHAR '~'
		MOVLW		'~'			
		MOVWF		SHRT_TRM_REG
		CALL TRANSMIT_CHAR_ADR50
		BANKSEL SHRT_TRM_REG			;TRANSMIT CHAR '~'
		MOVLW		'~'			
		MOVWF		SHRT_TRM_REG
		CALL TRANSMIT_CHAR_ADR50
		BANKSEL SHRT_TRM_REG			;TRANSMIT CHAR '~'
		MOVLW		'~'			
		MOVWF		SHRT_TRM_REG
		CALL TRANSMIT_CHAR_ADR50
		BANKSEL SHRT_TRM_REG			;TRANSMIT CHAR '~'
		MOVLW		'~'			
		MOVWF		SHRT_TRM_REG
		CALL TRANSMIT_CHAR_ADR50
		BANKSEL SHRT_TRM_REG			;TRANSMIT CHAR '~'
		MOVLW		'~'			
		MOVWF		SHRT_TRM_REG
		CALL TRANSMIT_CHAR_ADR50
		BANKSEL SHRT_TRM_REG			;TRANSMIT CHAR '~'
		MOVLW		'~'			
		MOVWF		SHRT_TRM_REG
		CALL TRANSMIT_CHAR_ADR50
		BANKSEL SHRT_TRM_REG			;TRANSMIT CHAR '~'
		MOVLW		'~'			
		MOVWF		SHRT_TRM_REG
		CALL TRANSMIT_CHAR_ADR50
		BANKSEL SHRT_TRM_REG			;TRANSMIT CHAR '~'
		MOVLW		'~'			
		MOVWF		SHRT_TRM_REG
		CALL TRANSMIT_CHAR_ADR50
		BANKSEL SHRT_TRM_REG			;TRANSMIT CHAR '~'
		MOVLW		'~'			
		MOVWF		SHRT_TRM_REG
		CALL TRANSMIT_CHAR_ADR50
		BANKSEL SHRT_TRM_REG			;TRANSMIT CHAR '~'
		MOVLW		'~'			
		MOVWF		SHRT_TRM_REG
		CALL TRANSMIT_CHAR_ADR50
		BANKSEL SHRT_TRM_REG			;TRANSMIT CHAR '~'
		MOVLW		'~'			
		MOVWF		SHRT_TRM_REG
		CALL TRANSMIT_CHAR_ADR50
		BANKSEL SHRT_TRM_REG			;TRANSMIT CHAR '~'
		MOVLW		'~'			
		MOVWF		SHRT_TRM_REG
		CALL TRANSMIT_CHAR_ADR50
		BANKSEL SHRT_TRM_REG			;TRANSMIT CHAR '~'
		MOVLW		'~'			
		MOVWF		SHRT_TRM_REG
		CALL TRANSMIT_CHAR_ADR50
		BANKSEL SHRT_TRM_REG			;TRANSMIT CHAR '~'
		MOVLW		'~'			
		MOVWF		SHRT_TRM_REG
		CALL TRANSMIT_CHAR_ADR50
		BANKSEL SHRT_TRM_REG			;TRANSMIT CHAR '~'
		MOVLW		'~'			
		MOVWF		SHRT_TRM_REG
		CALL TRANSMIT_CHAR_ADR50
		BANKSEL SHRT_TRM_REG			;TRANSMIT CHAR '~'
		MOVLW		'~'			
		MOVWF		SHRT_TRM_REG
		CALL TRANSMIT_CHAR_ADR50
		BANKSEL SHRT_TRM_REG			;TRANSMIT CHAR '~'
		MOVLW		'~'			
		MOVWF		SHRT_TRM_REG
		CALL TRANSMIT_CHAR_ADR50
		BANKSEL SHRT_TRM_REG			;TRANSMIT CHAR '~'
		MOVLW		'~'			
		MOVWF		SHRT_TRM_REG
		CALL TRANSMIT_CHAR_ADR50
		BANKSEL SHRT_TRM_REG			;TRANSMIT CHAR '~'
		MOVLW		'~'			
		MOVWF		SHRT_TRM_REG
		CALL TRANSMIT_CHAR_ADR50
		;NEW LINE *****************************
	
		BANKSEL SHRT_TRM_REG			;TRANSMIT CHAR 'R'
		MOVLW		'R'			
		MOVWF		SHRT_TRM_REG
		CALL TRANSMIT_CHAR_ADR50
		BANKSEL SHRT_TRM_REG			;TRANSMIT CHAR 'O'
		MOVLW		'O'			
		MOVWF		SHRT_TRM_REG
		CALL TRANSMIT_CHAR_ADR50
		BANKSEL SHRT_TRM_REG			;TRANSMIT CHAR 'B'
		MOVLW		'B'			
		MOVWF		SHRT_TRM_REG
		CALL TRANSMIT_CHAR_ADR50
		BANKSEL SHRT_TRM_REG			;TRANSMIT CHAR 'O'
		MOVLW		'O'			
		MOVWF		SHRT_TRM_REG
		CALL TRANSMIT_CHAR_ADR50
		BANKSEL SHRT_TRM_REG			;TRANSMIT CHAR 'T'
		MOVLW		'T'			
		MOVWF		SHRT_TRM_REG
		CALL TRANSMIT_CHAR_ADR50
		BANKSEL SHRT_TRM_REG			;TRANSMIT CHAR ' '
		MOVLW		' '			
		MOVWF		SHRT_TRM_REG
		CALL TRANSMIT_CHAR_ADR50
		BANKSEL SHRT_TRM_REG			;TRANSMIT CHAR 'A'
		MOVLW		'A'			
		MOVWF		SHRT_TRM_REG
		CALL TRANSMIT_CHAR_ADR50
		BANKSEL SHRT_TRM_REG			;TRANSMIT CHAR 'D'
		MOVLW		'D'			
		MOVWF		SHRT_TRM_REG
		CALL TRANSMIT_CHAR_ADR50
		BANKSEL SHRT_TRM_REG			;TRANSMIT CHAR 'D'
		MOVLW		'D'			
		MOVWF		SHRT_TRM_REG
		CALL TRANSMIT_CHAR_ADR50
		BANKSEL SHRT_TRM_REG			;TRANSMIT CHAR 'R'
		MOVLW		'R'			
		MOVWF		SHRT_TRM_REG
		CALL TRANSMIT_CHAR_ADR50
		BANKSEL SHRT_TRM_REG			;TRANSMIT CHAR 'E'
		MOVLW		'E'			
		MOVWF		SHRT_TRM_REG
		CALL TRANSMIT_CHAR_ADR50
		BANKSEL SHRT_TRM_REG			;TRANSMIT CHAR 'S'
		MOVLW		'S'			
		MOVWF		SHRT_TRM_REG
		CALL TRANSMIT_CHAR_ADR50
		BANKSEL SHRT_TRM_REG			;TRANSMIT CHAR 'S'
		MOVLW		'S'			
		MOVWF		SHRT_TRM_REG
		CALL TRANSMIT_CHAR_ADR50
		BANKSEL SHRT_TRM_REG			;TRANSMIT CHAR ':'
		MOVLW		':'			
		MOVWF		SHRT_TRM_REG
		CALL TRANSMIT_CHAR_ADR50
		BANKSEL SHRT_TRM_REG			;TRANSMIT CHAR ' '
		MOVLW		' '			 
		MOVWF		SHRT_TRM_REG
		CALL TRANSMIT_CHAR_ADR50
		BANKSEL SHRT_TRM_REG			;TRANSMIT CHAR ' '
		MOVLW		' '			 
		MOVWF		SHRT_TRM_REG
		CALL TRANSMIT_CHAR_ADR50
		BANKSEL SHRT_TRM_REG			;TRANSMIT CHAR ' '
		MOVLW		' '			 
		MOVWF		SHRT_TRM_REG
		CALL TRANSMIT_CHAR_ADR50
		BANKSEL SHRT_TRM_REG			;TRANSMIT CHAR 'H'
		MOVLW		'H'			
		MOVWF		SHRT_TRM_REG
		CALL TRANSMIT_CHAR_ADR50
		
		BANKSEL SSP1CON2			;GENERATE A STOP CONDITION
		BSF		SSP1CON2, PEN
		
		CALL I2C_IDLE_ADR50
		
		RETURN					;LEAVES PERIPHERAL_ADR50 FILE
		
;*** READ_FROM_PERIPHERAL_ADR50 **************
WRITE_TO_PERIPHERAL_ADR50
		
		CALL	I2C_IDLE_ADR50			;ENSURE I2C MODULE IS IDLE
	
		BANKSEL	SSPCON2
		BSF		SSPCON2,SEN		;GENERATE A START CONDITION
		
		CALL I2C_IDLE_ADR50
		
		MOVLW		B'01010000'		;ATTEMPT TO WRITE TO THE PERIPHERAL TO PROBE FOR AN ACKNOWLEDGE
		BANKSEL		SSP1BUF			;"50H - WRITE"
		MOVWF		SSP1BUF
		
		CALL I2C_IDLE_ADR50
		
		BANKSEL SSP1CON2			;IF (ACKNOWLEDGE RECEIVED) THEN:
		BTFSC		SSP1CON2, ACKSTAT	    ;SET PERIPHERAL STATUS INDICATOR (ESTABLISHED COMMS)
		GOTO NEVER_ACKNOWLEDGED_ADR50		;ELSE:					    
							    ;GOTO NEVER_ACKNOWLEDGED_ADR50
		
		CALL I2C_IDLE_ADR50
		
		CALL TRANSMIT_COMMAND_ADR50		;FIRST COMMAND BYTE
		BANKSEL SHRT_TRM_REG			;SECOND COMMAND BYTE
		MOVLW		0X47			
		MOVWF		SHRT_TRM_REG
		CALL TRANSMIT_CHAR_ADR50
		BANKSEL SHRT_TRM_REG			;SET CURSOR POSITION TO (8, 1)
		MOVLW		D'08'			
		MOVWF		SHRT_TRM_REG
		CALL TRANSMIT_CHAR_ADR50
		BANKSEL SHRT_TRM_REG			
		MOVLW		D'01'			
		MOVWF		SHRT_TRM_REG
		CALL TRANSMIT_CHAR_ADR50
	
		BANKSEL TX_DATA_43H_VAR1		;TRANSMIT CHAR 'UPPER NIBBLE OF ENCODER 1'
		MOVLW		B'11110000'
		ANDWF		TX_DATA_43H_VAR1, 0
		MOVWF		SHRT_TRM_REG
		LSRF		SHRT_TRM_REG, 1
		LSRF		SHRT_TRM_REG, 1
		LSRF		SHRT_TRM_REG, 1
		LSRF		SHRT_TRM_REG, 1
		MOVLW		D'048'
		ADDWF		SHRT_TRM_REG, 1
		CALL TRANSMIT_CHAR_ADR50
		
		BANKSEL TX_DATA_43H_VAR1		;TRANSMIT CHAR 'LOWER NIBBLE OF ENCODER 1'
		MOVLW		B'00001111'
		ANDWF		TX_DATA_43H_VAR1, 0
		MOVWF		SHRT_TRM_REG
		MOVLW		D'048'
		ADDWF		SHRT_TRM_REG, 1
		CALL TRANSMIT_CHAR_ADR50
	
		CALL TRANSMIT_COMMAND_ADR50		;FIRST COMMAND BYTE
		BANKSEL SHRT_TRM_REG			;SECOND COMMAND BYTE
		MOVLW		0X47			
		MOVWF		SHRT_TRM_REG
		CALL TRANSMIT_CHAR_ADR50
		BANKSEL SHRT_TRM_REG			;SET CURSOR POSITION TO (19, 1)
		MOVLW		D'019'			
		MOVWF		SHRT_TRM_REG
		CALL TRANSMIT_CHAR_ADR50
		BANKSEL SHRT_TRM_REG			
		MOVLW		D'01'			
		MOVWF		SHRT_TRM_REG
		CALL TRANSMIT_CHAR_ADR50
		
		BANKSEL INFO_REG			;IF (TOGGLE_SPEED_STATE OR HARD_STOP_INDICATOR) THEN:
		MOVLW		'N'			    ;TRANSMIT CHAR 'Y'
		BTFSC		INFO_REG, 4		;ELSE:
		MOVLW		'Y'			    ;TRANSMIT CHAR 'N'
		MOVWF		SHRT_TRM_REG
		CALL TRANSMIT_CHAR_ADR50
		
		CALL TRANSMIT_COMMAND_ADR50		;FIRST COMMAND BYTE
		BANKSEL SHRT_TRM_REG			;SECOND COMMAND BYTE
		MOVLW		0X47			
		MOVWF		SHRT_TRM_REG
		CALL TRANSMIT_CHAR_ADR50
		BANKSEL SHRT_TRM_REG			;SET CURSOR POSITION TO (8, 2)
		MOVLW		D'08'			
		MOVWF		SHRT_TRM_REG
		CALL TRANSMIT_CHAR_ADR50
		BANKSEL SHRT_TRM_REG			
		MOVLW		D'02'			
		MOVWF		SHRT_TRM_REG
		CALL TRANSMIT_CHAR_ADR50
	
		BANKSEL TX_DATA_43H_VAR2		;TRANSMIT CHAR 'UPPER NIBBLE OF ENCODER 2'
		MOVLW		B'11110000'
		ANDWF		TX_DATA_43H_VAR2, 0
		MOVWF		SHRT_TRM_REG
		LSRF		SHRT_TRM_REG, 1
		LSRF		SHRT_TRM_REG, 1
		LSRF		SHRT_TRM_REG, 1
		LSRF		SHRT_TRM_REG, 1
		MOVLW		D'048'
		ADDWF		SHRT_TRM_REG, 1
		CALL TRANSMIT_CHAR_ADR50
		
		BANKSEL TX_DATA_43H_VAR2		;TRANSMIT CHAR 'LOWER NIBBLE OF ENCODER 2'
		MOVLW		B'00001111'
		ANDWF		TX_DATA_43H_VAR2, 0
		MOVWF		SHRT_TRM_REG
		MOVLW		D'048'
		ADDWF		SHRT_TRM_REG, 1
		CALL TRANSMIT_CHAR_ADR50
		
		CALL TRANSMIT_COMMAND_ADR50		;FIRST COMMAND BYTE
		BANKSEL SHRT_TRM_REG			;SECOND COMMAND BYTE
		MOVLW		0X47			
		MOVWF		SHRT_TRM_REG
		CALL TRANSMIT_CHAR_ADR50
		BANKSEL SHRT_TRM_REG			;SET CURSOR POSITION TO (19, 2)
		MOVLW		D'019'			
		MOVWF		SHRT_TRM_REG
		CALL TRANSMIT_CHAR_ADR50
		BANKSEL SHRT_TRM_REG			
		MOVLW		D'02'			
		MOVWF		SHRT_TRM_REG
		CALL TRANSMIT_CHAR_ADR50
		
		BANKSEL INFO_REG			;IF (LOCK_BRAKES_INDICATOR OR HARD_STOP_INDICATOR) THEN:
		MOVLW		'N'			    ;TRANSMIT CHAR 'Y'
		BTFSC		INFO_REG, 5		;ELSE:
		MOVLW		'Y'			    ;TRANSMIT CHAR 'N'
		BTFSC		INFO_REG, 6		
		MOVLW		'Y'			    
		MOVWF		SHRT_TRM_REG
		CALL TRANSMIT_CHAR_ADR50
		
		CALL TRANSMIT_COMMAND_ADR50		;FIRST COMMAND BYTE
		BANKSEL SHRT_TRM_REG			;SECOND COMMAND BYTE
		MOVLW		0X47			
		MOVWF		SHRT_TRM_REG
		CALL TRANSMIT_CHAR_ADR50
		BANKSEL SHRT_TRM_REG			;SET CURSOR POSITION TO (16, 4)
		MOVLW		D'016'			
		MOVWF		SHRT_TRM_REG
		CALL TRANSMIT_CHAR_ADR50
		BANKSEL SHRT_TRM_REG			
		MOVLW		D'04'			
		MOVWF		SHRT_TRM_REG
		CALL TRANSMIT_CHAR_ADR50
		
		BANKSEL RBT_ADDR				;TRANSMIT CHAR 'UPPER NIBBLE OF ROBOT ADDRESS'
		MOVLW		B'11110000'
		ANDWF		RBT_ADDR, 0
		MOVWF		SHRT_TRM_REG
		LSRF		SHRT_TRM_REG, 1
		LSRF		SHRT_TRM_REG, 1
		LSRF		SHRT_TRM_REG, 1
		LSRF		SHRT_TRM_REG, 1
		MOVLW		D'048'
		ADDWF		SHRT_TRM_REG, 1
		CALL TRANSMIT_CHAR_ADR50
		
		BANKSEL RBT_ADDR				;TRANSMIT CHAR 'LOWER NIBBLE OF ROBOT ADDRESS'
		MOVLW		B'00001111'
		ANDWF		RBT_ADDR, 0
		MOVWF		SHRT_TRM_REG
		MOVLW		D'048'
		ADDWF		SHRT_TRM_REG, 1
		CALL TRANSMIT_CHAR_ADR50
		
		BANKSEL SSP1CON2			;GENERATE A STOP CONDITION
		BSF		SSP1CON2, PEN
		
		CALL I2C_IDLE_ADR50
		
		RETURN					;LEAVES PERIPHERAL_ADR50 FILE
;*** NEVER_ACKNOWLEDGED_ADR50 ***************
NEVER_ACKNOWLEDGED_ADR50
		
		BANKSEL PERI_STATUS			;CLEAR PERIPHERAL STATUS INDICATOR (LOSS/LACK OF COMMUNICATION)
		BCF		PERI_STATUS, 1
		
		CALL I2C_IDLE_ADR50
		
		BANKSEL SSP1CON2			;GENERATE A STOP CONDITION
		BSF		SSP1CON2, PEN
		
		CALL I2C_IDLE_ADR50
		
		RETURN					;LEAVES PERIPHERAL_ADR50 FILE
		
;********************************************
;FILE SPECIFIC SUBROUTINES
;********************************************
		
;*** I2C_IDLE_ADR50 *************************
I2C_IDLE_ADR50
		BANKSEL PORTD				;SET A TROUBLESHOOTING INDICATOR INCASE THE MASTER GETS STUCK
		BSF		PORTD, 5
		BANKSEL PIR1
		BCF		PIR1, SSP1IF
I2C_IDLE_INNER_ADR50
		MOVLW 	B'00001111'			; Load Bus Test Value
		BANKSEL	SSPCON2		
		ANDWF		SSPCON2, 0		; Compare 1F to check for 5 busy conditions
		BANKSEL	STATUS
		BTFSS		STATUS,Z		;Test Zero Bit
		GOTO 		I2C_IDLE_INNER_ADR50	;Z=0  Bus is still busy -repeat
CHECKR_W_ADR50						;Z=1 Not Busy
		BANKSEL	SSP1STAT
		BTFSC 		SSP1STAT, R_NOT_W	; see if SSP is transmitting data
		GOTO 		CHECKR_W_ADR50		;R_W = 1 - Still transmitting data
		BANKSEL PORTD				;R_W = 0 - Transmit done
		BCF		PORTD, 5    
		RETURN				
;*** TRANSMIT_CHAR_ADR50 ********************
TRANSMIT_CHAR_ADR50
		CALL I2C_IDLE_ADR50			;ENSURE I2C LINE IS IDLE	
							
		BANKSEL SHRT_TRM_REG			;MOVE SHRT_TRM_REG TO SSP1BUF AND TRANSMIT
		MOVFW		SHRT_TRM_REG
		BANKSEL SSP1BUF				
		MOVWF		SSP1BUF		
							
		CALL I2C_IDLE_ADR50			;ENSURE I2C LINE IS IDLE
	
		RETURN
;*** TRANSMIT_CHAR_ADR50 ********************
TRANSMIT_COMMAND_ADR50
		CALL I2C_IDLE_ADR50			;ENSURE I2C LINE IS IDLE	
							
		MOVLW		0XFE			;TRANSMIT BASIC COMMAND BYTE H'FE' / D'254'
		BANKSEL SSP1BUF				
		MOVWF		SSP1BUF		
							
		CALL I2C_IDLE_ADR50			;ENSURE I2C LINE IS IDLE
	
		RETURN
;********************************************
		
		