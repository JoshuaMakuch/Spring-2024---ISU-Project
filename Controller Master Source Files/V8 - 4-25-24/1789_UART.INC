;******************************************************************************
;                                                                             *
;    Filename:	    1789_UART.INC				              *
;    Date:	    APRIL 19, 2023                                            *
;    File Version:  1                                                         *
;    Author:        JOSHUA MAKUCH                                             *
;    Company:       Idaho State University                                    *
;    Description:   FIRMWARE FOR SETTING UP THE CONTROLLER FOR		      *
;		    DRIVING THE MINIATV					      *
;		                                                              *
;******************************************************************************

;******************************************************************************
;                                                                             *
;    Revision History:                                                        *
;	1: TRANSFERED ALL UART COMMUNICATION SUBROUTINES TO THIS FILE FOR     *					      
;	   FOR EASE OF READING						      *
;		                                                              *
;******************************************************************************
    
;******************************************************************************
;START OF FILE
;******************************************************************************
		
;********************************************
;SEND SUBROUTINES
;********************************************	
    
;*** TX_SEND_MOVE_FORWARD *******************		
TX_SEND_MOVE_FORWARD		

		BANKSEL TX_CHAR				;TRANSMIT MOVE FORWARD ('F')
		MOVLW		0X46			
		MOVWF		TX_CHAR
		MOVFW		TX_DATA_46H_VAR1
		MOVWF		TX_VAR1
		CLRF		TX_VAR2
		CLRF		TX_VAR3
		CALL SEND_DATA_PACKET
		
		RETURN
;*** TX_SEND_MOVE_BACK **********************
TX_SEND_MOVE_BACK		

		BANKSEL TX_CHAR				;TRANSMIT MOVE BACKWARD  ('B')
		MOVLW		0X42			
		MOVWF		TX_CHAR
		MOVFW		TX_DATA_42H_VAR1
		MOVWF		TX_VAR1
		CLRF		TX_VAR2
		CLRF		TX_VAR3
		CALL SEND_DATA_PACKET
		
		RETURN    
;*** TX_SEND_TURN ***************************		
TX_SEND_TURN		

		BANKSEL TX_CHAR				;TRANSMIT TURN ('T')
		MOVLW		0X54			
		MOVWF		TX_CHAR
		MOVFW		TX_DATA_54H_VAR1
		MOVWF		TX_VAR1
		MOVFW		TX_DATA_54H_VAR2
		MOVWF		TX_VAR2
		CLRF		TX_VAR3
		CALL SEND_DATA_PACKET
		
		RETURN    
;*** TX_SEND_ALTERNATE_TURN *****************		
TX_SEND_ALTERNATE_TURN		

		BANKSEL TX_CHAR				;TRANSMIT ALTERNATE TURN ('t')
		MOVLW		0X74			
		MOVWF		TX_CHAR
		MOVFW		TX_DATA_74H_VAR1
		MOVWF		TX_VAR1
		CLRF		TX_VAR2
		CLRF		TX_VAR3
		CALL SEND_DATA_PACKET
		
		RETURN    
;*** TX_SEND_STOP ***************************		
TX_SEND_STOP		
		BANKSEL TX_CHAR
		MOVLW		0X53			;TRANSMIT STOP ('S')
		MOVWF		TX_CHAR
		CLRF		TX_VAR1
		CLRF		TX_VAR2
		CLRF		TX_VAR3
		CALL SEND_DATA_PACKET			
		
		;BANKSEL INFO_REG
		;BCF		INFO_REG, 7		;CLEAR COAST INDICATOR (INFO_REG, 7)
		
		RETURN        
;*** TX_SEND_HARD_STOP **********************		
TX_SEND_HARD_STOP		
		BANKSEL TX_CHAR
		MOVLW		0X48			;TRANSMIT HARD STOP ('H')
		MOVWF		TX_CHAR
		CLRF		TX_VAR1
		CLRF		TX_VAR2
		CLRF		TX_VAR3
		CALL SEND_DATA_PACKET
		
		;BANKSEL INFO_REG
		;BCF		INFO_REG, 7		;CLEAR COAST INDICATOR (INFO_REG, 7)
		
		RETURN        
;*** TX_SEND_EMERGENCY_STOP *****************		
TX_SEND_EMERGENCY_STOP		

		BANKSEL TX_CHAR				;TRANSMIT EMERGENCY STOP ('45')
		MOVLW		0X45			
		MOVWF		TX_CHAR
		CLRF		TX_VAR1
		CLRF		TX_VAR2
		CLRF		TX_VAR3
		CALL SEND_DATA_PACKET
		
		RETURN        
;*** TX_SEND_STATUS_UPDATE ******************		
TX_SEND_STATUS_UPDATE		

		BANKSEL TX_CHAR				;TRANSMIT STATUS UPDATE ('U')
		MOVLW		0X56			
		MOVWF		TX_CHAR
		CLRF		TX_VAR1
		CLRF		TX_VAR2
		CLRF		TX_VAR3
		CALL SEND_DATA_PACKET
		
		RETURN        
;*** TX_SEND_INITIALIZE *********************		
TX_SEND_INITIALIZE		

		BANKSEL TX_CHAR				;TRANSMIT INITIALIZE ('49')
		MOVLW		0X49			
		MOVWF		TX_CHAR
		CLRF		TX_VAR1
		CLRF		TX_VAR2
		CLRF		TX_VAR3
		CALL SEND_DATA_PACKET
		
		RETURN        
;*** TX_SEND_MANIPULATOR ********************		
TX_SEND_MANIPULATOR		

		BANKSEL TX_CHAR				;TRANSMIT MANIPULATOR ('M')
		MOVLW		0X4D			
		MOVWF		TX_CHAR
		MOVFW		TX_DATA_4DH_VAR1
		MOVWF		TX_VAR1
		MOVFW		TX_DATA_4DH_VAR2
		MOVWF		TX_VAR2
		MOVFW		TX_DATA_4DH_VAR3
		MOVWF		TX_VAR3
		CALL SEND_DATA_PACKET
		
		RETURN        
;*** TX_SEND_DRIVE_MODE *********************		
TX_SEND_DRIVE_MODE		

		BANKSEL TX_CHAR				;TRANSMIT DRIVE MODE ('D')
		MOVLW		0X44			
		MOVWF		TX_CHAR
		MOVFW		TX_DATA_44H_VAR1
		MOVWF		TX_VAR1
		CLRF		TX_VAR2
		CLRF		TX_VAR3
		CALL SEND_DATA_PACKET
		
		RETURN        
;*** TX_SEND_LOCK_BREAKS ********************		
TX_SEND_LOCK_BRAKES
		
		BANKSEL TX_CHAR				;TRANSMIT LOCK BRAKES ('L')
		MOVLW		0X4C		
		MOVWF		TX_CHAR
		MOVFW		TX_DATA_44H_VAR1
		MOVWF		TX_VAR1
		CLRF		TX_VAR2
		CLRF		TX_VAR3
		CALL SEND_DATA_PACKET

		RETURN        
;*** TX_SEND_PERIPHERAL_INTERFACE ***********		
TX_SEND_PERIPHERAL_INTERFACE		

		BANKSEL TX_CHAR				;TRANSMIT PERIPHERAL INTERFACE ('P')
		MOVLW		0X50			
		MOVWF		TX_CHAR
		MOVFW		TX_DATA_50H_VAR1
		MOVWF		TX_VAR1
		MOVFW		TX_DATA_50H_VAR2
		MOVWF		TX_VAR2
		MOVFW		TX_DATA_50H_VAR3
		MOVWF		TX_VAR3
		CALL SEND_DATA_PACKET
		
		RETURN        
;*** TX_SEND_CANNON_X_AXIS_AND_Y_AXIS *******	
TX_SEND_CANNON_X_AXIS_AND_Y_AXIS
		
		BANKSEL TX_CHAR			;TRANSMIT CANNON X-AXIS AND Y-AXIS ('C')
		MOVLW		0X43			
		MOVWF		TX_CHAR
		MOVFW		TX_DATA_43H_VAR1
		MOVWF		TX_VAR1
		MOVFW		TX_DATA_43H_VAR2
		MOVWF		TX_VAR2
		CLRF		TX_VAR3
		CALL SEND_DATA_PACKET
		
		;BANKSEL TX_CHAR				;TRANSMIT CANNON X-AXIS AND Y-AXIS ('C')
		;MOVLW		0X43			;TRANSMITS JOY3LR/JOY3UD
		;MOVWF		TX_CHAR
		;MOVFW		JOY3LR
		;MOVWF		TX_VAR1
		;MOVFW		JOY3UD		    
		;MOVWF		TX_VAR2
		;CLRF		TX_VAR3
		;CALL SEND_DATA_PACKET
		
		RETURN        
;*** TX_SEND_CANNON_MECHANISM ***************		
TX_SEND_CANNON_MECHANISM		

		BANKSEL TX_CHAR				;TRANSMIT CANNON MECHANISM ('c')
		MOVLW		0X63			
		MOVWF		TX_CHAR
		MOVFW		TX_DATA_63H_VAR1
		MOVWF		TX_VAR1
		MOVFW		TX_DATA_63H_VAR2
		MOVWF		TX_VAR2
		CLRF		TX_VAR3
		CALL SEND_DATA_PACKET
		
		RETURN        
;********************************************
		
;********************************************
;UART FUNDAMENTAL SUBROUTINES
;********************************************	
		
;*** HANDLE_RX_DATA *************************
HANDLE_RX_DATA
		
		;THIS PORTION IS FOR TROUBLESHOOTING.
		;IN THE EVENT OF A LOCK BRAKES WITH TIED RX&TX LINES,
		;THIS CONDITION WILL OCCUR.
		
		BANKSEL RX_CHAR			    ;IF (RX_CHAR) = LOCK BRAKES THEN:
		MOVLW		0X4C			;CONTINUE
		XORWF		RX_CHAR		    ;ELSE
		BANKSEL STATUS				;GOTO DONE_HANDLING_RX_DATA
		BTFSS		STATUS, Z
		GOTO DONE_HANDLING_RX_DATA
		
		DONE_HANDLING_RX_DATA
		BANKSEL RX_HS
		CLRF		RX_HS		    ;CLEAR ALL RX VARIABLES
		CLRF		RX_ADDR
		CLRF		RX_CHAR
		CLRF		RX_VAR1
		CLRF		RX_VAR2
		CLRF		RX_VAR3

		BANKSEL RX_INFO_REG		    ;CLEAR HANDLING DATA INDICATOR
		BCF		RX_INFO_REG, 6
		
		RETURN	
;*** REC_BYTE *******************************
REC_BYTE
		BANKSEL RCREG				;STORE RCREG INTO NEWEST_BYTE
		MOVFW		RCREG
		BANKSEL NEWEST_BYTE
		MOVWF		NEWEST_BYTE
		
		BANKSEL RX_INFO_REG			;IF (HANDLING DATA) THEN:
		BTFSC		RX_INFO_REG, 6		    ;RETURN
		RETURN					
		
		BANKSEL RX_INFO_REG
		BTFSC		RX_INFO_REG, 7		;IF (CURRENTLY STORING DATA) THEN:
		GOTO $ + D'11'				    ;GOTO $ + 11	    					    
		MOVLW		H'024'			;ELSE
		XORWF		NEWEST_BYTE, 0		    ;IF (NEWEST_BYTE = $) THEN:
		BANKSEL STATUS					;SET RX_INFO_REG COUNT TO 1
		BTFSS		STATUS, Z			;INDICATE CURRENTLY STORING DATA
		RETURN					    ;ELSE:	
		BANKSEL RX_INFO_REG				;RETURN	
		MOVLW		B'11111000'
		ANDWF		RX_INFO_REG, 1
		INCF		RX_INFO_REG, 1
		BSF		RX_INFO_REG, 7
		
							;SELECT CASE (RX_INFO_REG_COUNT):
		BANKSEL RX_INFO_REG
		MOVLW		B'00000111'		    ;CASE 1
		ANDWF		RX_INFO_REG, 0			;STORE NEWEST_BYTE INTO RX_HS
		MOVWF		SHRT_TRM_REG_INT
		MOVLW		B'00000001'
		XORWF		SHRT_TRM_REG_INT, 0
		BANKSEL STATUS
		BTFSS		STATUS, Z
		GOTO $ + 4
		BANKSEL NEWEST_BYTE
		MOVFW		NEWEST_BYTE
		MOVWF		RX_HS
		
		BANKSEL RX_INFO_REG
		MOVLW		B'00000111'		    ;CASE 2
		ANDWF		RX_INFO_REG, 0			;STORE NEWEST_BYTE INTO RX_ADDR
		MOVWF		SHRT_TRM_REG_INT
		MOVLW		B'00000010'
		XORWF		SHRT_TRM_REG_INT, 0
		BANKSEL STATUS
		BTFSS		STATUS, Z
		GOTO $ + 4
		BANKSEL NEWEST_BYTE
		MOVFW		NEWEST_BYTE
		MOVWF		RX_ADDR
		
		BANKSEL RX_INFO_REG
		MOVLW		B'00000111'		    ;CASE 3
		ANDWF		RX_INFO_REG, 0			;STORE NEWEST_BYTE INTO RX_CHAR
		MOVWF		SHRT_TRM_REG_INT
		MOVLW		B'00000011'
		XORWF		SHRT_TRM_REG_INT, 0
		BANKSEL STATUS
		BTFSS		STATUS, Z
		GOTO $ + 4
		BANKSEL NEWEST_BYTE
		MOVFW		NEWEST_BYTE
		MOVWF		RX_CHAR
		
		BANKSEL RX_INFO_REG
		MOVLW		B'00000111'		    ;CASE 4
		ANDWF		RX_INFO_REG, 0			;STORE NEWEST_BYTE INTO RX_VAR1
		MOVWF		SHRT_TRM_REG_INT
		MOVLW		B'00000100'
		XORWF		SHRT_TRM_REG_INT, 0
		BANKSEL STATUS
		BTFSS		STATUS, Z
		GOTO $ + 4
		BANKSEL NEWEST_BYTE
		MOVFW		NEWEST_BYTE
		MOVWF		RX_VAR1
		
		BANKSEL RX_INFO_REG
		MOVLW		B'00000111'		    ;CASE 5
		ANDWF		RX_INFO_REG, 0			;STORE NEWEST_BYTE INTO RX_VAR2
		MOVWF		SHRT_TRM_REG_INT
		MOVLW		B'00000101'
		XORWF		SHRT_TRM_REG_INT, 0
		BANKSEL STATUS
		BTFSS		STATUS, Z
		GOTO $ + 4
		BANKSEL NEWEST_BYTE
		MOVFW		NEWEST_BYTE
		MOVWF		RX_VAR2
		
		BANKSEL RX_INFO_REG
		MOVLW		B'00000111'		    ;CASE 6
		ANDWF		RX_INFO_REG, 0			;STORE NEWEST_BYTE INTO RX_VAR3
		MOVWF		SHRT_TRM_REG_INT
		MOVLW		B'00000110'
		XORWF		SHRT_TRM_REG_INT, 0
		BANKSEL STATUS
		BTFSS		STATUS, Z
		GOTO $ + 4
		BANKSEL NEWEST_BYTE
		MOVFW		NEWEST_BYTE
		MOVWF		RX_VAR3
		
							;END CASE 
		
		BANKSEL RX_INFO_REG			;INCREMENT RX_INFO_REG COUNT
		INCF		RX_INFO_REG		    
		
		BANKSEL RX_INFO_REG
		MOVLW		B'00000111'		    ;IF (RX_INFO_REG COUNT = 7) THEN:
		ANDWF		RX_INFO_REG, 0			;SET HANDLING DATA INDICATOR
		MOVWF		SHRT_TRM_REG_INT		;CLEAR STORING DATA INDICATOR
		MOVLW		B'00000111'
		XORWF		SHRT_TRM_REG_INT, 0
		BANKSEL STATUS
		BTFSC		STATUS, Z
		BSF		RX_INFO_REG, 6
		BTFSC		STATUS, Z
		BCF		RX_INFO_REG, 7
		
		BANKSEL PIR1				;CLEAR RECEIVED BYTE FLAG
		BCF		PIR1, RCIF
		
		RETURN					
;*** SEND_DATA_PACKET **********************************
SEND_DATA_PACKET
		BANKSEL PIR1				
		BCF		PIR1, TMR2IF		;TMR2 INTERRUPT FLAG RESET
		BANKSEL PIE1				
		BSF		PIE1, TMR2IE		;ENABLE TMR2 INTERRUPT
		
		BANKSEL INFO_REG
		BTFSS		INFO_REG, 3
		GOTO $ - 2
		
		BANKSEL		TXSTA
		BTFSS		TXSTA, TRMT		;TEST IF THE TRANMIT SHIFT REGISTER IS EMPTY, IF IT IS, DON'T RETURN	
		GOTO $ - 2
		;HANDSHAKE TX
		BANKSEL TXREG
		MOVLW		H'024'			;MOVE A '$' TO WORKING
		MOVWF		TXREG			;MOVE WORKING TO TRANSMIT REGISTER	
		BANKSEL TXSTA
		BTFSS		TXSTA, TRMT		;TEST IF THE TRANSMIT SHIFT REGISTER IS EMPTY, IF IT IS, LOOP BACK
		GOTO $ - 2
		;ROBOT ADDRESS TX
		BANKSEL RBT_ADDR
		MOVFW		RBT_ADDR			;MOVE THE ROBOT ADDRESS TO WORKING
		BANKSEL TXREG				;MOVE WORKING TO TRANSMIT REGISTER
		MOVWF		TXREG
		BANKSEL TXSTA
		BTFSS		TXSTA, TRMT		;TEST IF THE TRANSMIT SHIFT REGISTER IS EMPTY, IF IT IS, LOOP BACK
		GOTO $ - 2
		;CHARACTER TX
		BANKSEL TX_CHAR
		MOVFW		TX_CHAR			;MOVE THE COMMAND CHARACTER TO WORKING
		BANKSEL TXREG				;MOVE WORKING TO TRANSMIT REGISTER
		MOVWF		TXREG
		BANKSEL TXSTA
		BTFSS		TXSTA, TRMT		;TEST IF THE TRANSMIT SHIFT REGISTER IS EMPTY, IF IT IS, LOOP BACK
		GOTO $ - 2
		;VARIABLE 1 TX
		BANKSEL TX_VAR1
		MOVFW		TX_VAR1			;MOVE THE VARIABLE 1 TO WORKING
		BANKSEL TXREG				;MOVE WORKING TO TRANSMIT REGISTER
		MOVWF		TXREG
		BANKSEL TXSTA
		BTFSS		TXSTA, TRMT		;TEST IF THE TRANSMIT SHIFT REGISTER IS EMPTY, IF IT IS, LOOP BACK
		GOTO $ - 2
		;VARIABLE 2 TX
		BANKSEL TX_VAR2
		MOVFW		TX_VAR2			;MOVE THE VARIABLE 2 TO WORKING
		BANKSEL TXREG				;MOVE WORKING TO TRANSMIT REGISTER
		MOVWF		TXREG
		BANKSEL TXSTA
		BTFSS		TXSTA, TRMT		;TEST IF THE TRANSMIT SHIFT REGISTER IS EMPTY, IF IT IS, LOOP BACK
		GOTO $ - 2
		;VARIABLE 3 TX
		BANKSEL TX_VAR3
		MOVFW		TX_VAR3			;MOVE THE VARIABLE 3 TO WORKING
		BANKSEL TXREG				;MOVE WORKING TO TRANSMIT REGISTER
		MOVWF		TXREG
		BANKSEL TXSTA
		BTFSS		TXSTA, TRMT		;TEST IF THE TRANSMIT SHIFT REGISTER IS EMPTY, IF IT IS, LOOP BACK
		GOTO $ - 2
		
		BANKSEL INFO_REG
		BCF		INFO_REG, 3
		
		BANKSEL PIR1				
		BCF		PIR1, TMR2IF		;TMR2 INTERRUPT FLAG RESET
		BANKSEL PIE1				
		BCF		PIE1, TMR2IE		;DISABLE TMR2 INTERRUPT
		
		RETURN								    
;********************************************
		