;******************************************************************************
;                                                                             *
;    Filename:	    MiniATV_Controller_Master_Code.asm			      *
;    Date:	    November 9, 2023                                         *
;    File Version:  2                                                         *
;    Author:        Joshua Makuch                                             *
;    Company:       Idaho State University                                    *
;    Description:   Firmware for runing the Master PIC for the MiniATV	      *
;		    Controller						      *
;		                                                              *
;******************************************************************************
;******************************************************************************
;                                                                             *
;    Revision History:                                                        *
;	1: Basic setup for the PIC16LF1789. Test program for the dev board    *
;	   increments portb to indicate that the 1789 was soldered correctly  *
;	2: This version will now have 3 joysticks, 7 buttons, 2 triggers,     *
;          a mode select switch, robot address dip switch package, and	      *
;	   several LED indicators.					      *
;									      *
;	    STARTED NOV 9 2023 -					      *
;                                                                             *
;******************************************************************************
	

	LIST	    p=16LF1789
	INCLUDE	    P16LF1789.INC
	INCLUDE	    1789_SETUP.INC
	
	; CONFIG1
; __config 0xEFE4
 __CONFIG _CONFIG1, _FOSC_INTOSC & _WDTE_OFF & _PWRTE_OFF & _MCLRE_ON & _CP_OFF & _CPD_OFF & _BOREN_OFF & _CLKOUTEN_OFF & _IESO_OFF & _FCMEN_OFF
; CONFIG2
; __config 0xFFFF
 __CONFIG _CONFIG2, _WRT_OFF  & _PLLEN_OFF & _STVREN_ON & _BORV_LO & _LPBOR_OFF & _LVP_ON

    ;suppress "not in bank 0" message,  Found label after column 1,
    errorlevel -302,-207,-305,-206,-203			
							
;******************************************		
;ORIGIN VECTORS & SETUP
;******************************************
		ORG 	H'000'					
 		GOTO 	SETUP				;RESET CONDITION GOTO SETUP
		ORG	H'004'
		GOTO	INTERUPT
SETUP
		CALL	INITIALIZE			;CALLS THE SETUP FILE 1788_SETUP.INC
		GOTO	MAIN
;******************************************
;INTERUPT SERVICE ROUTINE 
;******************************************
INTERUPT
		BANKSEL W_SAVE
		MOVWF		W_SAVE			;SAVE WORKING REGISTER CONTENTS
		BANKSEL	STATUS
		MOVFW		STATUS
		MOVWF		STATUS_SAVE		;SAVES STATUS REGISTER CONTENTS
		
		BANKSEL PIR1
		BTFSC	PIR1, TMR2IF			;IF TIMER2 INTERRUPT FLAG, THEN HANDLE TIMER COUNT
		CALL HANDLE_T2_INT
		
		BANKSEL STATUS_SAVE			;RECALL STATUS REGISTER CONTENTS
		MOVFW		STATUS_SAVE
		MOVWF		STATUS			;RESTORE STATUS REGISTER CONTENTS
		BANKSEL W_SAVE				
		MOVFW		W_SAVE			;RESTORE WORKING REGISTER CONTENTS
		
		RETFIE					;RETURN AND RESET INTERRUPT ENABLE BITS
;******************************************
;  SUBROUTINES
;******************************************
;*** HANDLE T2_INT *************************************
HANDLE_T2_INT
		
		BANKSEL PIR1				;PG.36
		BCF		PIR1, TMR2IF		;TMR2 INTERRUPT FLAG RESET
		
		BANKSEL TMR_CNT
		DECFSZ	TMR_CNT				;IF ? COUNTS OF TMR_CNT HAS OCCURED, RESET THE COUNT
		RETURN
		
		MOVLW		D'020'
		MOVWF		TMR_CNT
		
		RETURN
;*** STORE_JOY3LR **************************************
STORE_JOY3LR
		BANKSEL ADC_RESULT
		MOVFW		ADC_RESULT
		MOVWF		JOY3LR
		RETURN
;*** STORE_JOY3UD **************************************
STORE_JOY3UD
		BANKSEL ADC_RESULT
		MOVFW		ADC_RESULT
		MOVWF		JOY3UD
		RETURN
;*** STORE_JOY2LR **************************************
STORE_JOY2LR
		BANKSEL ADC_RESULT
		MOVFW		ADC_RESULT
		MOVWF		JOY2LR
		RETURN
;*** STORE_JOY2UD **************************************
STORE_JOY2UD
		BANKSEL ADC_RESULT
		MOVFW		ADC_RESULT
		MOVWF		JOY2UD
		RETURN
;*** STORE_JOY1LR **************************************
STORE_JOY1LR
		BANKSEL ADC_RESULT
		MOVFW		ADC_RESULT
		MOVWF		JOY1LR
		RETURN
;*** STORE_JOY1UD **************************************
STORE_JOY1UD
		BANKSEL ADC_RESULT
		MOVFW		ADC_RESULT
		MOVWF		JOY1UD
		RETURN
;*** RESET_ADC_COUNT ***********************************
RESET_ADC_COUNT
		BANKSEL ADCON0				;CLEAR ANALOG CHANNEL SELECT TO AN0
		BCF		ADCON0, CHS4
		BCF		ADCON0, CHS3
		BCF		ADCON0, CHS2
		BCF		ADCON0, CHS1
		BCF		ADCON0, CHS0
		RETURN
;*** SEND_DATA_PACKET **********************************
SEND_DATA_PACKET
		BANKSEL		TXSTA
		BTFSS		TXSTA, TRMT		;TEST IF THE TRANMIT SHIFT REGISTER IS EMPTY, IF IT IS, DON'T RETURN	
		GOTO $ - 2
		;HANDSHAKE TX
		BANKSEL TXREG
		MOVLW		H'024'			;MOVE A '$' TO WORKING
		MOVWF		TXREG			;MOVE WORKING TO TRANSMIT REGISTER	
		BANKSEL TXSTA
		BTFSS		TXSTA, TRMT		;TEST IF THE TRANSMIT SHIFT REGISTER IS EMPTY, IF IT IS, LOOP BACK
		GOTO $ - 2
		;ROBOT ADDRESS TX
		BANKSEL RBT_ADR
		MOVFW		RBT_ADR			;MOVE THE ROBOT ADDRESS TO WORKING
		BANKSEL TXREG				;MOVE WORKING TO TRANSMIT REGISTER
		MOVWF		TXREG
		BANKSEL TXSTA
		BTFSS		TXSTA, TRMT		;TEST IF THE TRANSMIT SHIFT REGISTER IS EMPTY, IF IT IS, LOOP BACK
		GOTO $ - 2
		;CHARACTER TX
		BANKSEL TX_CHAR
		MOVFW		TX_CHAR			;MOVE THE COMMAND CHARACTER TO WORKING
		BANKSEL TXREG				;MOVE WORKING TO TRANSMIT REGISTER
		MOVWF		TXREG
		BANKSEL TXSTA
		BTFSS		TXSTA, TRMT		;TEST IF THE TRANSMIT SHIFT REGISTER IS EMPTY, IF IT IS, LOOP BACK
		GOTO $ - 2
		;VARIABLE 1 TX
		BANKSEL TX_VAR1
		MOVFW		TX_VAR1			;MOVE THE VARIABLE 1 TO WORKING
		BANKSEL TXREG				;MOVE WORKING TO TRANSMIT REGISTER
		MOVWF		TXREG
		BANKSEL TXSTA
		BTFSS		TXSTA, TRMT		;TEST IF THE TRANSMIT SHIFT REGISTER IS EMPTY, IF IT IS, LOOP BACK
		GOTO $ - 2
		;VARIABLE 2 TX
		BANKSEL TX_VAR2
		MOVFW		TX_VAR2			;MOVE THE VARIABLE 2 TO WORKING
		BANKSEL TXREG				;MOVE WORKING TO TRANSMIT REGISTER
		MOVWF		TXREG
		BANKSEL TXSTA
		BTFSS		TXSTA, TRMT		;TEST IF THE TRANSMIT SHIFT REGISTER IS EMPTY, IF IT IS, LOOP BACK
		GOTO $ - 2
		;VARIABLE 3 TX
		BANKSEL TX_VAR3
		MOVFW		TX_VAR3			;MOVE THE VARIABLE 3 TO WORKING
		BANKSEL TXREG				;MOVE WORKING TO TRANSMIT REGISTER
		MOVWF		TXREG
		BANKSEL TXSTA
		BTFSS		TXSTA, TRMT		;TEST IF THE TRANSMIT SHIFT REGISTER IS EMPTY, IF IT IS, LOOP BACK
		GOTO $ - 2
		
		RETURN
;*** CONVERSION_DONE ***********************************
CONVERSION_DONE
		
		BANKSEL ADCON0				;TEMPORARILY STORES ADCON0 FOR USE IN ANALOG READING
		MOVFW		ADCON0
		BANKSEL SHRT_TRM_REG
		MOVWF		SHRT_TRM_REG
		
		MOVLW		B'00000100'		;INCREMENT ADCON0 ANALOG CHANNEL SELECT
		BANKSEL		ADCON0			
		ADDWF		ADCON0		
		
		
		MOVLW		B'10011001'		;IF (ANALOG SELECT CHANNEL = AN6) THEN:
		BANKSEL ADCON0				    ;RESET ANALOG SELECT CHANNEL TO AN0
		XORWF		ADCON0, 0	    
		BANKSEL STATUS
		BTFSC		STATUS, Z				 
		CALL RESET_ADC_COUNT
		
		BANKSEL ADRESH				;STORES THE UPPER 8-BIT ADC CONVERSTION RESULT INTO ADC_RESULT
		MOVFW		ADRESH	
		BANKSEL		ADC_RESULT
		MOVWF		ADC_RESULT
		
		
							;SELECT CASE (ANALOG SELECT CHANNEL (ANX)):
		
		MOVLW		B'10000001'		    ;CASE 0
		BANKSEL		SHRT_TRM_REG		    ;STORE ADC_RESULT INTO JOY1UD
		XORWF		SHRT_TRM_REG, 0
		BANKSEL STATUS
		BTFSC		STATUS, Z
		CALL STORE_JOY1UD
		
		MOVLW		B'10000101'		    ;CASE 1
		BANKSEL		SHRT_TRM_REG		    ;STORE ADC_RESULT INTO JOY1LR
		XORWF		SHRT_TRM_REG, 0
		BANKSEL STATUS
		BTFSC		STATUS, Z
		CALL STORE_JOY1LR
		
		MOVLW		B'10001001'		    ;CASE 2
		BANKSEL		SHRT_TRM_REG		    ;STORE ADC_RESULT INTO JOY2UD
		XORWF		SHRT_TRM_REG, 0
		BANKSEL STATUS
		BTFSC		STATUS, Z
		CALL STORE_JOY2UD
		
		MOVLW		B'10001101'		    ;CASE 3
		BANKSEL		SHRT_TRM_REG		    ;STORE ADC_RESULT INTO JOY2LR
		XORWF		SHRT_TRM_REG, 0
		BANKSEL STATUS
		BTFSC		STATUS, Z
		CALL STORE_JOY2LR
		
		MOVLW		B'10010001'		    ;CASE 4
		BANKSEL		SHRT_TRM_REG		    ;STORE ADC_RESULT INTO JOY3UD
		XORWF		SHRT_TRM_REG, 0
		BANKSEL STATUS
		BTFSC		STATUS, Z
		CALL STORE_JOY3UD
		
		MOVLW		B'10010101'		    ;CASE 5
		BANKSEL		SHRT_TRM_REG		    ;STORE ADC_RESULT INTO JOY3LR
		XORWF		SHRT_TRM_REG, 0
		BANKSEL STATUS
		BTFSC		STATUS, Z
		CALL STORE_JOY3LR
							;END CASE
				
		BANKSEL ADCON0
		BSF		ADCON0, 1		;BEGIN A NEW CONVERSION
		
		RETURN
;*** SET_FWD_VAR **************************
SET_FWD_VAR
		BANKSEL JOY1UD				;SET TX_VAR1 TO 2 * (JOY1UD - 128)
		MOVFW		JOY1UD
		BANKSEL TX_VAR1
		MOVWF		TX_VAR1
		MOVLW		D'128'
		SUBWF		TX_VAR1, 1
		LSLF		TX_VAR1, 1

		BANKSEL TX_CHAR
		MOVLW		0X46			;SET TX_CHAR TO 'F'
		MOVWF		TX_CHAR
		CLRF		TX_VAR2			;CLEAR TX_VAR2
		CLRF		TX_VAR3			;CLEAR TX_VAR3
		CALL SEND_DATA_PACKET			;SEND DATA PACKET FOR FORWARD
		
		RETURN
;*** SET_BWD_VAR **************************
SET_BWD_VAR
		BANKSEL JOY1UD				;SET TX_VAR1 TO 255 - (JOY1UD * 2)
		MOVFW		JOY1UD
		BANKSEL TX_VAR1
		MOVWF		TX_VAR1
		LSLF		TX_VAR1, 1
		MOVFW		TX_VAR1
		SUBLW		D'255'
		MOVWF		TX_VAR1

		BANKSEL TX_CHAR
		MOVLW		0X42			;SET TX_CHAR TO 'B'
		MOVWF		TX_CHAR
		CLRF		TX_VAR2			;CLEAR TX_VAR2
		CLRF		TX_VAR3			;CLEAR TX_VAR3
		CALL SEND_DATA_PACKET			;SEND DATA PACKET FOR BACKWARD
		
		RETURN
;******************************************
MODE_1_MAIN
;******************************************
		
		MOVLW		D'140'
		BANKSEL JOY1UD
		SUBWF		JOY1UD, 0
		BANKSEL STATUS
		BTFSC		STATUS, C
		BSF		PORTD, 0
		BTFSS		STATUS, C
		BCF		PORTD, 0

		MOVLW		D'140'			;IF (JOY1UD > 140) THEN:	
		BANKSEL JOY1UD				    ;SET TX_VAR1 TO 2 * (JOY1UD - 128)    
		SUBWF		JOY1UD, 0		;ELSE:
		BANKSEL STATUS				    ;SET TX_VAR1 TO 0     
		BTFSC		STATUS, C		    
		CALL SET_FWD_VAR
		
		
		MOVLW		D'113'			;IF (JOY1UD < 113) THEN:	
		BANKSEL JOY1UD				    ;SET TX_VAR1 TO 255 - (JOY1UD * 2)    
		SUBWF		JOY1UD, 0		;ELSE:
		BANKSEL STATUS				    ;SET TX_VAR1 TO 0
		BTFSS		STATUS, C		    
		CALL SET_BWD_VAR		
		
		MOVLW		D'140'
		BANKSEL JOY1LR
		SUBWF		JOY1LR, 0
		BANKSEL STATUS
		BTFSC		STATUS, C
		BSF		PORTD, 1
		BTFSS		STATUS, C
		BCF		PORTD, 1

		
		MOVLW		D'140'
		BANKSEL JOY2UD
		SUBWF		JOY2UD, 0
		BANKSEL STATUS
		BTFSC		STATUS, C
		BSF		PORTD, 2
		BTFSS		STATUS, C
		BCF		PORTD, 2

		
		MOVLW		D'140'
		BANKSEL JOY2LR
		SUBWF		JOY2LR, 0
		BANKSEL STATUS
		BTFSC		STATUS, C
		BSF		PORTD, 3
		BTFSS		STATUS, C
		BCF		PORTD, 3

		
		MOVLW		D'140'
		BANKSEL JOY3UD
		SUBWF		JOY3UD, 0
		BANKSEL STATUS
		BTFSC		STATUS, C
		BSF		PORTD, 4
		BTFSS		STATUS, C
		BCF		PORTD, 4

		
		MOVLW		D'140'
		BANKSEL JOY3LR
		SUBWF		JOY3LR, 0
		BANKSEL STATUS
		BTFSC		STATUS, C
		BSF		PORTD, 5
		BTFSS		STATUS, C
		BCF		PORTD, 5
		
		GOTO MAIN
;******************************************
MODE_2_MAIN
;******************************************
		BANKSEL PORTD
		BTFSC		BTN_REG_1, 0
		BSF		PORTD, 7
		BTFSS		BTN_REG_1, 0
		BCF		PORTD, 7
		
		BANKSEL PORTD
		BTFSC		BTN_REG_1, 1
		BSF		PORTD, 6
		BTFSS		BTN_REG_1, 1
		BCF		PORTD, 6
		
		BANKSEL PORTD
		BTFSC		BTN_REG_1, 2
		BSF		PORTD, 5
		BTFSS		BTN_REG_1, 2
		BCF		PORTD, 5
		
		BANKSEL PORTD
		BTFSC		BTN_REG_1, 3
		BSF		PORTD, 4
		BTFSS		BTN_REG_1, 3
		BCF		PORTD, 4
		
		BANKSEL PORTD
		BTFSC		BTN_REG_1, 4
		BSF		PORTD, 3
		BTFSS		BTN_REG_1, 4
		BCF		PORTD, 3
		
		BANKSEL PORTD
		BTFSC		BTN_REG_1, 5
		BSF		PORTD, 2
		BTFSS		BTN_REG_1, 5
		BCF		PORTD, 2
		
		BANKSEL PORTD
		BCF		PORTD, 1
		BTFSC		BTN_REG_1, 6
		BSF		PORTD, 1
		BTFSC		BTN_REG_1, 7
		BSF		PORTD, 1
		BTFSC		BTN_REG_2, 0
		BSF		PORTD, 1
		BCF		PORTD, 0
		
		GOTO MAIN
;******************************************
MAIN
;******************************************
		BANKSEL PORTB				;STORE PORTB INTO ROBOT ADDRESS
		MOVFW		PORTB			;CLEAR BIT 7 AS THIS IS A 7-BIT ADDRESS
		MOVWF		RBT_ADR
		BCF		RBT_ADR, 7
		
		BANKSEL PORTA				;IF (NOT TRIGGER1) THEN:
		BTFSC		PORTA, 6		    ;CLEAR TRIGGER1_INDICATOR (BTN_REG_1 BIT0)
		BSF		BTN_REG_1, 0		;ELSEIF (TRIGGER1) THEN:
		BTFSS		PORTA, 6		    ;SET TRIGGER1_INDICATOR (BTN_REG_1 BIT0)
		BCF		BTN_REG_1, 0
			
		BANKSEL PORTA				;IF (NOT TRIGGER2) THEN:
		BTFSC		PORTA, 7		    ;CLEAR TRIGGER2_INDICATOR (BTN_REG_1 BIT1)
		BSF		BTN_REG_1, 1		;ELSEIF (TRIGGER1) THEN:
		BTFSS		PORTA, 7		    ;SET TRIGGER2_INDICATOR (BTN_REG_1 BIT1)
		BCF		BTN_REG_1, 1
		
		BANKSEL PORTA				;IF (NOT BUTTON 1) THEN:
		BTFSC		PORTA, 4		    ;CLEAR BUTTON1_INDICATOR (BTN_REG_1 BIT2)
		BSF		BTN_REG_1, 2		;ELSEIF (BUTTON 1) THEN:
		BTFSS		PORTA, 4		    ;SET BUTTON1_INDICATOR (BTN_REG_1 BIT2)
		BCF		BTN_REG_1, 2
		
		BANKSEL PORTE				;IF (NOT BUTTON 2) THEN:
		BTFSC		PORTE, 1		    ;CLEAR BUTTON2_INDICATOR (BTN_REG_1 BIT3)
		BSF		BTN_REG_1, 3		;ELSEIF (BUTTON 2) THEN:
		BTFSS		PORTE, 1		    ;SET BUTTON2_INDICATOR (BTN_REG_1 BIT3)
		BCF		BTN_REG_1, 3
		
		BANKSEL PORTE				;IF (NOT BUTTON 3) THEN:
		BTFSC		PORTE, 2		    ;CLEAR BUTTON3_INDICATOR (BTN_REG_1 BIT4)
		BSF		BTN_REG_1, 4		;ELSEIF (BUTTON 3) THEN:
		BTFSS		PORTE, 2		    ;SET BUTTON3_INDICATOR (BTN_REG_1 BIT4)
		BCF		BTN_REG_1, 4
		
		BANKSEL PORTC				;IF (NOT BUTTON 4) THEN:
		BTFSC		PORTC, 0		    ;CLEAR BUTTON4_INDICATOR (BTN_REG_1 BIT5)
		BSF		BTN_REG_1, 5		;ELSEIF (BUTTON 4) THEN:
		BTFSS		PORTC, 0		    ;SET BUTTON4_INDICATOR (BTN_REG_1 BIT5)
		BCF		BTN_REG_1, 5
		
		BANKSEL PORTC				;IF (NOT JOYBTN 1) THEN:
		BTFSC		PORTC, 1		    ;CLEAR JOYBTN1_INDICATOR (BTN_REG_1 BIT6)
		BSF		BTN_REG_1, 6		;ELSEIF (JOYBTN 1) THEN:
		BTFSS		PORTC, 1		    ;SET JOYBTN1_INDICATOR (BTN_REG_1 BIT6)
		BCF		BTN_REG_1, 6
		
		BANKSEL PORTC				;IF (NOT JOYBTN 2) THEN:
		BTFSC		PORTC, 2		    ;CLEAR JOYBTN2_INDICATOR (BTN_REG_1 BIT7)
		BSF		BTN_REG_1, 7		;ELSEIF (JOYBTN 2) THEN:
		BTFSS		PORTC, 2		    ;SET JOYBTN2_INDICATOR (BTN_REG_1 BIT7)
		BCF		BTN_REG_1, 7
		
		BANKSEL PORTC				;IF (NOT JOYBTN 3) THEN:
		BTFSC		PORTC, 5		    ;CLEAR JOYBTN3_INDICATOR (BTN_REG_2 BIT0)
		BSF		BTN_REG_2, 0		;ELSEIF (JOYBTN 3) THEN:
		BTFSS		PORTC, 5		    ;SET JOYBTN3_INDICATOR (BTN_REG_2 BIT0)
		BCF		BTN_REG_2, 0
		
		BANKSEL ADCON0				;IF (ADC DONE) THEN:
		BTFSS		ADCON0, 1		    ;CALL CONVERSION_DONE
		CALL CONVERSION_DONE
		
		BANKSEL PORTB				;IF (NOT MODE SELECT) THEN:
		BTFSS		PORTB, 7		    ;GOTO MODE_1_MAIN
		GOTO MODE_1_MAIN			;ELSEIF (MODE SELECT) THEN:
		BANKSEL PORTB				    ;GOTO MODE_2_MAIN
		BTFSC		PORTB, 7
		GOTO MODE_2_MAIN

		GOTO	MAIN				;LOOP BACK
		END
;********************END PROGRAM DIRECTIVE ***********************************
;*****************************************************************************









