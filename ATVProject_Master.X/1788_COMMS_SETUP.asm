;******************************************************************************
;                                                                             *
;    Filename:	    1788_COMMS_SETUP.INC				      *
;    Date:	    29 NOV 2023						      *
;    File Version:  1                                                         *
;    Author:        XAVIER HOSKINS                                            *
;    Company:       Idaho State University                                    *
;    Description:   Firmware for Setting up a PIC16LF1788 as the Master board *
;		    for the ATV project. This board handles the UART          *
;		    communications and serves as the I2C Master device.	      *
;		                                                              *
;******************************************************************************

;******************************************************************************
;                                                                             *
;    Revision History:                                                        *
;	1: SETUP FILE FOR PIC16LF1788 ATV PROJECT-SPECIFICS ON SETUP SHOULD   *
;	   BE LISTED HERE AS MODIFIED                                         *
;	   STARTED 29 NOV 2023					              *
;		- CURRENT VERSION IMPLEMENTED 9 DEC 2023		      *
;									      *
;                                                                             *
;******************************************************************************

    
 
    
;******************************************
;DEFINE PERSONAL SFR LOCATIONS
;******************************************
COUNT		EQU 0X20		;REGISTER TO KEEP COUNT OF RECEIVED BYTES
COUNT_CHECK	EQU 0X21		;REGISTER TO COMPARE COUNT TO SET VALUES
RECEIVE		EQU 0X22		;REGISTER WITH FLAG TO INDICATE RECEIVED DATA
W_SAVE		EQU 0X23		;REGISTER TO SAVE W DURING INTERRUPT
STATUS_SAVE	EQU 0X24		;REGISTER TO SAVE STATUS DURING INTERRUPT
BYTE_1		EQU 0X25		;REGISTER TO SAVE FIRST BYTE
BYTE_2		EQU 0X26		;REGISTER TO SAVE SECOND BYTE
BYTE_3		EQU 0X27		;REGISTER TO SAVE THIRD BYTE
BYTE_4		EQU 0X28		;REGISTER TO SAVE FOURTH BYTE
BYTE_5		EQU 0X29		;REGISTER TO SAVE FIFTH BYTE
BYTE_6		EQU 0X2A		;REGISTER TO SAVE SIXTH BYTE
TEMP_ADD	EQU 0X2B		;REGISTER TO SEND I2C ADDRESS
DRIVE_COMMAND	EQU 0X2C		;REGISTER TO SEND I2C COMMAND
DRIVE_DATA	EQU 0X2D		;REGISTER TO SEND I2C DATA
CONECTION_STA	EQU 0X2E		;REGISTER FOR CONECTION STATUS	
DRIVE_ADD	EQU 0X2F		
		
		
;******************************************
;DEFINE CONSTANTS
;******************************************
#Define		DRIVER_ADD	0X0A	;USE ADDRESS OF 0X0A FOR DRIVER
#Define		PERIPHERAL_ADD	0X1A	;USE ADDRESS OF 0X1A FOR PERIPHERALS
#Define		SBAUDVAL	0X19	;0X19 SETS BAUDRATE

;******************************************
;SETUP CODE
;******************************************
	
SETUP_CODE   CODE			;START OF THE FILE
	    
INITIALIZE
;------OSC SETUP  ----------------------------------------------
		BANKSEL	OSCCON
		MOVLW	0X7A
		MOVWF	OSCCON		;SET INTERNL OSC TO 16 MHZ
		
;------ COMM PINS SETUP ----------------------------------------
;*******I2C PORT ON RC 3&4, UART ON RC 6&7  ******************
		BANKSEL	APFCON1
		BCF	APFCON1, SCKSEL	    ;0 [SCK = RC3] / 1 [SCK = RB7]
		BCF	APFCON1, SDISEL	    ;0 [SDA = RC4] / 1 [SDA = RB6]
		BCF	APFCON1, TXSEL	    ;0 [TX = RC6] / 1 [TX = RB6]
		BCF	APFCON1, RXSEL	    ;0 [RX = RC7] / 1 [RX = RB7]
;		BCF	APFCON1, C2OUTSEL   ;0 [C2OUT = RA5] / 1 [C2OUT = RA6]	
;		BCF	APFCON1, CCP1SEL    ;0 [CCP1 = RC2] / 1 [CCP1 = RB0]
;		BCF	APFCON1, SDOSEL	    ;0 [CCP1 = RC5] / 1 [CCP1 = RB5]
;		BCF	APFCON1, CCP2SEL    ;0 [CCP2 = RC1] / 1 [CCP2 = RB3]
		
;------ A/D SETUP ----------------------------------------------
;ADCON0 REGISTER

		BANKSEL	ADCON0
		CLRF	ADCON0		;DISALE ADC		
		
;ADCON1 REGISTER
		BANKSEL	ADCON1
		CLRF	ADCON1		;ADC IS UNUSED	
		
;ADCON2 REGISTER
		BANKSEL	ADCON2
		CLRF	ADCON2		;ADC IS UNUSED	
	
;ANSEL REGISTERS
		BANKSEL ANSELA
		CLRF	ANSELA		;SET ALL PORTA TO DIGITAL I/O

		BANKSEL ANSELB
		CLRF	ANSELB		;SET ALL PORTB TO DIGITAL I/O
		
;------ I/O PORT SETUP ------------------------------------------------------
;* PORT A SETUP    
		BANKSEL LATA
		CLRF	LATA
		BANKSEL	TRISA		
		MOVLW	0xFF		;SET PORTA AS INPUTS 
		MOVWF	TRISA		
		MOVLW	0X00
		BANKSEL	WPUA
		MOVWF	WPUA		;DISABLE PORT A WEAK PULLUPS
		BANKSEL	SLRCONA
		CLRF	SLRCONA		;SLEWRATE TO MAXIMUM
		BANKSEL	INLVLA
		CLRF	INLVLA		;SET INPUT LEVEL TO TTL
		BANKSEL	ODCONA
		CLRF	ODCONA		;SET PORT A TO PUSH PULL
		
;* PORT B SETUP				
		BANKSEL LATB		   
		CLRF	LATB		
		BANKSEL	TRISB	
		MOVLW	0x00		
		MOVWF	TRISB		;PORTB IS UNUSED
		MOVLW	0X00
		BANKSEL	WPUB
		MOVWF	WPUB		;DISABLE PORT B WEAK PULLUPS
		BANKSEL	SLRCONB
		CLRF	SLRCONB		;SLEWRATE TO MAXIMUM
		BANKSEL	INLVLB
		CLRF	INLVLB		;SET INPUT LEVEL TO TTL
		BANKSEL	ODCONB
		CLRF	ODCONB		;SET PORT B TO PUSH PULL 

;PORT C SETUP
		BANKSEL LATC
		CLRF	LATC		
		MOVLW	0x98		
		BANKSEL	TRISC		;RC3&4 INPUT FOR I2C
		MOVWF	TRISC		;RC6 TX & RC7 RX FOR UART
		
		MOVLW	0X00		;DISABLE WEAK PULLUPS 
		BANKSEL	WPUC
		MOVWF	WPUC		
		
;ADDITIONAL GPIO FUNCTIONS
		BANKSEL	SLRCONC
		CLRF	SLRCONC		;SLEWRATE TO MAXIMUM
		BANKSEL	INLVLC
		CLRF	INLVLC		;SET INPUT LEVEL TO TTL
		BANKSEL	ODCONC
		CLRF	ODCONC		;SET PORT C TO PUSH PULL

;USART SETUP *****************************************************************	
;BAUDRATE REGISTER 		
		BANKSEL	BAUDCON
		BCF	BAUDCON, BRG16	;SET BAUDRATE GENERATOR TO 8 BIT

;SPBRG REGISTER 
		BANKSEL SPBRG		;SPBRG = (FOSC / (64 * BAUD) - 1
		MOVLW	SBAUDVAL	;SET SERIAL BAUD RATE
		MOVWF	SPBRG

;TXSTA REGISTER 
		BANKSEL TXSTA
		BCF	TXSTA,	BRGH	;SET BRGH TO HIGH SPEED
		BCF	TXSTA,	SYNC	;SET SYNC TO ASYNCH MODE
		BCF	TXSTA,	TX9	;SET TO 8 BIT TRANSMISSION
		
;RCSTA REGISTER 
		BANKSEL RCSTA
		BSF	RCSTA,CREN	;ENABLE CONTINUOS RECIEVE
		BCF	RCSTA,RX9	;SET 8 BIT RECEPTION		
		BSF	RCSTA,SPEN	;ENABLE SERIAL PORT

;ENABLE TRANSMIT
		BANKSEL TXSTA
		BSF	TXSTA,	TXEN	;ENABLE TRANSMIT		
	
		
;I2C SETUP *******************************************************************
;SSP1CON1 REGISTER
		BANKSEL	SSP1CON1
		BSF	SSP1CON1,SSPEN	;ENABLE SERIAL PORT
		BCF	SSP1CON1,SSPM0	;\
		BCF	SSP1CON1,SSPM1	;*\
		BCF	SSP1CON1,SSPM2	;**\
		BSF	SSP1CON1,SSPM3	;***ENABLE I2C MASTER MODE, SSPADD USED FOR BAUD
		
;SSP1CON2 REGISTER
		BANKSEL	SSP1CON2
		BCF	SSP1CON2,ACKEN	;IDLE STATE
		BCF	SSP1CON2,RCEN	;IDLE STATE 
		BCF	SSP1CON2,PEN	;IDLE STATE
		BCF	SSP1CON2,RSEN	;IDLE STATE
		BCF	SSP1CON2,SEN	;IDLE STATE
		
;SSP1STAT REGISTER
		BANKSEL	SSP1STAT
		BSF	SSP1STAT,SMP	;SLEW RATE DISABLED FOR 100KHZ CLOCK
		BSF	SSP1STAT,CKE	;ENABLE SMBUS COMPLIANT OPERATION
		
;SSPADD REGISTER
		BANKSEL	SSP1ADD
		MOVLW	0X27		;SSPADD = (FOSC / (BAUD * 4)) - 1 = 39 = 0X27
		MOVWF	SSP1ADD
		
		
;MISC SETUP ******************************************************************
;OPTION_REG REGISTER 
		BANKSEL OPTION_REG
		BSF	OPTION_REG, PS0	;\\
		BSF	OPTION_REG, PS1	; >>PRESCALER RATIO SET 1:1
		BSF	OPTION_REG, PS2	;//
		BCF	OPTION_REG, PSA	;PRESCALER ASSIGNED TO TMR0 
		BCF	OPTION_REG, T0SE	;TMR0 EDGE SET RISING
		BCF	OPTION_REG, T0CS	;TMR0 CLOCK SET TO INTERNAL
		BSF	OPTION_REG, INTEDG	;RB0/INT SET TO RISING EDGE
		BCF	OPTION_REG, 7	;PULLUPS SET TO INDIVIDUALLY EN.
		
;INTCON REGISTER 
		BANKSEL INTCON
		BCF	INTCON, INTE	;DISABLE RB0/INT EXT INTERRUPT
		BSF	INTCON, TMR0IE	;DISABLE TMR0 INTERRUPT
		BCF	INTCON, PEIE	;DISABLE PERIPHERAL INTERRUPTS
		BCF	INTCON, GIE	;DISABLE ALL UNMASKED INTERRUPTS
		
;PIE1 REGISTER 
		BANKSEL PIE1
		BCF	PIE1, TMR1IE	;DISABLE TMR1 INTERRUPT
		BCF	PIE1, TMR2IE	;ENABLE TMR2 INTERRUPT
		BCF	PIE1, CCP1IE	;DISABLE CCP1 INTERRUPT
		BCF	PIE1, SSP1IE	;ENABLE SSP INTERRUPT
		BCF	PIE1, TXIE	;DISABLE USART TX INTERRUPT
		BSF	PIE1, RCIE	;ENABLE USART RX INTERRUPT
 		BCF	PIE1, ADIE	;DISABLE A/D INTERRUPT
		BCF	PIE1, 7		;DISABLE PSP INTERRUPT
	
;PIE2 REGISTER
		BANKSEL	PIE2
		BCF	PIE2, CCP2IE	;DISABLE THE CCP2 INTERRUPT
		BCF	PIE2, BCL1IE	;DISABLE BUS COLLISION INTERRUPT
		BCF	PIE2, EEIE	;DISABLE EEPROM WRITE INTERRUPT

;T1CON REGISTER 
		BANKSEL	T1CON
		BCF	T1CON, TMR1ON	;DISABLE TIMER 1
		BCF	T1CON, T1OSCEN	;OSCILLATOR IS SHUT OFF
		BCF	T1CON, T1CKPS1	;00 1:1 PRESCALE VALUE
		BCF	T1CON, T1CKPS0	

;T2CON REGISTER   
		BANKSEL	T2CON
		BSF	T2CON, T2OUTPS0	;\
		BSF	T2CON, T2OUTPS1 ; \ TIMER 2 POSTSCALER
		BSF	T2CON, T2OUTPS2 ; / '1111' POSTSCALER = 1:16
		BSF	T2CON, T2OUTPS3 ;/
		BCF	T2CON, TMR2ON 	;DIS. TIMER 2/ ENABLED AS NEEDED
		BSF	T2CON, T2CKPS0	;\ 11 PRESCALE VALUE IS 64
		BSF	T2CON, T2CKPS1	;/
		
;PR2 REGISTER  
		BANKSEL	PR2
		CLRF	PR2

;CCP1CON REGISTER
		BANKSEL	CCP1CON
		BCF	CCP1CON, CCP1M0	
		BCF	CCP1CON, CCP1M1	; >CAPTURE/COMPARE/PWM DISABLED
		BCF	CCP1CON, CCP1M2	
		BCF	CCP1CON, CCP1M3	
		
;CCP2CON REGISTER 
		BANKSEL	CCP2CON
		BCF	CCP2CON, CCP2M0	
		BCF	CCP2CON, CCP2M1	;>CAPTURE/COMPARE/PWM DISABLED
		BCF	CCP2CON, CCP2M2	
		BCF	CCP2CON, CCP2M3	
		
;FINALIZE AND ENABLE INTERRUPTS
		BANKSEL	PIR1
		BCF	PIR1,RCIF	;CLEAR INTERRUPT FLAGS
		BCF	PIR1,TMR2IF	;*/
		BCF	PIR1,SSP1IF	;/
		BANKSEL	COUNT3
		CLRF	COUNT3		;CLEAR COUNT3
		CLRF	RECEIVE		;CLEAR RECEIVE FLAGS
		BANKSEL	INTCON
		BSF	INTCON,PEIE	;ENABLE PERIPHERAL INTERRUPTS
		BSF	INTCON,GIE	;ENABLE GLOBAL INTERRUPTS
		RETURN
